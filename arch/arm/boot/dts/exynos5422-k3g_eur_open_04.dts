# 1 "arch/arm/boot/dts/exynos5422-k3g_eur_open_04.dts"
# 1 "<command-line>"
# 1 "arch/arm/boot/dts/exynos5422-k3g_eur_open_04.dts"
# 12 "arch/arm/boot/dts/exynos5422-k3g_eur_open_04.dts"
/dts-v1/;
# 1 "arch/arm/boot/dts/exynos5422_evt0-k3g_common.dtsi" 1
# 12 "arch/arm/boot/dts/exynos5422_evt0-k3g_common.dtsi"
# 1 "arch/arm/boot/dts/exynos5422_evt0.dtsi" 1
# 16 "arch/arm/boot/dts/exynos5422_evt0.dtsi"
# 1 "arch/arm/boot/dts/exynos5.dtsi" 1
# 16 "arch/arm/boot/dts/exynos5.dtsi"
# 1 "arch/arm/boot/dts/skeleton.dtsi" 1






/ {
 #address-cells = <1>;
 #size-cells = <1>;
 chosen { };
 aliases { };
 memory { device_type = "memory"; reg = <0 0>; };
};
# 17 "arch/arm/boot/dts/exynos5.dtsi" 2

/ {
 interrupt-parent = <&gic>;

 chipid@10000000 {
  compatible = "samsung,exynos4210-chipid";
  reg = <0x10000000 0x100>;
 };

 combiner:interrupt-controller@10440000 {
  compatible = "samsung,exynos4210-combiner";
  #interrupt-cells = <2>;
  interrupt-controller;
  samsung,combiner-nr = <32>;
  reg = <0x10440000 0x1000>;
  interrupts = <0 0 0>, <0 1 0>, <0 2 0>, <0 3 0>,
    <0 4 0>, <0 5 0>, <0 6 0>, <0 7 0>,
    <0 8 0>, <0 9 0>, <0 10 0>, <0 11 0>,
    <0 12 0>, <0 13 0>, <0 14 0>, <0 15 0>,
    <0 16 0>, <0 17 0>, <0 18 0>, <0 19 0>,
    <0 20 0>, <0 21 0>, <0 22 0>, <0 23 0>,
    <0 24 0>, <0 25 0>, <0 26 0>, <0 27 0>,
    <0 28 0>, <0 29 0>, <0 30 0>, <0 31 0>;
 };

 gic:interrupt-controller@10481000 {
  compatible = "arm,cortex-a15-gic", "arm,cortex-a9-gic";
  #interrupt-cells = <3>;
  interrupt-controller;
  reg = <0x10481000 0x1000>,
   <0x10482000 0x1000>,
   <0x10484000 0x2000>,
   <0x10486000 0x2000>;
  interrupts = <1 9 0xf04>;
 };

 dwmmc_0: dwmmc0@12200000 {
  compatible = "samsung,exynos5250-dw-mshc";
  interrupts = <0 75 0>;
  #address-cells = <1>;
  #size-cells = <0>;
 };

 dwmmc_1: dwmmc1@12210000 {
  compatible = "samsung,exynos5250-dw-mshc";
  interrupts = <0 76 0>;
  #address-cells = <1>;
  #size-cells = <0>;
 };

 dwmmc_2: dwmmc2@12220000 {
  compatible = "samsung,exynos5250-dw-mshc";
  interrupts = <0 77 0>;
  #address-cells = <1>;
  #size-cells = <0>;
 };

 serial@12C00000 {
  compatible = "samsung,exynos4210-uart";
  reg = <0x12C00000 0x100>;
  interrupts = <0 51 0>;
 };

 serial@12C10000 {
  compatible = "samsung,exynos4210-uart";
  reg = <0x12C10000 0x100>;
  interrupts = <0 52 0>;
 };

 serial@12C20000 {
  compatible = "samsung,exynos4210-uart";
  reg = <0x12C20000 0x100>;
  interrupts = <0 53 0>;
 };

 serial@12C30000 {
  compatible = "samsung,exynos4210-uart";
  reg = <0x12C30000 0x100>;
  interrupts = <0 54 0>;
 };

 rtc {
  compatible = "samsung,s3c6410-rtc";
  reg = <0x101E0000 0x100>;
  interrupts = <0 43 0>, <0 44 0>;
  status = "disabled";
 };

 watchdog {
  compatible = "samsung,s3c2410-wdt";
  reg = <0x101D0000 0x100>;
  interrupts = <0 42 0>;
  status = "disabled";
 };
};
# 17 "arch/arm/boot/dts/exynos5422_evt0.dtsi" 2
# 1 "arch/arm/boot/dts/exynos5422-pinctrl.dtsi" 1
# 15 "arch/arm/boot/dts/exynos5422-pinctrl.dtsi"
/ {
 pinctrl@13400000 {
  gpy7: gpy7 {
   gpio-controller;
   #gpio-cells = <2>;

   interrupt-controller;
   #interrupt-cells = <2>;
  };

  gpx0: gpx0 {
   gpio-controller;
   #gpio-cells = <2>;

   interrupt-controller;
   interrupt-parent = <&combiner>;
   #interrupt-cells = <2>;
   interrupts = <23 0>, <24 0>, <25 0>, <25 1>,
         <26 0>, <26 1>, <27 0>, <27 1>;
  };

  gpx1: gpx1 {
   gpio-controller;
   #gpio-cells = <2>;

   interrupt-controller;
   interrupt-parent = <&combiner>;
   #interrupt-cells = <2>;
   interrupts = <28 0>, <28 1>, <29 0>, <29 1>,
         <30 0>, <30 1>, <31 0>, <31 1>;
  };

  gpx2: gpx2 {
   gpio-controller;
   #gpio-cells = <2>;

   interrupt-controller;
   #interrupt-cells = <3>;
  };

  gpx3: gpx3 {
   gpio-controller;
   #gpio-cells = <2>;

   interrupt-controller;
   #interrupt-cells = <2>;
  };

  hdmi_hdmi_hpd: hdmi_hdmi_hpd {
   samsung,pins = "gpx3-7";
   samsung,pin-function = <3>;
   samsung,pin-pud = <1>;
   samsung,pin-drv = <0>;
  };

  hdmi_ext_hpd: hdmi_ext_hpd {
   samsung,pins = "gpx3-7";
   samsung,pin-function = <15>;
   samsung,pin-pud = <1>;
   samsung,pin-drv = <0>;
  };

  hdmi_cec: hdmi_cec {
   samsung,pins = "gpx3-6";
   samsung,pin-function = <3>;
   samsung,pin-pud = <1>;
   samsung,pin-drv = <0>;
  };
 };

 pinctrl@13410000 {
  gpc0: gpc0 {
   gpio-controller;
   #gpio-cells = <2>;

   interrupt-controller;
   #interrupt-cells = <2>;
  };

  gpc1: gpc1 {
   gpio-controller;
   #gpio-cells = <2>;

   interrupt-controller;
   #interrupt-cells = <2>;
  };

  gpc2: gpc2 {
   gpio-controller;
   #gpio-cells = <2>;

   interrupt-controller;
   #interrupt-cells = <2>;
  };

  gpc3: gpc3 {
   gpio-controller;
   #gpio-cells = <2>;

   interrupt-controller;
   #interrupt-cells = <2>;
  };

  gpc4: gpc4 {
   gpio-controller;
   #gpio-cells = <2>;

   interrupt-controller;
   #interrupt-cells = <2>;
  };

  gpd1: gpd1 {
   gpio-controller;
   #gpio-cells = <2>;

   interrupt-controller;
   #interrupt-cells = <2>;
  };

  gpy0: gpy0 {
   gpio-controller;
   #gpio-cells = <2>;
  };

  gpy1: gpy1 {
   gpio-controller;
   #gpio-cells = <2>;
  };

  gpy2: gpy2 {
   gpio-controller;
   #gpio-cells = <2>;
  };

  gpy3: gpy3 {
   gpio-controller;
   #gpio-cells = <2>;
  };

  gpy4: gpy4 {
   gpio-controller;
   #gpio-cells = <2>;
  };

  gpy5: gpy5 {
   gpio-controller;
   #gpio-cells = <2>;
  };

  gpy6: gpy6 {
   gpio-controller;
   #gpio-cells = <2>;
  };

  sd0_clk: sd0-clk {
   samsung,pins = "gpc0-0";
   samsung,pin-function = <2>;
   samsung,pin-pud = <0>;
   samsung,pin-drv = <1>;
  };

  sd0_cmd: sd0-cmd {
   samsung,pins = "gpc0-1";
   samsung,pin-function = <2>;
   samsung,pin-pud = <0>;
   samsung,pin-drv = <1>;
  };

  sd0_rdqs: sd0-rdqs {
   samsung,pins = "gpc0-7";
   samsung,pin-function = <2>;
   samsung,pin-pud = <1>;
  };

  sd0_qrdy: sd0-qrdy {
   samsung,pins = "gpd1-3";
   samsung,pin-function = <2>;
   samsung,pin-pud = <0>;
  };

  sd0_bus1: sd0-bus-width1 {
   samsung,pins = "gpc0-3";
   samsung,pin-function = <2>;
   samsung,pin-pud = <3>;
   samsung,pin-drv = <1>;
  };

  sd0_bus4: sd0-bus-width4 {
   samsung,pins = "gpc0-4", "gpc0-5", "gpc0-6";
   samsung,pin-function = <2>;
   samsung,pin-pud = <3>;
   samsung,pin-drv = <1>;
  };

  sd0_bus8: sd0-bus-width8 {
   samsung,pins = "gpc3-0", "gpc3-1", "gpc3-2", "gpc3-3";
   samsung,pin-function = <2>;
   samsung,pin-pud = <3>;
   samsung,pin-drv = <1>;
  };

  sd1_clk: sd1-clk {
   samsung,pins = "gpc1-0";
   samsung,pin-function = <2>;
   samsung,pin-pud = <0>;
   samsung,pin-drv = <2>;
  };

  sd1_cmd: sd1-cmd {
   samsung,pins = "gpc1-1";
   samsung,pin-function = <2>;
   samsung,pin-pud = <0>;
   samsung,pin-drv = <2>;
  };

  sd1_bus1: sd1-bus-width1 {
   samsung,pins = "gpc1-3";
   samsung,pin-function = <2>;
   samsung,pin-pud = <3>;
   samsung,pin-drv = <2>;
  };

  sd1_bus4: sd1-bus-width4 {
   samsung,pins = "gpc1-4", "gpc1-5", "gpc1-6";
   samsung,pin-function = <2>;
   samsung,pin-pud = <3>;
   samsung,pin-drv = <2>;
  };

  sd1_bus8: sd1-bus-width8 {
   samsung,pins = "gpd1-4", "gpd1-5", "gpd1-6", "gpd1-7";
   samsung,pin-function = <2>;
   samsung,pin-pud = <3>;
   samsung,pin-drv = <2>;
  };

  sd2_clk: sd2-clk {
   samsung,pins = "gpc2-0";
   samsung,pin-function = <2>;
   samsung,pin-pud = <0>;
   samsung,pin-drv = <1>;
  };

  sd2_cmd: sd2-cmd {
   samsung,pins = "gpc2-1";
   samsung,pin-function = <2>;
   samsung,pin-pud = <0>;
   samsung,pin-drv = <1>;
  };

  sd2_cd: sd2-cd {
   samsung,pins = "gpc2-2";
   samsung,pin-function = <2>;
   samsung,pin-pud = <3>;
   samsung,pin-drv = <1>;
  };

  sd2_bus1: sd2-bus-width1 {
   samsung,pins = "gpc2-3";
   samsung,pin-function = <2>;
   samsung,pin-pud = <0>;
   samsung,pin-drv = <1>;
  };

  sd2_bus4: sd2-bus-width4 {
   samsung,pins = "gpc2-4", "gpc2-5", "gpc2-6";
   samsung,pin-function = <2>;
   samsung,pin-pud = <0>;
   samsung,pin-drv = <1>;
  };


  sd2_clk_output: sd2-clk-output {
   samsung,pins = "gpc2-0";
   samsung,pin-function = <1>;
   samsung,pin-pud = <0>;
   samsung,pin-drv = <1>;
  };

  sd2_cmd_output: sd2-cmd-output {
   samsung,pins = "gpc2-1";
   samsung,pin-function = <1>;
   samsung,pin-pud = <0>;
   samsung,pin-drv = <1>;
  };
 };

 pinctrl@14000000 {
  gpe0: gpe0 {
   gpio-controller;
   #gpio-cells = <2>;

   interrupt-controller;
   #interrupt-cells = <2>;
  };

  gpe1: gpe1 {
   gpio-controller;
   #gpio-cells = <2>;

   interrupt-controller;
   #interrupt-cells = <2>;
  };

  gpf0: gpf0 {
   gpio-controller;
   #gpio-cells = <2>;

   interrupt-controller;
   #interrupt-cells = <2>;
  };

  gpf1: gpf1 {
   gpio-controller;
   #gpio-cells = <2>;

   interrupt-controller;
   #interrupt-cells = <2>;
  };

  gpg0: gpg0 {
   gpio-controller;
   #gpio-cells = <2>;

   interrupt-controller;
   #interrupt-cells = <2>;
  };

  gpg1: gpg1 {
   gpio-controller;
   #gpio-cells = <2>;

   interrupt-controller;
   #interrupt-cells = <2>;
  };

  gpg2: gpg2 {
   gpio-controller;
   #gpio-cells = <2>;

   interrupt-controller;
   #interrupt-cells = <2>;
  };

  gpj4: gpj4 {
   gpio-controller;
   #gpio-cells = <2>;

   interrupt-controller;
   #interrupt-cells = <2>;
  };

  disp_teson: disp_teson {
   samsung,pins = "gpj4-0";
   samsung,pin-function = <2>;
  };

  disp_tesoff: disp_tesoff {
   samsung,pins = "gpj4-0";
   samsung,pin-function = <0>;
  };

  fimc_is_uart: fimc-is-uart {
   samsung,pins = "gpe0-7", "gpe1-1";
   samsung,pin-function = <3>;
   samsung,pin-pud = <0>;
   samsung,pin-drv = <0>;
  };

  fimc_is_ch0_i2c: fimc-is-ch0_i2c {
   samsung,pins = "gpf0-1", "gpf0-0";
   samsung,pin-function = <2>;
   samsung,pin-pud = <0>;
   samsung,pin-drv = <0>;
  };

  fimc_is_ch1_i2c: fimc-is-ch1-i2c {
   samsung,pins = "gpf0-3", "gpf0-2";
   samsung,pin-function = <2>;
   samsung,pin-pud = <0>;
   samsung,pin-drv = <0>;
  };

  fimc_is_ch2_i2c: fimc-is-ch2-i2c {
   samsung,pins = "gpf0-5", "gpf0-4";
   samsung,pin-function = <2>;
   samsung,pin-pud = <0>;
   samsung,pin-drv = <0>;
  };

  fimc_is_spi_pin0: fimc-is-spi-pin0 {
   samsung,pins = "gpf1-3", "gpf1-2", "gpf1-1", "gpf1-0";
   samsung,pin-function = <2>;
   samsung,pin-pud = <0>;
   samsung,pin-drv = <0>;
  };

  fimc_is_spi_pin1: fimc-is-spi-pin1 {
   samsung,pins = "gpf1-7", "gpf1-6", "gpf1-5", "gpf1-4";
   samsung,pin-function = <2>;
   samsung,pin-pud = <0>;
   samsung,pin-drv = <0>;
  };
 };

 pinctrl@14010000 {
  gpa0: gpa0 {
   gpio-controller;
   #gpio-cells = <2>;

   interrupt-controller;
   #interrupt-cells = <2>;
  };

  gpa1: gpa1 {
   gpio-controller;
   #gpio-cells = <2>;

   interrupt-controller;
   #interrupt-cells = <2>;
  };

  gpa2: gpa2 {
   gpio-controller;
   #gpio-cells = <2>;

   interrupt-controller;
   #interrupt-cells = <2>;
  };

  gpb0: gpb0 {
   gpio-controller;
   #gpio-cells = <2>;

   interrupt-controller;
   #interrupt-cells = <2>;
  };

  gpb1: gpb1 {
   gpio-controller;
   #gpio-cells = <2>;

   interrupt-controller;
   #interrupt-cells = <2>;
  };

  gpb2: gpb2 {
   gpio-controller;
   #gpio-cells = <2>;

   interrupt-controller;
   #interrupt-cells = <2>;
  };

  gpb3: gpb3 {
   gpio-controller;
   #gpio-cells = <2>;

   interrupt-controller;
   #interrupt-cells = <2>;
  };

  gpb4: gpb4 {
   gpio-controller;
   #gpio-cells = <2>;

   interrupt-controller;
   #interrupt-cells = <2>;
  };

  gph0: gph0 {
   gpio-controller;
   #gpio-cells = <2>;

   interrupt-controller;
   #interrupt-cells = <2>;
  };

  uart0_bus: uart0-bus {
   samsung,pins = "gpa0-3", "gpa0-2", "gpa0-1", "gpa0-0";
   samsung,pin-function = <2>;
   samsung,pin-pud = <0>;
  };

  uart1_bus: uart1-bus {
   samsung,pins = "gpa0-7", "gpa0-6", "gpa0-5", "gpa0-4";
   samsung,pin-function = <2>;
   samsung,pin-pud = <0>;
  };

  uart2_bus: uart2-bus {
   samsung,pins = "gpa1-3", "gpa1-2", "gpa1-1", "gpa1-0";
   samsung,pin-function = <2>;
   samsung,pin-pud = <0>;
  };

  uart3_bus: uart3-bus {
   samsung,pins = "gpa1-5", "gpa1-4";
   samsung,pin-function = <2>;
   samsung,pin-pud = <0>;
  };

  i2c2_bus: i2c2-bus {
   samsung,pins = "gpa0-7", "gpa0-6";
   samsung,pin-function = <3>;
   samsung,pin-pud = <3>;
   samsung,pin-drv = <0>;
  };

  i2c3_bus: i2c3-bus {
   samsung,pins = "gpa1-3", "gpa1-2";
   samsung,pin-function = <3>;
   samsung,pin-pud = <3>;
   samsung,pin-drv = <0>;
  };

  hs_i2c0_bus: hs-i2c0-bus {
   samsung,pins = "gpa2-1", "gpa2-0";
   samsung,pin-function = <3>;
   samsung,pin-pud = <3>;
   samsung,pin-drv = <0>;
  };

  hs_i2c1_bus: hs-i2c1-bus {
   samsung,pins = "gpa2-3", "gpa2-2";
   samsung,pin-function = <3>;
   samsung,pin-pud = <3>;
   samsung,pin-drv = <0>;
  };

  hs_i2c2_bus: hs-i2c2-bus {
   samsung,pins = "gpb1-4", "gpb1-3";
   samsung,pin-function = <4>;
   samsung,pin-pud = <3>;
   samsung,pin-drv = <0>;
  };

  hs_i2c3_bus: hs-i2c3-bus {
   samsung,pins = "gpb2-3", "gpb2-2";
   samsung,pin-function = <3>;
   samsung,pin-pud = <3>;
   samsung,pin-drv = <0>;
  };

  hs_i2c4_bus: hs-i2c4-bus {
   samsung,pins = "gpb3-5", "gpb3-4";
   samsung,pin-function = <2>;
   samsung,pin-pud = <3>;
   samsung,pin-drv = <0>;
  };

  hs_i2c5_bus: hs-i2c5-bus {
   samsung,pins = "gpb3-7", "gpb3-6";
   samsung,pin-function = <2>;
   samsung,pin-pud = <3>;
   samsung,pin-drv = <0>;
  };

  hs_i2c6_bus: hs-i2c6-bus {
   samsung,pins = "gpb4-1", "gpb4-0";
   samsung,pin-function = <2>;
   samsung,pin-pud = <3>;
   samsung,pin-drv = <0>;
  };

  i2c0_bus: i2c0-bus {
   samsung,pins = "gpb3-1", "gpb3-0";
   samsung,pin-function = <2>;
   samsung,pin-pud = <3>;
   samsung,pin-drv = <0>;
  };

  i2c1_bus: i2c1-bus {
   samsung,pins = "gpb3-3", "gpb3-2";
   samsung,pin-function = <2>;
   samsung,pin-pud = <3>;
   samsung,pin-drv = <0>;
  };

  i2s1_bus: i2s1-bus {
   samsung,pins = "gpb0-0", "gpb0-1", "gpb0-2", "gpb0-3",
     "gpb0-4";
   samsung,pin-function = <2>;
   samsung,pin-pud = <1>;
   samsung,pin-drv = <0>;
  };

  pcm1_bus: pcm1-bus {
   samsung,pins = "gpb0-0", "gpb0-1", "gpb0-2", "gpb0-3",
     "gpb0-4";
   samsung,pin-function = <3>;
   samsung,pin-pud = <1>;
   samsung,pin-drv = <0>;
  };

  i2s2_bus: i2s2-bus {
   samsung,pins = "gpb1-0", "gpb1-1", "gpb1-2", "gpb1-3",
     "gpb1-4";
   samsung,pin-function = <2>;
   samsung,pin-pud = <1>;
   samsung,pin-drv = <0>;
  };

  pcm2_bus: pcm2-bus {
   samsung,pins = "gpb1-0", "gpb1-1", "gpb1-2", "gpb1-3",
     "gpb1-4";
   samsung,pin-function = <3>;
   samsung,pin-pud = <1>;
   samsung,pin-drv = <0>;
  };

  spdif_bus: spdif-bus {
   samsung,pins = "gpb1-0", "gpb1-1";
   samsung,pin-function = <4>;
   samsung,pin-pud = <1>;
   samsung,pin-drv = <0>;
  };

  spi0_bus: spi0-bus {
   samsung,pins = "gpa2-0", "gpa2-2", "gpa2-3";
   samsung,pin-function = <2>;
   samsung,pin-pud = <3>;
   samsung,pin-drv = <0>;
  };

  spi0_cs: spi0-cs {
   samsung,pins = "gpa2-1";
   samsung,pin-function = <1>;
   samsung,pin-pud = <2>;
   samsung,pin-drv = <0>;
  };

  spi1_bus: spi1-bus {
   samsung,pins = "gpa2-4", "gpa2-6", "gpa2-7";
   samsung,pin-function = <2>;
   samsung,pin-pud = <3>;
   samsung,pin-drv = <0>;
  };

  spi1_cs: spi1-cs {
   samsung,pins = "gpa2-5";
   samsung,pin-function = <1>;
   samsung,pin-pud = <2>;
   samsung,pin-drv = <0>;
  };

  spi2_bus: spi2-bus {
   samsung,pins = "gpb1-1", "gpb1-3", "gpb1-4";
   samsung,pin-function = <5>;
   samsung,pin-pud = <3>;
   samsung,pin-drv = <0>;
  };

  spi2_cs: spi2-cs {
   samsung,pins = "gpb1-2";
   samsung,pin-function = <1>;
   samsung,pin-pud = <2>;
   samsung,pin-drv = <0>;
  };

  fimc_is_ch0_mclk: fimc-is-ch0_mclk {
   samsung,pins = "gph0-5";
   samsung,pin-function = <2>;
   samsung,pin-pud = <0>;
   samsung,pin-drv = <0>;
  };

  fimc_is_ch1_mclk: fimc-is-ch1-mclk {
   samsung,pins = "gph0-6";
   samsung,pin-function = <2>;
   samsung,pin-pud = <0>;
   samsung,pin-drv = <0>;
  };

  fimc_is_ch2_mclk: fimc-is-ch2-mclk {
   samsung,pins = "gph0-7";
   samsung,pin-function = <2>;
   samsung,pin-pud = <0>;
   samsung,pin-drv = <0>;
  };
 };

 pinctrl@03860000 {
  gpz: gpz {
   gpio-controller;
   #gpio-cells = <2>;

   interrupt-controller;
   #interrupt-cells = <2>;
  };

  i2s0_bus: i2s0-bus {
   samsung,pins = "gpz-0", "gpz-1", "gpz-2", "gpz-3",
     "gpz-4", "gpz-5", "gpz-6";
   samsung,pin-function = <2>;
   samsung,pin-pud = <1>;
   samsung,pin-drv = <0>;
  };

  pcm0_bus: pcm0-bus {
   samsung,pins = "gpz-0", "gpz-1", "gpz-2", "gpz-3",
     "gpz-4";
   samsung,pin-function = <3>;
   samsung,pin-pud = <1>;
   samsung,pin-drv = <0>;
  };
 };
};
# 18 "arch/arm/boot/dts/exynos5422_evt0.dtsi" 2

/ {
 compatible = "samsung,exynos5422";
 interrupt-parent = <&gic>;

 aliases {
  pinctrl0 = &pinctrl_0;
  pinctrl1 = &pinctrl_1;
  pinctrl2 = &pinctrl_2;
  pinctrl3 = &pinctrl_3;
  pinctrl4 = &pinctrl_4;
  mshc0 = &dwmmc_0;
  mshc1 = &dwmmc_1;
  mshc2 = &dwmmc_2;
  mfc0 = &mfc_0;
  gsc0 = &gsc_0;
  gsc1 = &gsc_1;
  mdev0 = &mdev_0;
  jpeg0 = &jpeg_0;
  jpeg1 = &jpeg_1;
  spi0 = &spi_0;
  spi1 = &spi_1;
  spi2 = &spi_2;
  spi3 = &spi_3;
  spi4 = &spi_4;
  scaler0 = &scaler_0;
  scaler1 = &scaler_1;
  scaler2 = &scaler_2;
  fimg2d0 = &fimg2d_0;
 };

 cpus {
  #address-cells = <1>;
  #size-cells = <0>;

  cpu0: cpu@0 {
   device_type = "cpu";
   compatible = "arm,cortex-a7";
   reg = <0x100>;
  };
  cpu@1 {
   device_type = "cpu";
   compatible = "arm,cortex-a7";
   reg = <0x101>;
  };
  cpu@2 {
   device_type = "cpu";
   compatible = "arm,cortex-a7";
   reg = <0x102>;
  };
  cpu@3 {
   device_type = "cpu";
   compatible = "arm,cortex-a7";
   reg = <0x103>;
  };
  cpu@4 {
   device_type = "cpu";
   compatible = "arm,cortex-a15";
   reg = <0x0>;
  };
  cpu@5 {
   device_type = "cpu";
   compatible = "arm,cortex-a15";
   reg = <0x1>;
  };
  cpu@6 {
   device_type = "cpu";
   compatible = "arm,cortex-a15";
   reg = <0x2>;
  };
  cpu@7 {
   device_type = "cpu";
   compatible = "arm,cortex-a15";
   reg = <0x3>;
  };
 };

 persistent_clock@101E0000 {
  compatible = "samsung,exynos_persistent_clock";
  reg = <0x101E0000 0x100>;
  clocks = <&clock 1507>;
  clock-names = "gate_rtc";
 };

 watchdog@10020000 {
  compatible = "samsung,s3c2410-wdt";
  reg = <0x101D0000 0x100>;
  interrupts = <0 42 0>;
  clocks = <&clock 1508>, <&clock 1508>;
  clock-names = "rate_watchdog", "gate_watchdog";
  timeout-sec = <30>;
  pmu_wdt_reset_type = <1>;
 };

 firmware@02073000 {
  compatible = "samsung,secure-firmware";
  reg = <0x02073000 0x1000>;
 };

 combiner:interrupt-controller@10440000 {
  samsung,combiner-irqbase = <256>;
 };

 clock: clock-controller@0x10010000 {
  compatible = "samsung,exynos5422-clock";
  reg = <0x10010000 0x30000>;
  #clock-cells = <1>;
 };

 cci {
  compatible = "arm,cci";
  reg = <0x10d20000 0x10000>;
  #address-cells = <1>;
  #size-cells = <0>;
  cci_s@0 {
   device_type = "cci";
   SIF = "SIF0";
   reg = <0x1000>;
  };
  cci_s@1 {
   device_type = "cci";
   SIF = "SIF1";
   reg = <0x2000>;
  };
  cci_s@2 {
   device_type = "cci";
   SIF = "SIF2";
   reg = <0x3000>;
  };
  cci_s@3 {
   device_type = "cci";
   SIF = "KFC";
   reg = <0x4000>;
  };
  cci_s@4 {
   device_type = "cci";
   SIF = "EAGLE";
   reg = <0x5000>;
  };
 };

 coresight {
  compatible = "exynos,coresight";
  reg = <0x10880000 0x8000>;
  #address-cells = <1>;
  #size-cells = <0>;
  css_pc@0 {
   device_type = "cs";
   offset = <0x1F000>;
  };
  css_pc@1 {
   device_type = "cs";
   offset = <0x21000>;
  };
  css_pc@2 {
   device_type = "cs";
   offset = <0x23000>;
  };
  css_pc@3 {
   device_type = "cs";
   offset = <0x25000>;
  };
  css_pc@4 {
   device_type = "cs";
   offset = <0xE000>;
  };
  css_pc@5 {
   device_type = "cs";
   offset = <0x10000>;
  };
  css_pc@6 {
   device_type = "cs";
   offset = <0x12000>;
  };
  css_pc@7 {
   device_type = "cs";
   offset = <0x14000>;
  };
 };

 mct@101C0000 {
  compatible = "samsung,exynos4210-mct";
  reg = <0x101C0000 0x800>;
  interrupt-controller;
  #interrups-cells = <2>;
  interrupt-parent = <&mct_map>;
  interrupts = <0 0>, <1 0>, <2 0>, <3 0>,
        <4 0>, <5 0>, <6 0>, <7 0>,
        <8 0>, <9 0>, <10 0>, <11 0>;
  clocks = <&clock 1>, <&clock 964>;
  clock-names = "fin_pll", "mct";

  mct_map: mct-map {
   #interrupt-cells = <2>;
   #address-cells = <0>;
   #size-cells = <0>;
   interrupt-map = <0 0 &combiner 23 3>,
     <1 0 &combiner 23 4>,
     <2 0 &combiner 25 2>,
     <3 0 &combiner 25 3>,
     <4 0 &gic 0 120 0>,
     <5 0 &gic 0 121 0>,
     <6 0 &gic 0 122 0>,
     <7 0 &gic 0 123 0>,
     <8 0 &gic 0 128 0>,
     <9 0 &gic 0 129 0>,
     <10 0 &gic 0 130 0>,
     <11 0 &gic 0 131 0>;
  };
 };

 clock_pwm: pwm-clock-controller@12dd0000 {
  compatible = "samsung,exynos-pwm-clock";
  reg = <0x12DD0000 0x50>;
  #clock-cells = <1>;
 };

 serial@12C00000 {
  compatible = "samsung,exynos4210-uart";
  reg = <0x12C00000 0x100>;
  irq_affinity = <4>;
  mif_qos_val = <633000>;
  cpu_qos_val = <800000>;
  qos_timeout = <1000000>;
  pinctrl-names = "default";
  pinctrl-0 = <&uart0_bus>;
  clocks = <&clock 1165>, <&clock 1499>;
  clock-names = "sclk_uart0", "gate_uart0";
 };

 serial@12C10000 {
  compatible = "samsung,exynos4210-uart";
  reg = <0x12C10000 0x100>;
  pinctrl-names = "default";
  pinctrl-0 = <&uart1_bus>;
  clocks = <&clock 1164>, <&clock 1498>;
  clock-names = "sclk_uart1", "gate_uart1";
 };

 serial@12C20000 {
  compatible = "samsung,exynos4210-uart";
  reg = <0x12C20000 0x100>;
  pinctrl-names = "default";
  pinctrl-0 = <&uart2_bus>;
  clocks = <&clock 1163>, <&clock 1497>;
  clock-names = "sclk_uart2", "gate_uart2";
 };

 serial@12C30000 {
  compatible = "samsung,exynos4210-uart";
  reg = <0x12C30000 0x100>;
  pinctrl-names = "default";
  pinctrl-0 = <&uart3_bus>;
  clocks = <&clock 1162>, <&clock 1496>;
  clock-names = "sclk_uart3", "gate_uart3";
 };

 pinctrl_0: pinctrl@13400000 {
  compatible = "samsung,exynos5422-pinctrl";
  reg = <0x13400000 0x1000>;
  interrupts = <0 45 0>;

  wakeup-interrupt-controller {
   compatible = "samsung,exynos4210-wakeup-eint";
   interrupts = <0 32 0>;
  };
 };

 pinctrl_1: pinctrl@13410000 {
  compatible = "samsung,exynos5422-pinctrl";
  reg = <0x13410000 0x1000>;
  interrupts = <0 78 0>;
 };

 pinctrl_2: pinctrl@14000000 {
  compatible = "samsung,exynos5422-pinctrl";
  reg = <0x14000000 0x1000>;
  interrupts = <0 46 0>;
 };

 pinctrl_3: pinctrl@14010000 {
  compatible = "samsung,exynos5422-pinctrl";
  reg = <0x14010000 0x1000>;
  interrupts = <0 50 0>;
 };

 pinctrl_4: pinctrl@03860000 {
  compatible = "samsung,exynos5422-pinctrl";
  reg = <0x03860000 0x1000>;
  interrupts = <0 47 0>;
 };

 sysmmu_flite_a: sysmmu@0x13C40000 {
  compatible = "samsung,exynos4210-sysmmu";
  reg = <0x13C40000 0x1000>;
  interrupt-parent = <&combiner>;
  interrupts = <3 4>;
  mmu-masters = <&fimc_is_sensor0>;
  qos = <15>;
  prop-map {
   iomap = "w";
   tlbinv-nonblock = "yes";
  };
 };

 sysmmu_flite_b: sysmmu@0x13C50000 {
  compatible = "samsung,exynos4210-sysmmu";
  reg = <0x13C50000 0x1000>;
  interrupt-parent = <&combiner>;
  interrupts = <24 1>;
  mmu-masters = <&fimc_is_sensor1>;
  qos = <15>;
  prop-map {
   iomap = "w";
   tlbinv-nonblock = "yes";
  };
 };

 sysmmu_flite_d: sysmmu@0x13D50000 {
  compatible = "samsung,exynos4210-sysmmu";
  reg = <0x13D50000 0x1000>;
  interrupt-parent = <&combiner>;
  interrupts = <2 4>;
  mmu-masters = <&fimc_is>;
  qos = <15>;
  prop-map {
   iomap = "w";
   tlbinv-nonblock = "yes";
  };
 };

 sysmmu_3aa: sysmmu@0x13CC0000 {
  compatible = "samsung,exynos4210-sysmmu";
  reg = <0x13CC0000 0x1000>;
  interrupt-parent = <&combiner>;
  interrupts = <23 6>;
  mmu-masters = <&fimc_is>;
 };

 sysmmu_3aa_2: sysmmu@0x13CB0000 {
  compatible = "samsung,exynos4210-sysmmu";
  reg = <0x13CB0000 0x1000>;
  interrupts = <0 172 0>;
  mmu-masters = <&fimc_is>;
 };

 sysmmu_g2d: sysmmu@0x10A60000 {
  compatible = "samsung,exynos4210-sysmmu";
  reg = <0x10A60000 0x1000>;
  interrupt-parent = <&combiner>;
  interrupts = <24 5>;
  clock-names = "sysmmu", "master";
  clocks = <&clock 231>, <&clock 234>;
  mmu-masters = <&fimg2d_0>;
  prop-map {
   iomap = "r";
  };
 };

 sysmmu_g2d_wr: sysmmu@0x10A70000 {
  compatible = "samsung,exynos4210-sysmmu";
  reg = <0x10A70000 0x1000>;
  interrupt-parent = <&combiner>;
  interrupts = <22 2>;
  clock-names = "sysmmu", "master";
  clocks = <&clock 231>, <&clock 234>;
  mmu-masters = <&fimg2d_0>;
  prop-map {
   iomap = "w";
  };
 };

 sysmmu_tv: sysmmu@0x14650000 {
  compatible = "samsung,exynos4210-sysmmu";
  reg = <0x14650000 0x1000>;
  interrupt-parent = <&combiner>;
  interrupts = <7 4>;
  clock-names = "sysmmu", "master";
  clocks = <&clock 1320>, <&clock 1324>;
  mmu-masters = <&mixer>;
  qos = <15>;
 };

 sysmmu_gscl0: sysmmu@0x13E80000 {
  compatible = "samsung,exynos4210-sysmmu";
  reg = <0x13E80000 0x1000>;
  interrupt-parent = <&combiner>;
  interrupts = <2 0>;
  mmu-masters = <&gsc_0>;
 };

 sysmmu_gscl1: sysmmu@0x13E90000 {
  compatible = "samsung,exynos4210-sysmmu";
  reg = <0x13E90000 0x1000>;
  interrupt-parent = <&combiner>;
  interrupts = <2 2>;
  mmu-masters = <&gsc_1>;
 };

 sysmmu_fimc_fd: sysmmu@0x132A0000 {
  compatible = "samsung,exynos4210-sysmmu";
  reg = <0x132A0000 0x1000>;
  interrupt-parent = <&combiner>;
  interrupts = <5 0>;
  clock-names = "sysmmu", "master";
  clocks = <&clock 404>, <&clock 411>;
  mmu-masters = <&fimc_is>;
 };

 sysmmu_fimc_cpu: sysmmu@0x132B0000 {
  compatible = "samsung,exynos4210-sysmmu";
  reg = <0x132B0000 0x1000>;
  interrupt-parent = <&combiner>;
  interrupts = <5 4>;
  clock-names = "sysmmu", "master";
  clocks = <&clock 401>, <&clock 408>;
  mmu-masters = <&fimc_is>;
 };

 sysmmu_fimc_isp: sysmmu@0x13260000 {
  compatible = "samsung,exynos4210-sysmmu";
  reg = <0x13260000 0x1000>;
  interrupt-parent = <&combiner>;
  interrupts = <10 6>;
  clock-names = "sysmmu", "master";
  clocks = <&clock 406>, <&clock 413>;
  mmu-masters = <&fimc_is>;
 };

 sysmmu_fimc_drc: sysmmu@0x13270000 {
  compatible = "samsung,exynos4210-sysmmu";
  reg = <0x13270000 0x1000>;
  interrupt-parent = <&combiner>;
  interrupts = <4 6>;
  clock-names = "sysmmu", "master";
  clocks = <&clock 405>, <&clock 412>;
  mmu-masters = <&fimc_is>;
 };

 sysmmu_fimc_scc: sysmmu@0x13280000 {
  compatible = "samsung,exynos4210-sysmmu";
  reg = <0x13280000 0x1000>;
  interrupt-parent = <&combiner>;
  interrupts = <5 2>;
  clock-names = "sysmmu", "master";
  clocks = <&clock 403>, <&clock 410>;
  mmu-masters = <&fimc_is>;
 };

 sysmmu_fimc_scp: sysmmu@0x13290000 {
  compatible = "samsung,exynos4210-sysmmu";
  reg = <0x13290000 0x1000>;
  interrupt-parent = <&combiner>;
  interrupts = <3 6>;
  clock-names = "sysmmu", "master";
  clocks = <&clock 402>, <&clock 409>;
  mmu-masters = <&fimc_is>;
 };

 sysmmu_fimc_3dnr: sysmmu@0x132F0000 {
  compatible = "samsung,exynos4210-sysmmu";
  reg = <0x132F0000 0x1000>;
  interrupt-parent = <&combiner>;
  interrupts = <5 6>;
  clock-names = "sysmmu", "master";
  clocks = <&clock 426>, <&clock 429>;
  mmu-masters = <&fimc_is>;
 };

 sysmmu_scaler0r: sysmmu@0x12880000 {
  compatible = "samsung,exynos4210-sysmmu";
  reg = <0x12880000 0x1000>;
  interrupt-parent = <&combiner>;
  interrupts = <22 4>;
  clock-names = "sysmmu", "master";
  clocks = <&clock 1542>, <&clock 1550>;
  mmu-masters = <&scaler_0>;
  prop-map {
   iomap = "r";
  };
 };

 sysmmu_scaler1r: sysmmu@0x12890000 {
  compatible = "samsung,exynos4210-sysmmu";
  reg = <0x12890000 0x1000>;
  interrupts = <0 186 0>;
  clock-names = "sysmmu", "master";
  clocks = <&clock 1541>, <&clock 1549>;
  mmu-masters = <&scaler_1>;
  prop-map {
   iomap = "r";
  };
 };

 sysmmu_scaler2r: sysmmu@0x128A0000 {
  compatible = "samsung,exynos4210-sysmmu";
  reg = <0x128A0000 0x1000>;
  interrupts = <0 188 0>;
  clock-names = "sysmmu", "master";
  clocks = <&clock 1540>, <&clock 1548>;
  mmu-masters = <&scaler_2>;
  prop-map {
   iomap = "r";
  };
 };

 sysmmu_scaler0w: sysmmu@0x128C0000 {
  compatible = "samsung,exynos4210-sysmmu";
  reg = <0x128C0000 0x1000>;
  interrupt-parent = <&combiner>;
  interrupts = <27 2>;
  clock-names = "sysmmu", "master";
  clocks = <&clock 1542>, <&clock 1550>;
  mmu-masters = <&scaler_0>;
  prop-map {
   iomap = "w";
  };
 };

 sysmmu_scaler1w: sysmmu@0x128D0000 {
  compatible = "samsung,exynos4210-sysmmu";
  reg = <0x128D0000 0x1000>;
  interrupt-parent = <&combiner>;
  interrupts = <22 6>;
  clock-names = "sysmmu", "master";
  clocks = <&clock 1541>, <&clock 1549>;
  mmu-masters = <&scaler_1>;
  prop-map {
   iomap = "w";
  };
 };

 sysmmu_scaler2w: sysmmu@0x128E0000 {
  compatible = "samsung,exynos4210-sysmmu";
  reg = <0x128E0000 0x1000>;
  interrupt-parent = <&combiner>;
  interrupts = <19 6>;
  clock-names = "sysmmu", "master";
  clocks = <&clock 1540>, <&clock 1548>;
  mmu-masters = <&scaler_2>;
  prop-map {
   iomap = "w";
  };
 };

 sysmmu_jpeg: sysmmu@0x11F10000 {
  compatible = "samsung,exynos4210-sysmmu";
  reg = <0x11F10000 0x1000>;
  interrupt-parent = <&combiner>;
  interrupts = <4 2>;
  clock-names = "sysmmu", "master";
  clocks = <&clock 1413>, <&clock 1418>;
  mmu-masters = <&jpeg_0>;
 };

 sysmmu_jpeg2: sysmmu@0x11F20000 {
  compatible = "samsung,exynos4210-sysmmu";
  reg = <0x11F20000 0x1000>;
  interrupts = <0 169 0>;
  clock-names = "sysmmu", "master";
  clocks = <&clock 1413>, <&clock 1417>;
  mmu-masters = <&jpeg_1>;
 };

 sysmmu_mfc0_0: sysmmu@0x11200000 {
  compatible = "samsung,exynos4210-sysmmu";
  reg = <0x11200000 0x1000>;
  interrupt-parent = <&combiner>;
  interrupts = <6 2>;
  clock-names = "sysmmu", "master";
  clocks = <&clock 1349>, <&clock 1350>;
  mmu-masters = <&mfc_0>;
 };

 sysmmu_mfc0_1: sysmmu@0x11210000 {
  compatible = "samsung,exynos4210-sysmmu";
  reg = <0x11210000 0x1000>;
  interrupt-parent = <&combiner>;
  interrupts = <8 5>;
  clock-names = "sysmmu", "master";
  clocks = <&clock 1348>, <&clock 1350>;
  mmu-masters = <&mfc_0>;
 };

 sysmmu_fimd0x: sysmmu@0x14640000 {
  compatible = "samsung,exynos4210-sysmmu";
  reg = <0x14640000 0x1000>;
  interrupt-parent = <&combiner>;
  interrupts = <3 2>;
  clock-names = "sysmmu", "master";
  clocks = <&clock 1322>, <&clock 1329>;
  qos = <15>;
  mmu-masters = <&fimd_fb>;
  prop-map {
   winmap = <0x11>;
  };
 };

 sysmmu_fimd1x: sysmmu@0x14680000 {
  compatible = "samsung,exynos4210-sysmmu";
  reg = <0x14680000 0x1000>;
  interrupt-parent = <&combiner>;
  interrupts = <3 0>;
  clock-names = "sysmmu", "master";
  clocks = <&clock 1321>, <&clock 1329>;
  qos = <15>;
  mmu-masters = <&fimd_fb>;
  prop-map {
   winmap = <0xe>;
  };
 };


 fimd_fb: fimd_fb {
  compatible = "samsung,exynos5-disp_driver";
  reg = <0x14400000 0x40000>, <0x14500000 0x8000>, <0x145A0000 0x48>;
  samsung,power-domain = <&spd_fimd>;
  interrupt-controller;
  #interrups-cells = <2>;
  interrupt-parent = <&fimd_fb_int_map>;
  interrupts = <0 0>, <1 0>, <2 0>, <3 0>;







  clocks = <&clock 1329>, <&clock 2104>, <&clock 1061>,
    <&clock 2004>, <&clock 2107>, <&clock 2078>,
    <&clock 2068>, <&clock 4016>, <&clock 2054>,
    <&clock 2002>, <&clock 2083>, <&clock 2073>,
    <&clock 4021>, <&clock 2059>, <&clock 601>,
    <&clock 1326>, <&clock 4103>, <&clock 2008>;

  clock-names = "clk_fimd1", "mout_fimd1", "sclk_fimd1",
     "mout_rpll_ctrl", "mout_fimd1_mdnie1", "mout_aclk_300_disp1_user",
     "mout_aclk_300_disp1_sw", "dout_aclk_300_disp1", "mout_aclk_300_disp1",
     "mout_dpll_ctrl", "mout_aclk_400_disp1_user", "mout_aclk_400_disp1_sw",
     "dout_aclk_400_disp1", "mout_aclk_400_disp1", "aclk_axi_disp1x",
     "clk_dsim1", "dout_fimd1", "mout_mpll_ctrl";

  fimd_fb_int_map: fimd_fb_int_map {
   #interrupt-cells = <2>;
   #address-cells = <0>;
   #size-cells = <0>;
   interrupt-map = <0 0 &combiner 18 5>,
     <1 0 &combiner 18 4>,
     <2 0 &combiner 18 6>,
     <3 0 &gic 0 82 0>;
  };

  fimd: fimd_ctrl {
   samsung,vidcon0 = <0x8000>;
   samsung,vidcon1 = <0x80>;
   samsung,default_win = <0>;
   fb_driver_data {
     fb_variant {
       nr_windows = <5>;
       vidcon1 = <0x20004>;
       vidtcon = <0x20010>;
       wincon = <0x20>;
       winmap = <0x180>;
       keycon = <0x140>;
       osd = <0x40>;
       osd_stride = <16>;
       buf_start = <0xA0>;
       buf_size = <0x100>;
       buf_end = <0xD0>;
       palette_0 = <0x2400>;
       palette_1 = <0x2800>;
       palette_2 = <0x2c00>;
       palette_3 = <0x3000>;
       palette_4 = <0x3400>;
       has_shadowcon = <1>;
       has_blendcon = <1>;
       has_alphacon = <1>;
       has_fixvclk = <1>;
     };
    };
   };
  };

 dwmmc_0: dwmmc0@12200000 {
  compatible = "samsung,exynos5422-dw-mshc";
  reg = <0x12200000 0x2000>;
  interrupts = <0 75 0>;
  #address-cells = <1>;
  #size-cells = <0>;
  clocks = <&clock 746>, <&clock 1126>, <&clock 4110>;
  clock-names = "biu", "gate_ciu", "dout_mmc_a";
  status = "disabled";
 };
 dwmmc_1: dwmmc1@12210000 {
  compatible = "samsung,exynos5422-dw-mshc";
  reg = <0x12210000 0x2000>;
  interrupts = <0 76 0>;
  #address-cells = <1>;
  #size-cells = <0>;
  clocks = <&clock 745>, <&clock 1125>, <&clock 4111>;
  clock-names = "biu", "gate_ciu", "dout_mmc_a";
  status = "disabled";
 };

 dwmmc_2: dwmmc2@12220000 {
  compatible = "samsung,exynos5422-dw-mshc";
  reg = <0x12220000 0x2000>;
  interrupts = <0 77 0>;
  #address-cells = <1>;
  #size-cells = <0>;
  clocks = <&clock 744>, <&clock 1124>, <&clock 4112>;
  clock-names = "biu", "gate_ciu", "dout_mmc_a";
  status = "disabled";
 };

 i2c_0: i2c@12C60000 {
  compatible = "samsung,s3c2440-i2c";
  reg = <0x12C60000 0x1000>;
  interrupts = <0 56 0>;
  #address-cells = <1>;
  #size-cells = <0>;
  pinctrl-names = "default";
  pinctrl-0 = <&i2c0_bus>;
  clocks = <&clock 1494>, <&clock 1494>;
  clock-names = "rate_i2c", "gate_i2c";
  status = "disabled";
 };

 i2c_1: i2c@12C70000 {
  compatible = "samsung,s3c2440-i2c";
  reg = <0x12C70000 0x1000>;
  interrupts = <0 57 0>;
  #address-cells = <1>;
  #size-cells = <0>;
  pinctrl-names = "default";
  pinctrl-0 = <&i2c1_bus>;
  clocks = <&clock 1493>, <&clock 1493>;
  clock-names = "rate_i2c", "gate_i2c";
  status = "disabled";
 };

 i2c_2: i2c@12C80000 {
  compatible = "samsung,s3c2440-i2c";
  reg = <0x12C80000 0x1000>;
  interrupts = <0 58 0>;
  #address-cells = <1>;
  #size-cells = <0>;
  pinctrl-names = "default";
  pinctrl-0 = <&i2c2_bus>;
  clocks = <&clock 1492>, <&clock 1492>;
  clock-names = "rate_i2c", "gate_i2c";
  status = "disabled";
 };

 i2c_3: i2c@12C90000 {
  compatible = "samsung,s3c2440-i2c";
  reg = <0x12C90000 0x1000>;
  interrupts = <0 59 0>;
  #address-cells = <1>;
  #size-cells = <0>;
  pinctrl-names = "default";
  pinctrl-0 = <&i2c3_bus>;
  clocks = <&clock 1491>, <&clock 1491>;
  clock-names = "rate_i2c", "gate_i2c";
  status = "disabled";
 };

 hsi2c_0: hsi2c@12CA0000 {
  compatible = "samsung,exynos5-hsi2c";
  samsung,polling-mode;
  reg = <0x12CA0000 0x1000>;
  interrupts = <0 60 0>;
  #address-cells = <1>;
  #size-cells = <0>;
  pinctrl-names = "default";
  pinctrl-0 = <&hs_i2c0_bus>;
  clocks = <&clock 1490>, <&clock 1490>;
  clock-names = "rate_hsi2c", "gate_hsi2c";
  status = "disabled";
 };

 hsi2c_1: hsi2c@12CB0000 {
  compatible = "samsung,exynos5-hsi2c";
  samsung,polling-mode;
  reg = <0x12CB0000 0x1000>;
  interrupts = <0 61 0>;
  #address-cells = <1>;
  #size-cells = <0>;
  pinctrl-names = "default";
  pinctrl-0 = <&hs_i2c1_bus>;
  clocks = <&clock 1489>, <&clock 1489>;
  clock-names = "rate_hsi2c", "gate_hsi2c";
  status = "disabled";
 };

 hsi2c_2: hsi2c@12CC0000 {
  compatible = "samsung,exynos5-hsi2c";
  samsung,polling-mode;
  reg = <0x12CC0000 0x1000>;
  interrupts = <0 62 0>;
  #address-cells = <1>;
  #size-cells = <0>;
  pinctrl-names = "default";
  pinctrl-0 = <&hs_i2c2_bus>;
  clocks = <&clock 1488>, <&clock 1488>;
  clock-names = "rate_hsi2c", "gate_hsi2c";
  status = "disabled";
 };

 hsi2c_3: hsi2c@12CD0000 {
  compatible = "samsung,exynos5-hsi2c";
  samsung,polling-mode;
  reg = <0x12CD0000 0x1000>;
  interrupts = <0 63 0>;
  #address-cells = <1>;
  #size-cells = <0>;
  pinctrl-names = "default";
  pinctrl-0 = <&hs_i2c3_bus>;
  clocks = <&clock 1487>, <&clock 1487>;
  clock-names = "rate_hsi2c", "gate_hsi2c";
  status = "disabled";
 };

 hsi2c_4: hsi2c@12E00000 {
  compatible = "samsung,exynos5-hsi2c";
  samsung,polling-mode;
  reg = <0x12E00000 0x1000>;
  interrupts = <0 87 0>;
  #address-cells = <1>;
  #size-cells = <0>;
  pinctrl-names = "default";
  pinctrl-0 = <&hs_i2c4_bus>;
  clocks = <&clock 1475>, <&clock 1475>;
  clock-names = "rate_hsi2c", "gate_hsi2c";
  status = "disabled";
 };

 hsi2c_5: hsi2c@12E10000 {
  compatible = "samsung,exynos5-hsi2c";
  samsung,polling-mode;
  reg = <0x12E10000 0x1000>;
  interrupts = <0 88 0>;
  #address-cells = <1>;
  #size-cells = <0>;
  pinctrl-names = "default";
  pinctrl-0 = <&hs_i2c5_bus>;
  clocks = <&clock 1473>, <&clock 1473>;
  clock-names = "rate_hsi2c", "gate_hsi2c";
  status = "disabled";
 };

 hsi2c_6: hsi2c@12E20000 {
  compatible = "samsung,exynos5-hsi2c";
  samsung,polling-mode;
  reg = <0x12E20000 0x1000>;
  interrupts = <0 203 0>;
  #address-cells = <1>;
  #size-cells = <0>;
  pinctrl-names = "default";
  pinctrl-0 = <&hs_i2c6_bus>;
  clocks = <&clock 1472>, <&clock 1472>;
  clock-names = "rate_hsi2c", "gate_hsi2c";
  status = "disabled";
 };

 mali {
  compatible = "arm,mali";
  reg = <0x11800000 0x5000>;
  interrupts = <0 219 0>, <0 74 0>, <0 117 0>;
  clocks = <&clock 10>, <&clock 2007>, <&clock 2002>,
   <&clock 2056>, <&clock 4018>, <&clock 2070>,
   <&clock 2080>, <&clock 1376>, <&clock 1>,
   <&clock 2136>;
  clock-names = "fout_vpll", "mout_vpll_ctrl", "mout_dpll_ctrl",
   "mout_aclk_g3d", "dout_aclk_g3d", "mout_aclk_g3d_sw",
   "mout_aclk_g3d_user", "clk_g3d_ip", "fin_pll",
   "armclk";
  samsung,power-domain = <&pd_g3d>;
 };


 amba {
  #address-cells = <1>;
  #size-cells = <1>;
  compatible = "arm,amba-bus";
  interrupt-parent = <&gic>;
  interrupt-cells = <3>;
  ranges;

  mdma0: mdma@10800000 {
   compatible = "arm,pl330", "arm,primecell";
   reg = <0x10800000 0x1000>;
   interrupts = <0 33 0>;
   clocks = <&clock 236>;
   clock-names = "apb_pclk";
   #dma-cells = <1>;
   #dma-channels = <8>;
   #dma-requests = <1>;
  };

  pdma0: pdma@121A0000{
   compatible = "arm,pl330", "arm,primecell";
   reg = <0x121A0000 0x1000>;
   interrupts = <0 34 0>;
   clocks = <&clock 755>;
   clock-names = "apb_pclk";
   #dma-cells = <1>;
   #dma-channels = <8>;
   #dma-requests = <32>;
  };

  pdma1: pdma@121B0000{
   compatible = "arm,pl330", "arm,primecell";
   reg = <0x121B0000 0x1000>;
   interrupts = <0 35 0>;
   clocks = <&clock 754>;
   clock-names = "apb_pclk";
   #dma-cells = <1>;
   #dma-channels = <8>;
   #dma-requests = <32>;
   #dma-secure-mode = <1>;
  };

  adma: adma@03880000 {
   compatible = "arm,pl330", "arm,primecell";
   reg = <0x03880000 0x1000>;
   interrupts = <0 110 0>;
   clocks = <&clock 1089>;
   clock-names = "apb_pclk";
   #dma-cells = <1>;
   #dma-channels = <6>;
   #dma-requests = <16>;
   #dma-mcode-addr = <0x03027000>;
  };
 };

 ehci: usb@12110000 {
  compatible = "samsung,exynos5-ehci";
  reg = <0x12110000 0x100>;
  interrupts = <0 71 0>;
  clocks = <&clock 1449>;
  clock-names = "usbhost";
  status = "ok";
  l2-retention = <0>;
  usb-phy = <&usb2_phy>;
 };

 ohci: usb@12120000 {
  compatible = "samsung,exynos5-ohci";
  reg = <0x12120000 0x100>;
  interrupts = <0 71 0>;
  clocks = <&clock 1449>;
  clock-names = "usbhost";
  status = "ok";
  usb-phy = <&usb2_phy>;
 };

 usb2_phy: usb2phy@12130000 {
  compatible = "samsung,exynos5-usb2phy";
  reg = <0x12130000 0x100>;
  clocks = <&clock 1>, <&clock 1449>;
  clock-names = "ext_xtal", "usbhost";
  #address-cells = <1>;
  #size-cells = <1>;
  ranges;

  usbphy-sys {
   reg = <0x10040704 0xC>;
  };
 };

 usb@12000000 {
  compatible = "samsung,exynos5-dwusb3";
  clocks = <&clock 1448>;
  clock-names = "usbdrd30";
  #address-cells = <1>;
  #size-cells = <1>;
  ranges;
  status = "disabled";

  dwc3 {
   compatible = "synopsys,dwc3";
   reg = <0x12000000 0x10000>;
   interrupts = <0 72 0>;
   usb-phy = <&dwc3_usb2_phy_0 &dwc3_usb3_phy_0>;
  };
 };

 usb@12400000 {
  compatible = "samsung,exynos5-dwusb3";
  clocks = <&clock 1447>;
  clock-names = "usbdrd30";
  #address-cells = <1>;
  #size-cells = <1>;
  ranges;
  status = "disabled";

  dwc3 {
   compatible = "synopsys,dwc3";
   reg = <0x12400000 0x10000>;
   interrupts = <0 73 0>;
   usb-phy = <&dwc3_usb2_phy_1 &dwc3_usb3_phy_1>;
  };
 };

 usb-switch {
  compatible = "samsung,exynos-usb-switch";
  ehci = <&ehci>;
  ohci = <&ohci>;
 };

 exynos_adc: adc@12D10000 {
  compatible = "samsung,exynos-adc-v2";
  reg = <0x12D10000 0x100>;
  interrupts = <0 106 0>;
  #io-channel-cells = <1>;
  io-channel-ranges;
  clocks = <&clock 1485>;
  clock-names = "gate_adcif";
 };

 dwc3_usb2_phy_0: usbphy@0 {
  compatible = "samsung,exynos5-usb2phy-dummy";
 };

 dwc3_usb2_phy_1: usbphy@1 {
  compatible = "samsung,exynos5-usb2phy-dummy";
 };

 dwc3_usb3_phy_0: usbphy@12100000 {
  compatible = "samsung,exynos5420-usb3phy";
  reg = <0x12100000 0x100>;
  clocks = <&clock 1>, <&clock 1448>;
  clock-names = "ext_xtal", "usbdrd30";
  #address-cells = <1>;
  #size-cells = <1>;
  ranges;

  usbphy-sys {
   reg = <0x10040704 0x4>;
  };
 };

 dwc3_usb3_phy_1: usbphy@12500000 {
  compatible = "samsung,exynos5420-usb3phy";
  reg = <0x12500000 0x100>;
  clocks = <&clock 1>, <&clock 1447>;
  clock-names = "ext_xtal", "usbdrd30";
  #address-cells = <1>;
  #size-cells = <1>;
  ranges;

  usbphy-sys {
   reg = <0x10040708 0x4>;
  };
 };

 spi_0: spi@12d20000 {
  compatible = "samsung,exynos5410-spi";
  reg = <0x12d20000 0x100>;
                interrupts = <0 68 0>;
                dma-mode;
                dmas = <&pdma0 5
                        &pdma0 4>;
                dma-names = "tx", "rx";
                swap-mode;
                #address-cells = <1>;
                #size-cells = <0>;
                clocks = <&clock 1484>, <&clock 4134>;
                clock-names = "spi", "spi_busclk0";
                pinctrl-names = "default";
                pinctrl-0 = <&spi0_bus>;
 };

 spi_1: spi@12d30000 {
  compatible = "samsung,exynos5410-spi";
                reg = <0x12d30000 0x100>;
                interrupts = <0 69 0>;
                dma-mode;
                dmas = <&pdma1 5
                        &pdma1 4>;
                dma-names = "tx", "rx";
                swap-mode;
                #address-cells = <1>;
                #size-cells = <0>;
                clocks = <&clock 1483>, <&clock 4135>;
                clock-names = "spi", "spi_busclk0";
                pinctrl-names = "default";
                pinctrl-0 = <&spi1_bus>;
 };

 spi_2: spi@12d40000 {
                compatible = "samsung,exynos5410-spi";
                reg = <0x12d40000 0x100>;
                interrupts = <0 70 0>;
                dmas = <&pdma0 7
                        &pdma0 6>;
                dma-names = "tx", "rx";
                swap-mode;
                #address-cells = <1>;
                #size-cells = <0>;
                clocks = <&clock 1482>, <&clock 4136>;
                clock-names = "spi", "spi_busclk0";
                pinctrl-names = "default";
                pinctrl-0 = <&spi2_bus>;
 };

 mfc_0: mfc@11000000 {
  compatible = "samsung,mfc-v6";
  reg = <0x11000000 0x10000>;
  interrupts = <0 96 0>;
  clock-names = "mfc", "aclk_333", "mout_aclk_333_user", "gate_ip_mfc", "mout_aclk_333_sw", "dout_aclk_333";
  clocks = <&clock 1350>, <&clock 486>, <&clock 2041>, <&clock 1234>, <&clock 2034>, <&clock 4008>;
  samsung,power-domain = <&pd_mfc0>;
  status = "ok";
  ip_ver = <10>;
  clock_rate = <400000000>;
  min_rate = <100000>;
  num_qos_steps = <5>;
  mfc_qos_table {
   mfc_qos_variant_0 {
    thrd_mb = <0>;
    freq_mfc = <96000>;
    freq_int = <83000>;
    freq_mif = <165000>;
    freq_cpu = <0>;
    freq_kfc = <0>;
   };
   mfc_qos_variant_1 {
    thrd_mb = <108000>;
    freq_mfc = <111000>;
    freq_int = <111000>;
    freq_mif = <206000>;
    freq_cpu = <0>;
    freq_kfc = <0>;
   };
   mfc_qos_variant_2 {
    thrd_mb = <244800>;
    freq_mfc = <167000>;
    freq_int = <222000>;
    freq_mif = <275000>;
    freq_cpu = <0>;
    freq_kfc = <400000>;
   };
   mfc_qos_variant_3 {
    thrd_mb = <367200>;
    freq_mfc = <222000>;
    freq_int = <333000>;
    freq_mif = <413000>;
    freq_cpu = <0>;
    freq_kfc = <400000>;
   };
   mfc_qos_variant_4 {
    thrd_mb = <489600>;
    freq_mfc = <400000>;
    freq_int = <420000>;
    freq_mif = <413000>;
    freq_cpu = <0>;
    freq_kfc = <400000>;
   };
   mfc_qos_extra_var_0 {
    thrd_mb = <0xFFFFFFFF>;
   };
   mfc_qos_extra_var_1 {
    thrd_mb = <0xFFFFFFFF>;
   };
   mfc_qos_extra_var_2 {
    thrd_mb = <0xFFFFFFFF>;
   };
   mfc_qos_extra_var_3 {
    thrd_mb = <0xFFFFFFFF>;
   };
   mfc_qos_extra_var_4 {
    thrd_mb = <489600>;
    freq_mfc = <400000>;
    freq_int = <420000>;
    freq_mif = <825000>;
    freq_cpu = <0>;
    freq_kfc = <400000>;
   };
  };
 };

 sec_pwm: pwm@12dd0000 {
  compatible = "samsung,s3c6400-pwm";
  reg = <0x12dd0000 0x1000>;
  #pwm-cells = <3>;
  clocks = <&clock 1477>,
         <&clock_pwm 1>, <&clock_pwm 2>,
         <&clock_pwm 5>, <&clock_pwm 6>,
         <&clock_pwm 7>, <&clock_pwm 8>,
         <&clock_pwm 10>, <&clock_pwm 11>,
         <&clock_pwm 12>, <&clock_pwm 13>;
  clock-names = "gate_timers",
   "pwm-scaler0", "pwm-scaler1",
   "pwm-tdiv0", "pwm-tdiv1",
   "pwm-tdiv2", "pwm-tdiv3",
   "pwm-tin0", "pwm-tin1",
   "pwm-tin2", "pwm-tin3";
  status = "ok";
 };

 tmu@10060000 {
  compatible = "samsung,exynos5422-tmu";
  reg = <0x10060000 0x100>,
   <0x10064000 0x100>,
   <0x10068000 0x100>,
   <0x1006c000 0x100>,
   <0x100a0000 0x100>;
  interrupts = <0 65 0>,
      <0 183 0>,
      <0 184 0>,
      <0 185 0>,
      <0 215 0>;
  clocks = <&clock 468>,
   <&clock 468>,
   <&clock 468>,
   <&clock 468>,
   <&clock 469>;
  clock-names = "tmu", "tmu", "tmu", "tmu", "tmu_gpu";
 };

 mdev_0: mdev_output {
  compatible = "samsung,exynos5-mdev";
 };

 gsc_0: gsc@13E00000 {
  compatible = "samsung,exynos5-gsc";
  reg = <0x13E00000 0x1000>;
  interrupts = <0 85 0>;
  clocks = <&clock 1264>, <&clock 494>, <&clock 2077>;
  clock-names = "gscl", "aclk_300_gscl", "aclk_300_gscl_sw";
  samsung,power-domain = <&spd_gscl0>;
  ip_ver = <1>;
  mif_min = <160000>;
  int_min = <83000>;
 };

 gsc_1: gsc@0x13E10000 {
  compatible = "samsung,exynos5-gsc";
  reg = <0x13E10000 0x1000>;
  interrupts = <0 86 0>;
  clocks = <&clock 1263>, <&clock 494>, <&clock 2077>;
  clock-names = "gscl", "aclk_300_gscl", "aclk_300_gscl_sw";
  samsung,power-domain = <&spd_gscl1>;
  ip_ver = <1>;
  mif_min = <160000>;
  int_min = <83000>;
 };

 jpeg_0: jpeg@11F50000 {
  compatible = "samsung,jpeg-hx2";
  reg = <0x11F50000 0x1000>;
  interrupts = <0 89 0>;
  clock-names = "jpeg", "aclk_300_jpeg", "aclk_300_jpeg_user";
  clocks = <&clock 1418>, <&clock 496>, <&clock 2079>;
  ip_ver = <3>;
  samsung,power-domain = <&spd_jpeg1>;
 };

 jpeg_1: jpeg@11F60000 {
  compatible = "samsung,jpeg-hx2";
  reg = <0x11F60000 0x1000>;
  interrupts = <0 168 0>;
  clock-names = "jpeg", "aclk_300_jpeg", "aclk_300_jpeg_user";
  clocks = <&clock 1417>, <&clock 496>, <&clock 2079>;
  ip_ver = <3>;
  samsung,power-domain = <&spd_jpeg2>;
 };

 scaler_0: scaler@12800000 {
  compatible = "samsung,exynos5-scaler";
  reg = <0x12800000 0x1300>;
  interrupts = <0 220 0>;
  clocks = <&clock 1550>;
  clock-names = "gate";
  samsung,power-domain = <&spd_mscl0>;
 };

 scaler_1: scaler@12810000 {
  compatible = "samsung,exynos5-scaler";
  reg = <0x12810000 0x1300>;
  interrupts = <0 221 0>;
  clocks = <&clock 1549>;
  clock-names = "gate";
  samsung,power-domain = <&spd_mscl1>;
 };

 scaler_2: scaler@12820000 {
  compatible = "samsung,exynos5-scaler";
  reg = <0x12820000 0x1300>;
  interrupts = <0 222 0>;
  clocks = <&clock 1548>;
  clock-names = "gate";
  samsung,power-domain = <&spd_mscl2>;
 };

 fimg2d_0: fimg2d@10850000 {
    compatible = "samsung,s5p-fimg2d";
    reg = <0x10850000 0x1000>;
    interrupts = <0 91 0>;
    clocks = <&clock 234>, <&clock 228>;
    clock-names = "clk_g2d", "clk_qeg2d";
    ip_ver = <7>;
    samsung,power-domain = <&pd_g2d>;
    g2d_qos_table {
     g2d_qos_variant_0 {
      freq_int = <400000>;
      freq_mif = <825000>;
      freq_cpu = <1900000>;
      freq_kfc = <1500000>;
     };
     g2d_qos_variant_1 {
      freq_int = <400000>;
      freq_mif = <633000>;
      freq_cpu = <0>;
      freq_kfc = <800000>;
     };
     g2d_qos_variant_2 {
      freq_int = <333000>;
      freq_mif = <543000>;
      freq_cpu = <0>;
      freq_kfc = <800000>;
     };
     g2d_qos_variant_3 {
      freq_int = <222000>;
      freq_mif = <413000>;
      freq_cpu = <0>;
      freq_kfc = <800000>;
     };
     g2d_qos_variant_4 {
      freq_int = <222000>;
      freq_mif = <275000>;
      freq_cpu = <0>;
      freq_kfc = <800000>;
     };
    };
 };

 lpass: lpass@03810000 {
  compatible = "samsung,exynos5-audss";
  reg = <0x03810000 0x100>,
        <0x03000000 0x49000>;
  clocks = <&clock 1722>,
    <&clock 1723>,
    <&clock 1725>,
    <&clock 1730>,
    <&clock 5>,
    <&clock 2002>,
    <&clock 2060>,
    <&clock 5316>,
    <&clock 2200>,
    <&clock 2201>,
    <&clock 1>;
  clock-names = "dmac", "timer", "gpio", "srp", "fout_dpll",
   "mout_dpll_ctrl", "mout_mau_epll_clk",
   "mout_mau_epll_clk_user", "mout_ass_clk",
   "mout_ass_i2s", "fin_pll";
  samsung,power-domain = <&pd_maudio>;
  status = "ok";
 };

 i2s0: i2s@03830000 {
  compatible = "samsung,i2s-v5";
  reg = <0x03830000 0x100>;
  dmas = <&adma 0 &adma 2>;
  dma-names = "tx", "rx";
  interrupts = <0 115 0>;
  clocks = <&clock 1728>,
    <&clock 4182>,
    <&clock 4183>;
  clock-names = "iis", "i2s_opclk0", "i2s_opclk1";
  samsung,supports-6ch;
  samsung,supports-rstclr;
  samsung,supports-secdai;
  samsung,supports-tdm;
  samsung,lpass-subip;
  pinctrl-names = "default", "idle";
  pinctrl-0 = <&i2s0_bus>;
  pinctrl-1 = <&pcm0_bus>;
  status = "disabled";
  i2s-sec {
   dmas = <&adma 1>;
   dma-names = "tx-sec";
   samsung,tx-buf = <0x03000000>;
   samsung,tx-size = <0x20000>;
  };
 };

 pcm0: pcm@03840000 {
  compatible = "samsung,pcm";
  reg = <0x03840000 0x100>;
  dmas = <&adma 3 &adma 4>;
  dma-names = "tx", "rx";
  interrupts = <0 116 0>;
  clocks = <&clock 1726>,
    <&clock 4105>;
  clock-names = "pcm", "sclk_pcm";
  samsung,lpass-subip;
  status = "disabled";
 };

 spdif@12DB0000 {
  compatible = "samsung,spdif";
  reg = <0x12DB0000 0x100>;
  dmas = <&pdma1 7>;
  dma-names = "tx";
  interrupts = <0 105 0>;
  clocks = <&clock 1476>,
           <&clock 1157>;
  clock-names = "spdif", "sclk_spdif";
  samsung,lpass-subip;
  pinctrl-names = "default", "idle";
  pinctrl-0 = <&spdif_bus>;
  pinctrl-1 = <&pcm2_bus>;
  status = "disabled";
 };


 mixer: mixer@14450000 {
  compatible = "samsung,exynos5-mixer_driver";
  reg = <0x14450000 0x4000>;
  interrupts = <0 94 0>;
  samsung,power-domain = <&spd_mixer>;

  clock-names = "clk_mixer", "sclk_hdmi", "aclk_axi_disp1x";

  clocks = <&clock 1324>, <&clock 1059>, <&clock 601>;

  ip_ver = <5>;
 };


 hdmi: hdmi@14530000 {
  compatible = "samsung,exynos5-hdmi_driver";
  reg = <0x14530000 0x80000>,
        <0x145D0000 0x8000>;
  interrupts = <0 95 0>;
  samsung,power-domain = <&spd_hdmi>;

  gpios = <&gpx3 7 0xf>;

  pinctrl-names = "hdmi_hdmi_hpd", "hdmi_ext_hpd";
  pinctrl-0 = <&hdmi_hdmi_hpd>;
  pinctrl-1 = <&hdmi_ext_hpd>;

  clock-names = "mout_hdmi", "sclk_hdmiphy", "sclk_hdmi", "sclk_pixel", "clk_hdmi";

  clocks = <&clock 2108>, <&clock 28>, <&clock 1059>, <&clock 1058>, <&clock 1323>;

  ip_ver = <5>;


  audio_master_clk = <0>;
 };


 cec@101B0000 {
  compatible = "samsung,exynos5-cec_driver";
  reg = <0x101B0000 0x1000>;
  interrupts = <0 114 0>;

  gpios = <&gpx3 6 0xf>;
  pinctrl-names = "hdmi_cec";
  pinctrl-0 = <&hdmi_cec>;

  clock-names = "pclk_hdmi_cec";
  clocks = <&clock 966>;

  #address-cells = <1>;
  #size-cells = <1>;
  ranges;

  hdmiphy-sys {
   reg = <0x10040700 0x4>;
  };
 };

 spi_0: spi@12d20000 {
  compatible = "samsung,exynos5410-spi";
  reg = <0x12d20000 0x100>;
  interrupts = <0 68 0>;
  dma-mode;
  dmas = <&pdma0 5
   &pdma0 4>;
  dma-names = "tx", "rx";
  swap-mode;
  #address-cells = <1>;
  #size-cells = <0>;
  clocks = <&clock 1484>, <&clock 4134>;
  clock-names = "spi", "spi_busclk0";
  pinctrl-names = "default";
  pinctrl-0 = <&spi0_bus>;
 };

 spi_1: spi@12d30000 {
  compatible = "samsung,exynos5410-spi";
  reg = <0x12d30000 0x100>;
  interrupts = <0 69 0>;
  dma-mode;
  dmas = <&pdma1 5
   &pdma1 4>;
  dma-names = "tx", "rx";
  swap-mode;
  #address-cells = <1>;
  #size-cells = <0>;
  clocks = <&clock 1483>, <&clock 4135>;
  clock-names = "spi", "spi_busclk0";
  pinctrl-names = "default";
  pinctrl-0 = <&spi1_bus>;
 };

 spi_2: spi@12d40000 {
  compatible = "samsung,exynos5410-spi";
  reg = <0x12d40000 0x100>;
  interrupts = <0 70 0>;
  dmas = <&pdma0 7
   &pdma0 6>;
  dma-names = "tx", "rx";
  swap-mode;
  #address-cells = <1>;
  #size-cells = <0>;
  clocks = <&clock 1482>, <&clock 4136>;
  clock-names = "spi", "spi_busclk0";
  pinctrl-names = "default";
  pinctrl-0 = <&spi2_bus>;
 };

 spi_3: spi@131a0000 {
  compatible = "samsung,exynos5410-spi";
  reg = <0x131a0000 0x100>;
  interrupts = <0 170 0>;
  swap-mode;
  #address-cells = <1>;
  #size-cells = <0>;
  clocks = <&clock 1221>, <&clock 4121>;
  clock-names = "spi", "spi_busclk0";
  pinctrl-names = "default";
  pinctrl-0 = <&fimc_is_spi_pin0>;
  domain = "isp";
  samsung,power-domain = <&pd_isp>;
 };

 spi_4: spi@131b0000 {
  compatible = "samsung,exynos5410-spi";
  reg = <0x131b0000 0x100>;
  interrupts = <0 171 0>;
  swap-mode;
  #address-cells = <1>;
  #size-cells = <0>;
  clocks = <&clock 1220>, <&clock 4122>;
  clock-names = "spi", "spi_busclk0";
  pinctrl-names = "default";
  pinctrl-0 = <&fimc_is_spi_pin1>;
  domain = "isp";
  samsung,power-domain = <&pd_isp>;
 };


 fimc_is_companion: fimc_is_companion@13180000 {
  samsung,power-domain = <&pd_isp>;
  clock-names = "fin_pll",


   "mout_isp_sensor",
   "dout_isp_sensor0",
   "sclk_isp_sensor0",


   "mout_spi0_isp",
   "dout_spi0_isp",
   "dout_spi0_isp_pre",


   "mout_spi1_isp",
   "dout_spi1_isp",
   "dout_spi1_isp_pre",


   "mout_ipll_ctrl",
   "mout_spll_ctrl",


   "mout_aclk_333_432_isp",
   "dout_aclk_333_432_isp",
   "mout_aclk_333_432_isp_sw",
   "mout_aclk_333_432_isp_user",



   "dout_ispdiv0",
   "dout_ispdiv1",
   "dout_ispdiv2";
  clocks = <&clock 1>,


   <&clock 2116>,
   <&clock 4114>,
   <&clock 1218>,


   <&clock 2119>,
   <&clock 4119>,
   <&clock 4121>,


   <&clock 2120>,
   <&clock 4120>,
   <&clock 4122>,


   <&clock 2005>,
   <&clock 2006>,


   <&clock 2051>,
   <&clock 4013>,
   <&clock 2065>,
   <&clock 2075>,


   <&clock 4170>,
   <&clock 4171>,
   <&clock 4172>;
 };


 fimc_is_sensor0: fimc_is_sensor@13C00000 {
  compatible = "samsung,exynos5-fimc-is-sensor";
  reg = <0x13C00000 0x10000>,
   <0x13C20000 0x10000>;
  interrupts = <0 125 0>;
  pinctrl-names = "ch0", "af0";
  pinctrl-0 = <&fimc_is_ch0_mclk>;
  pinctrl-1 = <&fimc_is_ch0_mclk &fimc_is_ch1_i2c>;
  samsung,power-domain = <&pd_cam>;
  clock-names = "mout_isp_sensor",
    "dout_isp_sensor0",
    "dout_isp_sensor1",
    "dout_isp_sensor2",

    "sclk_gscl_wrap_b",
    "sclk_gscl_wrap_a",

    "sclk_isp_sensor2",
    "sclk_isp_sensor1",
    "sclk_isp_sensor0",
    "sclk_pwm_isp",
    "sclk_spi1_isp",
    "sclk_spi0_isp",
    "sclk_uart_isp",

    "clk_camif_top_fimcl3",
    "clk_camif_top_fimcl1",
    "clk_camif_top_fimcl0",
    "clk_camif_top_3aa",
    "gscl_fimc_lite1",
    "gscl_fimc_lite0",
    "clk_3aa",

    "clk_camif_top_csis0",
    "gscl_fimc_lite3",
    "clk_gscl_wrap_b",
    "clk_gscl_wrap_a",

    "clk_3aa_2",
    "clk_xiu_si_gscl_cam",
    "clk_noc_p_rstop_fimcl",
    "clk_camif_top_3aa0",
    "clk_bts_gscl1",
    "clk_bts_gscl0",
    "clk_gscaler1",
    "clk_gscaler0";
  clocks = <&clock 2116>,
    <&clock 4114>,
    <&clock 4115>,
    <&clock 4116>,

    <&clock 1024>,
    <&clock 1025>,

    <&clock 1216>,
    <&clock 1217>,
    <&clock 1218>,
    <&clock 1219>,
    <&clock 1220>,
    <&clock 1221>,
    <&clock 1222>,

    <&clock 1255>,
    <&clock 1256>,
    <&clock 1257>,
    <&clock 1258>,
    <&clock 1260>,
    <&clock 1261>,
    <&clock 1262>,

    <&clock 1280>,
    <&clock 1281>,
    <&clock 1283>,
    <&clock 1284>,

    <&clock 5008>,
    <&clock 5010>,
    <&clock 5011>,
    <&clock 5012>,

    <&clock 1248>,
    <&clock 1249>,
    <&clock 1253>,
    <&clock 1254>;
 };


 fimc_is_sensor1: fimc_is_sensor@13C10000 {
  compatible = "samsung,exynos5-fimc-is-sensor";
  reg = <0x13C10000 0x10000>,
   <0x13C30000 0x10000>;
  interrupts = <0 126 0>;
  pinctrl-names = "ch1";
  pinctrl-0 = <&fimc_is_ch2_i2c &fimc_is_ch2_mclk>;
  iommu = <&sysmmu_flite_b>;
  samsung,power-domain = <&pd_cam>;
  clock-names = "mout_isp_sensor",
    "dout_isp_sensor0",
    "dout_isp_sensor1",
    "dout_isp_sensor2",


    "mout_aclk_fl1_550_cam",
    "dout_aclk_fl1_550_cam",
    "mout_aclk_fl1_550_cam_sw",
    "mout_aclk_fl1_550_cam_user",
    "dout2_cam_blk_550",


    "sclk_gscl_wrap_b",
    "sclk_gscl_wrap_a",

    "sclk_isp_sensor2",
    "sclk_isp_sensor1",
    "sclk_isp_sensor0",
    "sclk_pwm_isp",
    "sclk_spi1_isp",
    "sclk_spi0_isp",
    "sclk_uart_isp",

    "clk_camif_top_fimcl3",
    "clk_camif_top_fimcl1",
    "clk_camif_top_fimcl0",
    "clk_camif_top_3aa",
    "gscl_fimc_lite1",
    "gscl_fimc_lite0",
    "clk_3aa",

    "clk_camif_top_csis0",
    "gscl_fimc_lite3",
    "clk_gscl_wrap_b",
    "clk_gscl_wrap_a",

    "clk_3aa_2",
    "clk_xiu_si_gscl_cam",
    "clk_noc_p_rstop_fimcl",
    "clk_camif_top_3aa0",
    "clk_bts_gscl1",
    "clk_bts_gscl0",
    "clk_gscaler1",
    "clk_gscaler0";
  clocks = <&clock 2116>,
    <&clock 4114>,
    <&clock 4115>,
    <&clock 4116>,

    <&clock 5310>,
    <&clock 5407>,
    <&clock 5311>,
    <&clock 5312>,
    <&clock 5415>,

    <&clock 1024>,
    <&clock 1025>,

    <&clock 1216>,
    <&clock 1217>,
    <&clock 1218>,
    <&clock 1219>,
    <&clock 1220>,
    <&clock 1221>,
    <&clock 1222>,

    <&clock 1255>,
    <&clock 1256>,
    <&clock 1257>,
    <&clock 1258>,
    <&clock 1260>,
    <&clock 1261>,
    <&clock 1262>,

    <&clock 1280>,
    <&clock 1281>,
    <&clock 1283>,
    <&clock 1284>,

    <&clock 5008>,
    <&clock 5010>,
    <&clock 5011>,
    <&clock 5012>,

    <&clock 1248>,
    <&clock 1249>,
    <&clock 1253>,
    <&clock 1254>;
 };


 fimc_is: fimc_is@13000000 {
  compatible = "samsung,exynos5-fimc-is";
  reg = <0x13180000 0x10000>;
  interrupt-parent = <&combiner>;
  interrupts = <19 1>,
     <19 4>;
  pinctrl-names = "default";
  pinctrl-0 = <&fimc_is_flash>;
  clock-names = "fin_pll",
    "mout_cpll_ctrl",
    "mout_dpll_ctrl",
    "mout_epll_ctrl",
    "mout_rpll_ctrl",
    "mout_ipll_ctrl",
    "mout_spll_ctrl",
    "mout_mpll_ctrl",
    "sclk_epll2",
    "dout_spll_ctrl_div2",

    "mout_aclk_400_isp",
    "dout_aclk_400_isp",
    "mout_aclk_400_isp_sw",
    "mout_aclk_400_isp_user",
    "dout_mcuispdiv0",
    "dout_mcuispdiv1",

    "mout_aclk_266_isp",
    "dout_aclk_266_isp",
    "mout_aclk_266_isp_sw",
    "mout_aclk_266_isp_user",

    "mout_aclk_333_432_isp",
    "dout_aclk_333_432_isp",
    "mout_aclk_333_432_isp_sw",
    "mout_aclk_333_432_isp_user",

    "mout_aclk_333_432_isp0",
    "dout_aclk_333_432_isp0",
    "mout_aclk_333_432_isp0_sw",
    "mout_aclk_333_432_isp0_user",

    "dout_ispdiv0",
    "dout_ispdiv1",
    "dout_ispdiv2",

    "mout_aclk_333_432_gscl",
    "dout_aclk_333_432_gscl",
    "mout_aclk_333_432_gscl_sw",
    "mout_aclk_333_432_gscl_user",

    "mout_aclk_432_cam",
    "dout_aclk_432_cam",
    "mout_aclk_432_cam_sw",
    "mout_aclk_432_cam_user",

    "mout_aclk_550_cam",
    "dout_aclk_550_cam",
    "mout_aclk_550_cam_sw",
    "mout_aclk_550_cam_user",

    "mout_aclk_fl1_550_cam",
    "dout_aclk_fl1_550_cam",
    "mout_aclk_fl1_550_cam_sw",
    "mout_aclk_fl1_550_cam_user",

    "dout2_gscl_blk_333",
    "dout2_cam_blk_432",
    "dout2_cam_blk_550",

    "mout_isp_sensor",
    "dout_isp_sensor0",
    "dout_isp_sensor1",
    "dout_isp_sensor2",

    "mout_pwm_isp",
    "dout_pwm_isp",

    "mout_uart_isp",
    "dout_uart_isp",

    "mout_spi0_isp",
    "dout_spi0_isp",
    "dout_spi0_isp_pre",

    "mout_spi1_isp",
    "dout_spi1_isp",
    "dout_spi1_isp_pre",

    "mout_gscl_wrap_a",
    "dout_gscl_wrap_a",

    "mout_gscl_wrap_b",
    "dout_gscl_wrap_b",

    "sclk_gscl_wrap_b",
    "sclk_gscl_wrap_a",

    "sclk_isp_sensor2",
    "sclk_isp_sensor1",
    "sclk_isp_sensor0",
    "sclk_pwm_isp",
    "sclk_spi1_isp",
    "sclk_spi0_isp",
    "sclk_uart_isp",

    "clk_camif_top_fimcl3",
    "clk_camif_top_fimcl1",
    "clk_camif_top_fimcl0",
    "clk_camif_top_3aa",
    "gscl_fimc_lite1",
    "gscl_fimc_lite0",
    "clk_3aa",

    "clk_camif_top_csis0",
    "gscl_fimc_lite3",
    "clk_gscl_wrap_b",
    "clk_gscl_wrap_a",

    "clk_3aa_2",
    "clk_xiu_si_gscl_cam",
    "clk_noc_p_rstop_fimcl",
    "clk_camif_top_3aa0",

    "clk_uart_isp",
    "clk_wdt_isp",
    "clk_i2c2_isp",
    "clk_pwm_isp",
    "clk_mtcadc_isp",
    "clk_i2c1_isp",
    "clk_i2c0_isp",
    "clk_mpwm_isp",
    "clk_mcuctl_isp",
    "clk_gicisp",
    "clk_mcuisp",
    "clk_scalerp",
    "clk_scalerc",
    "clk_fd",
    "clk_drc",
    "clk_isp",

    "aclk_asyncaxim_3dnr_ip",
    "aclk_asyncaxim_fd_ip",
    "aclk_asyncaxim_scp_ip",
    "clk_spi1_isp",
    "clk_spi0_isp",
    "clk_3dnr",
    "clk_chain_glue1",

    "dout_ispdiv0_0";
  clocks = <&clock 1>,
    <&clock 2001>,
    <&clock 2002>,
    <&clock 2003>,
    <&clock 2004>,
    <&clock 2005>,
    <&clock 2006>,
    <&clock 2008>,
    <&clock 5000>,
    <&clock 5001>,

    <&clock 2025>,
    <&clock 4007>,
    <&clock 2033>,
    <&clock 2040>,
    <&clock 4168>,
    <&clock 4169>,

    <&clock 5301>,
    <&clock 5404>,
    <&clock 5302>,
    <&clock 2044>,

    <&clock 2051>,
    <&clock 4013>,
    <&clock 2065>,
    <&clock 2075>,

    <&clock 2050>,
    <&clock 4012>,
    <&clock 2064>,
    <&clock 2074>,

    <&clock 4170>,
    <&clock 4171>,
    <&clock 4172>,

    <&clock 2052>,
    <&clock 4014>,
    <&clock 2066>,
    <&clock 2076>,

    <&clock 5306>,
    <&clock 5406>,
    <&clock 5307>,
    <&clock 5308>,

    <&clock 5313>,
    <&clock 5408>,
    <&clock 5314>,
    <&clock 5315>,

    <&clock 5310>,
    <&clock 5407>,
    <&clock 5311>,
    <&clock 5312>,

    <&clock 5413>,
    <&clock 5414>,
    <&clock 5415>,

    <&clock 2116>,
    <&clock 4114>,
    <&clock 4115>,
    <&clock 4116>,

    <&clock 2117>,
    <&clock 4117>,

    <&clock 2118>,
    <&clock 4118>,

    <&clock 2119>,
    <&clock 4119>,
    <&clock 4121>,

    <&clock 2120>,
    <&clock 4120>,
    <&clock 4122>,

    <&clock 5320>,
    <&clock 5410>,
    <&clock 5321>,
    <&clock 5411>,

    <&clock 1024>,
    <&clock 1025>,

    <&clock 1216>,
    <&clock 1217>,
    <&clock 1218>,
    <&clock 1219>,
    <&clock 1220>,
    <&clock 1221>,
    <&clock 1222>,

    <&clock 1255>,
    <&clock 1256>,
    <&clock 1257>,
    <&clock 1258>,
    <&clock 1260>,
    <&clock 1261>,
    <&clock 1262>,

    <&clock 1280>,
    <&clock 1281>,
    <&clock 1283>,
    <&clock 1284>,

    <&clock 5008>,
    <&clock 5010>,
    <&clock 5011>,
    <&clock 5012>,

    <&clock 384>,
    <&clock 385>,
    <&clock 386>,
    <&clock 387>,
    <&clock 388>,
    <&clock 389>,
    <&clock 390>,
    <&clock 391>,
    <&clock 392>,
    <&clock 407>,
    <&clock 408>,
    <&clock 409>,
    <&clock 410>,
    <&clock 411>,
    <&clock 412>,
    <&clock 413>,
    <&clock 416>,
    <&clock 419>,
    <&clock 420>,
    <&clock 421>,
    <&clock 422>,
    <&clock 429>,
    <&clock 431>,

    <&clock 4167>;
  samsung,power-domain = <&pd_isp>;
  status = "ok";


  clk_gate_enums =<0>,
    <1>,
    <2>,
    <3>,
    <5>,
    <6>,
    <7>,
    <8>,
    <9>;
  clk_gate_strs = "gate_3aa1",
    "gate_isp",
    "gate_drc",
    "gate_scalerc",
    "gate_dis",
    "gate_3dnr",
    "gate_scalerp",
    "gate_fd",
    "gate_3aa0";
  clk_gate_ctrl {

   group0 {

   };

   group1 {

   };

   group2 {
    mask_clk_on_org = <1>,
       <2>,
       <3>,
       <6>,
       <7>,
       <8>;
    mask_clk_off_self_org = <1>,
       <2>,
       <3>,
       <6>,
       <7>,
       <8>;
   };
  };
  subip_info {
   num_of_mcuctl = <1>;
   num_of_3a0 = <1>;
   num_of_3a1 = <1>;
   num_of_isp = <1>;
   num_of_drc = <1>;
   num_of_scc = <1>;
   num_of_odc = <0>;
   num_of_dis = <0>;
   num_of_dnr = <1>;
   num_of_scp = <1>;
   num_of_fd = <1>;

   full_bypass_drc = <0>;
   full_bypass_dis = <1>;
   full_bypass_dnr = <1>;

   version_mcuctl = <221>;
  };
 };

 sss@10830000 {
  compatible = "samsung,exynos5-sss";
  reg = <0x10830000 0x8000>;
  interrupts = <0 112 0>;
  clocks = <&clock 235>;
  clock-names = "secss";
 };

 slimsss@10900000 {
  compatible = "samsung,exynos5-slimsss";
  reg = <0x10900000 0x1000>;
  interrupts = <0 196 0>;
  clocks = <&clock 226>;
  clock-names = "slimsss";
 };

 pd_gscl: pd-gscl@10044000 {
  compatible = "samsung,exynos-pd";
  reg = <0x10044000 0x20>;

  spd_gscl0: spd-gscl0@10044000 {
   compatible = "samsung,exynos-spd";
   bts-status = "enabled";
  };

  spd_gscl1: spd-gscl1@10044000 {
   compatible = "samsung,exynos-spd";
   bts-status = "enabled";
  };
 };

 pd_isp: pd-isp@10044020 {
  compatible = "samsung,exynos-pd";
  reg = <0x10044020 0x20>;
  parent = <&pd_cam>;
  bts-status = "enabled";
 };

 pd_mfc0: pd-mfc@10044060 {
  compatible = "samsung,exynos-pd";
  reg = <0x10044060 0x20>;
  bts-status = "disable";
 };

 pd_g3d: pd-g3d@0x10044080 {
  compatible = "samsung,exynos-pd";
  reg = <0x10044080 0x20>;
  bts-status = "enabled";
 };

 pd_disp1: pd-disp1@0x100440c0 {
  compatible = "samsung,exynos-pd";
  reg = <0x100440c0 0x20>;

  spd_fimd: spd-fimd@100440c0 {
   compatible = "samsung,exynos-spd";
   bts-status = "enabled";
  };

  spd_mixer: spd-mixer@100440c0 {
   compatible = "samsung,exynos-spd";
   bts-status = "enabled";
  };

  spd_hdmi: spd-hdmi@100440c0 {
   compatible = "samsung,exynos-spd";
   bts-status = "disabled";
  };
 };


 pd_maudio: pd-maudio@100440e0 {
  compatible = "samsung,exynos-pd";
  reg = <0x100440e0 0x20>;
 };

 pd_g2d: pd-g2d@0x10044100 {
  compatible = "samsung,exynos-pd";
  reg = <0x10044100 0x20>;
  status = "disabled";
  bts-status = "enabled";
 };

 pd_mscl: pd-mscl@10044120 {
  compatible = "samsung,exynos-pd";
  reg = <0x10044120 0x20>;
  bts-status = "enabled";
  spd_mscl0: spd-mscl0@10044120 {
   compatible = "samsung,exynos-spd";
   bts-status = "enabled";
  };
  spd_mscl1: spd-mscl1@10044120 {
   compatible = "samsung,exynos-spd";
   bts-status = "enabled";
  };
  spd_mscl2: spd-mscl2@10044120 {
   compatible = "samsung,exynos-spd";
   bts-status = "enabled";
  };
 };

 pd_fsys: pd-fsys@10044140 {
  compatible = "samsung,exynos-pd";
  reg = <0x10044140 0x20>;
  status = "disabled";

  spd_usbdrd30: spd-usbdrd30@10044140 {
   compatible = "samsung,exynos-spd";
   bts-status = "enabled";
  };

  spd_pdma: spd-pdma@10044140 {
   compatible = "samsung,exynos-spd";
  };

  spd_usbhost20: spd-usbhost20@10044140 {
   compatible = "samsung,exynos-spd";
  };
 };

 pd_psgen: pd-psgen@10044180 {
  compatible = "samsung,exynos-pd";
  reg = <0x10044180 0x20>;
  status = "disabled";

  spd_jpeg1: spd-jpeg1@10044180 {
   compatible = "samsung,exynos-spd";
   status = "disabled";
   bts-status = "enabled";
  };

  spd_jpeg2: spd-jpeg2@10044180 {
   compatible = "samsung,exynos-spd";
   status = "disabled";
   bts-status = "enabled";
  };
 };

 pd_peric: pd-peric@100441A0 {
  compatible = "samsung,exynos-pd";
  reg = <0x100441A0 0x20>;
  status = "disabled";
 };

 pd_wcore: pd-wcore@100441C0 {
  compatible = "samsung,exynos-pd";
  reg = <0x10041C00 0x20>;
  status = "disabled";
 };

 pd_cam: pd-cam@10045100 {
  compatible = "samsung,exynos-pd";
  reg = <0x10045100 0x20>;
  parent = <&pd_gscl>;
  bts-status = "enabled";
 };

 s5p-smem {
  compatible = "samsung,exynos-secmem";
  secmem = <&gsc_0>,
    <&gsc_1>;
 };

};
# 13 "arch/arm/boot/dts/exynos5422_evt0-k3g_common.dtsi" 2
# 1 "arch/arm/boot/dts/exynos5422-k_mhl2x.dtsi" 1
# 13 "arch/arm/boot/dts/exynos5422-k_mhl2x.dtsi"
/ {
 hsi2c@12E20000 {
  samsung,fs-mode;
  clock-frequency = <100000>;
  status = "okay";

  sii8240tmds@39 {
   compatible = "sii8240,tmds";
   reg = <0x39>;
   sii8240,client_id = <0x00>;

   interrupts = <3 1 1>;
   interrupt-parent = <&gpg0>;
   pinctrl-names = "default";
   pinctrl-0 = <&mhl_irq>;

   sii8240,mhl_reset = <&gpj4 3 0>;
   sii8240,mhl_scl = <&gpb4 1 0>;
   sii8240,mhl_sda = <&gpb4 0 0>;
   sii8240,swing_level = <0x2D>;
  };
  sii8240hdmi@49 {
   compatible = "sii8240,hdmi";
   reg = <0x49>;
   sii8240,client_id = <0x01>;
  };
  sii8240disc@4D {
   compatible = "sii8240,disc";
   reg = <0x4D>;
   sii8240,client_id = <0x02>;
  };
  sii8240tpi@59 {
   compatible = "sii8240,tpi";
   reg = <0x59>;
   sii8240,client_id = <0x03>;
  };
  sii8240cbus@64 {
   compatible = "sii8240,cbus";
   reg = <0x64>;
   sii8240,client_id = <0x04>;
  };
 };

 pinctrl@14000000 {
  mhl_irq: mhl_irq {
   samsung,pins = "gpg0-3";
   samsung,pin-function = <0xf>;
   samsung,pin-pud = <1>;
   samsung,pin-drv = <0>;
  };
 };
};
# 14 "arch/arm/boot/dts/exynos5422_evt0-k3g_common.dtsi" 2
# 1 "arch/arm/boot/dts/exynos5422-k_gpio.dtsi" 1
# 12 "arch/arm/boot/dts/exynos5422-k_gpio.dtsi"
# 1 "arch/arm/boot/dts/exynos_gpio_config_macros.dtsi" 1
# 13 "arch/arm/boot/dts/exynos5422-k_gpio.dtsi" 2

&pinctrl_0 {
 pinctrl-names = "sleep";

 pinctrl-0 = <&sleep0>;

sleep0: sleep-state {
  gpy7-2 { samsung,pins = "gpy7-2"; samsung,pin-con-pdn = <2>; samsung,pin-pud-pdn = <1>; };
  gpy7-3 { samsung,pins = "gpy7-3"; samsung,pin-con-pdn = <2>; samsung,pin-pud-pdn = <1>; };
  gpy7-4 { samsung,pins = "gpy7-4"; samsung,pin-con-pdn = <3>; samsung,pin-pud-pdn = <0>; };
 };
};

&pinctrl_1 {
 pinctrl-names = "default", "sleep";

 pinctrl-0 = <&initial1>;
 pinctrl-1 = <&sleep1>;

initial1: initial-state {
    gpc2-2 { samsung,pins = "gpc2-2"; samsung,pin-function = <0>; samsung,pin-pud = <1>; samsung,pin-drv = <0x0>; };
    gpy0-0 { samsung,pins = "gpy0-0"; samsung,pin-function = <0>; samsung,pin-pud = <1>; samsung,pin-drv = <0x0>; };
    gpy0-1 { samsung,pins = "gpy0-1"; samsung,pin-function = <0>; samsung,pin-pud = <1>; samsung,pin-drv = <0x0>; };
    gpy0-2 { samsung,pins = "gpy0-2"; samsung,pin-function = <0>; samsung,pin-pud = <1>; samsung,pin-drv = <0x0>; };
    gpy0-3 { samsung,pins = "gpy0-3"; samsung,pin-function = <0>; samsung,pin-pud = <1>; samsung,pin-drv = <0x0>; };
    gpy0-4 { samsung,pins = "gpy0-4"; samsung,pin-function = <0>; samsung,pin-pud = <1>; samsung,pin-drv = <0x0>; };
    gpy0-5 { samsung,pins = "gpy0-5"; samsung,pin-function = <0>; samsung,pin-pud = <1>; samsung,pin-drv = <0x0>; };

    gpy1-0 { samsung,pins = "gpy1-0"; samsung,pin-function = <0>; samsung,pin-pud = <1>; samsung,pin-drv = <0x0>; };
    gpy1-1 { samsung,pins = "gpy1-1"; samsung,pin-function = <0>; samsung,pin-pud = <1>; samsung,pin-drv = <0x0>; };
    gpy1-2 { samsung,pins = "gpy1-2"; samsung,pin-function = <0>; samsung,pin-pud = <1>; samsung,pin-drv = <0x0>; };
    gpy1-3 { samsung,pins = "gpy1-3"; samsung,pin-function = <0>; samsung,pin-pud = <1>; samsung,pin-drv = <0x0>; };

    gpy2-1 { samsung,pins = "gpy2-1"; samsung,pin-function = <0>; samsung,pin-pud = <1>; samsung,pin-drv = <0x0>; };
    gpy2-2 { samsung,pins = "gpy2-2"; samsung,pin-function = <0>; samsung,pin-pud = <1>; samsung,pin-drv = <0x0>; };

    gpy2-3 { samsung,pins = "gpy2-3"; samsung,pin-function = <0>; samsung,pin-pud = <1>; samsung,pin-drv = <0x0>; };
    gpy2-4 { samsung,pins = "gpy2-4"; samsung,pin-function = <0>; samsung,pin-pud = <1>; samsung,pin-drv = <0x0>; };
    gpy2-5 { samsung,pins = "gpy2-5"; samsung,pin-function = <0>; samsung,pin-pud = <1>; samsung,pin-drv = <0x0>; };

    gpy3-6 { samsung,pins = "gpy3-6"; samsung,pin-function = <0>; samsung,pin-pud = <0>; samsung,pin-drv = <0x0>; };
    gpy3-7 { samsung,pins = "gpy3-7"; samsung,pin-function = <0>; samsung,pin-pud = <0>; samsung,pin-drv = <0x0>; };

    gpy4-2 { samsung,pins = "gpy4-2"; samsung,pin-function = <0>; samsung,pin-pud = <1>; samsung,pin-drv = <0x0>; };
    gpy4-3 { samsung,pins = "gpy4-3"; samsung,pin-function = <0>; samsung,pin-pud = <1>; samsung,pin-drv = <0x0>; };
   };

sleep1: sleep-state {
  gpc0-0 { samsung,pins = "gpc0-0"; samsung,pin-con-pdn = <3>; samsung,pin-pud-pdn = <0>; };
  gpc0-1 { samsung,pins = "gpc0-1"; samsung,pin-con-pdn = <3>; samsung,pin-pud-pdn = <0>; };
  gpc0-2 { samsung,pins = "gpc0-2"; samsung,pin-con-pdn = <3>; samsung,pin-pud-pdn = <0>; };
  gpc0-3 { samsung,pins = "gpc0-3"; samsung,pin-con-pdn = <3>; samsung,pin-pud-pdn = <0>; };
  gpc0-4 { samsung,pins = "gpc0-4"; samsung,pin-con-pdn = <3>; samsung,pin-pud-pdn = <0>; };
  gpc0-5 { samsung,pins = "gpc0-5"; samsung,pin-con-pdn = <3>; samsung,pin-pud-pdn = <0>; };
  gpc0-6 { samsung,pins = "gpc0-6"; samsung,pin-con-pdn = <3>; samsung,pin-pud-pdn = <0>; };
  gpc0-7 { samsung,pins = "gpc0-7"; samsung,pin-con-pdn = <3>; samsung,pin-pud-pdn = <0>; };

  gpc1-0 { samsung,pins = "gpc1-0"; samsung,pin-con-pdn = <0>; samsung,pin-pud-pdn = <0>; };
  gpc1-1 { samsung,pins = "gpc1-1"; samsung,pin-con-pdn = <2>; samsung,pin-pud-pdn = <0>; };
  gpc1-2 { samsung,pins = "gpc1-2"; samsung,pin-con-pdn = <2>; samsung,pin-pud-pdn = <1>; };
  gpc1-3 { samsung,pins = "gpc1-3"; samsung,pin-con-pdn = <2>; samsung,pin-pud-pdn = <0>; };
  gpc1-4 { samsung,pins = "gpc1-4"; samsung,pin-con-pdn = <2>; samsung,pin-pud-pdn = <0>; };
  gpc1-5 { samsung,pins = "gpc1-5"; samsung,pin-con-pdn = <2>; samsung,pin-pud-pdn = <0>; };
  gpc1-6 { samsung,pins = "gpc1-6"; samsung,pin-con-pdn = <2>; samsung,pin-pud-pdn = <0>; };
  gpc1-7 { samsung,pins = "gpc1-7"; samsung,pin-con-pdn = <2>; samsung,pin-pud-pdn = <1>; };

  gpc2-0 { samsung,pins = "gpc2-0"; samsung,pin-con-pdn = <2>; samsung,pin-pud-pdn = <1>; };
  gpc2-1 { samsung,pins = "gpc2-1"; samsung,pin-con-pdn = <2>; samsung,pin-pud-pdn = <1>; };
  gpc2-2 { samsung,pins = "gpc2-2"; samsung,pin-con-pdn = <2>; samsung,pin-pud-pdn = <1>; };
  gpc2-3 { samsung,pins = "gpc2-3"; samsung,pin-con-pdn = <2>; samsung,pin-pud-pdn = <1>; };
  gpc2-4 { samsung,pins = "gpc2-4"; samsung,pin-con-pdn = <2>; samsung,pin-pud-pdn = <1>; };
  gpc2-5 { samsung,pins = "gpc2-5"; samsung,pin-con-pdn = <2>; samsung,pin-pud-pdn = <1>; };
  gpc2-6 { samsung,pins = "gpc2-6"; samsung,pin-con-pdn = <2>; samsung,pin-pud-pdn = <1>; };

  gpc3-0 { samsung,pins = "gpc3-0"; samsung,pin-con-pdn = <3>; samsung,pin-pud-pdn = <0>; };
  gpc3-1 { samsung,pins = "gpc3-1"; samsung,pin-con-pdn = <3>; samsung,pin-pud-pdn = <0>; };
  gpc3-2 { samsung,pins = "gpc3-2"; samsung,pin-con-pdn = <3>; samsung,pin-pud-pdn = <0>; };
  gpc3-3 { samsung,pins = "gpc3-3"; samsung,pin-con-pdn = <3>; samsung,pin-pud-pdn = <0>; };

  gpc4-0 { samsung,pins = "gpc4-0"; samsung,pin-con-pdn = <2>; samsung,pin-pud-pdn = <1>; };
  gpc4-1 { samsung,pins = "gpc4-1"; samsung,pin-con-pdn = <2>; samsung,pin-pud-pdn = <1>; };

  gpd1-0 { samsung,pins = "gpd1-0"; samsung,pin-con-pdn = <0>; samsung,pin-pud-pdn = <1>; };
  gpd1-1 { samsung,pins = "gpd1-1"; samsung,pin-con-pdn = <0>; samsung,pin-pud-pdn = <0>; };
  gpd1-2 { samsung,pins = "gpd1-2"; samsung,pin-con-pdn = <0>; samsung,pin-pud-pdn = <1>; };
  gpd1-3 { samsung,pins = "gpd1-3"; samsung,pin-con-pdn = <2>; samsung,pin-pud-pdn = <1>; };
  gpd1-4 { samsung,pins = "gpd1-4"; samsung,pin-con-pdn = <2>; samsung,pin-pud-pdn = <1>; };
  gpd1-5 { samsung,pins = "gpd1-5"; samsung,pin-con-pdn = <2>; samsung,pin-pud-pdn = <1>; };
  gpd1-6 { samsung,pins = "gpd1-6"; samsung,pin-con-pdn = <0>; samsung,pin-pud-pdn = <1>; };
  gpd1-7 { samsung,pins = "gpd1-7"; samsung,pin-con-pdn = <2>; samsung,pin-pud-pdn = <1>; };

  gpy0-0 { samsung,pins = "gpy0-0"; samsung,pin-con-pdn = <2>; samsung,pin-pud-pdn = <1>; };
  gpy0-1 { samsung,pins = "gpy0-1"; samsung,pin-con-pdn = <2>; samsung,pin-pud-pdn = <1>; };
  gpy0-2 { samsung,pins = "gpy0-2"; samsung,pin-con-pdn = <2>; samsung,pin-pud-pdn = <1>; };
  gpy0-3 { samsung,pins = "gpy0-3"; samsung,pin-con-pdn = <2>; samsung,pin-pud-pdn = <1>; };
  gpy0-4 { samsung,pins = "gpy0-4"; samsung,pin-con-pdn = <2>; samsung,pin-pud-pdn = <1>; };
  gpy0-5 { samsung,pins = "gpy0-5"; samsung,pin-con-pdn = <2>; samsung,pin-pud-pdn = <1>; };

  gpy1-0 { samsung,pins = "gpy1-0"; samsung,pin-con-pdn = <2>; samsung,pin-pud-pdn = <1>; };
  gpy1-1 { samsung,pins = "gpy1-1"; samsung,pin-con-pdn = <2>; samsung,pin-pud-pdn = <1>; };
  gpy1-2 { samsung,pins = "gpy1-2"; samsung,pin-con-pdn = <2>; samsung,pin-pud-pdn = <1>; };
  gpy1-3 { samsung,pins = "gpy1-3"; samsung,pin-con-pdn = <2>; samsung,pin-pud-pdn = <1>; };

  gpy2-0 { samsung,pins = "gpy2-0"; samsung,pin-con-pdn = <3>; samsung,pin-pud-pdn = <0>; };
  gpy2-1 { samsung,pins = "gpy2-1"; samsung,pin-con-pdn = <2>; samsung,pin-pud-pdn = <1>; };
  gpy2-2 { samsung,pins = "gpy2-2"; samsung,pin-con-pdn = <2>; samsung,pin-pud-pdn = <1>; };
  gpy2-3 { samsung,pins = "gpy2-3"; samsung,pin-con-pdn = <2>; samsung,pin-pud-pdn = <1>; };
  gpy2-4 { samsung,pins = "gpy2-4"; samsung,pin-con-pdn = <2>; samsung,pin-pud-pdn = <1>; };
  gpy2-5 { samsung,pins = "gpy2-5"; samsung,pin-con-pdn = <2>; samsung,pin-pud-pdn = <1>; };

  gpy3-0 { samsung,pins = "gpy3-0"; samsung,pin-con-pdn = <3>; samsung,pin-pud-pdn = <0>; };
  gpy3-1 { samsung,pins = "gpy3-1"; samsung,pin-con-pdn = <3>; samsung,pin-pud-pdn = <0>; };
  gpy3-2 { samsung,pins = "gpy3-2"; samsung,pin-con-pdn = <0>; samsung,pin-pud-pdn = <0>; };
  gpy3-3 { samsung,pins = "gpy3-3"; samsung,pin-con-pdn = <3>; samsung,pin-pud-pdn = <0>; };
  gpy3-4 { samsung,pins = "gpy3-4"; samsung,pin-con-pdn = <2>; samsung,pin-pud-pdn = <0>; };
  gpy3-5 { samsung,pins = "gpy3-5"; samsung,pin-con-pdn = <3>; samsung,pin-pud-pdn = <0>; };
  gpy3-6 { samsung,pins = "gpy3-6"; samsung,pin-con-pdn = <2>; samsung,pin-pud-pdn = <0>; };
  gpy3-7 { samsung,pins = "gpy3-7"; samsung,pin-con-pdn = <2>; samsung,pin-pud-pdn = <0>; };

  gpy4-0 { samsung,pins = "gpy4-0"; samsung,pin-con-pdn = <3>; samsung,pin-pud-pdn = <0>; };
  gpy4-1 { samsung,pins = "gpy4-1"; samsung,pin-con-pdn = <2>; samsung,pin-pud-pdn = <1>; };
  gpy4-2 { samsung,pins = "gpy4-2"; samsung,pin-con-pdn = <2>; samsung,pin-pud-pdn = <1>; };
  gpy4-3 { samsung,pins = "gpy4-3"; samsung,pin-con-pdn = <2>; samsung,pin-pud-pdn = <1>; };
  gpy4-4 { samsung,pins = "gpy4-4"; samsung,pin-con-pdn = <2>; samsung,pin-pud-pdn = <1>; };
  gpy4-5 { samsung,pins = "gpy4-5"; samsung,pin-con-pdn = <2>; samsung,pin-pud-pdn = <1>; };
  gpy4-6 { samsung,pins = "gpy4-6"; samsung,pin-con-pdn = <2>; samsung,pin-pud-pdn = <1>; };
  gpy4-7 { samsung,pins = "gpy4-7"; samsung,pin-con-pdn = <2>; samsung,pin-pud-pdn = <1>; };

  gpy5-0 { samsung,pins = "gpy5-0"; samsung,pin-con-pdn = <2>; samsung,pin-pud-pdn = <1>; };
  gpy5-1 { samsung,pins = "gpy5-1"; samsung,pin-con-pdn = <2>; samsung,pin-pud-pdn = <1>; };
  gpy5-2 { samsung,pins = "gpy5-2"; samsung,pin-con-pdn = <2>; samsung,pin-pud-pdn = <1>; };
  gpy5-3 { samsung,pins = "gpy5-3"; samsung,pin-con-pdn = <2>; samsung,pin-pud-pdn = <1>; };
  gpy5-4 { samsung,pins = "gpy5-4"; samsung,pin-con-pdn = <2>; samsung,pin-pud-pdn = <1>; };
  gpy5-5 { samsung,pins = "gpy5-5"; samsung,pin-con-pdn = <2>; samsung,pin-pud-pdn = <1>; };
  gpy5-6 { samsung,pins = "gpy5-6"; samsung,pin-con-pdn = <2>; samsung,pin-pud-pdn = <1>; };
  gpy5-7 { samsung,pins = "gpy5-7"; samsung,pin-con-pdn = <2>; samsung,pin-pud-pdn = <1>; };

  gpy6-0 { samsung,pins = "gpy6-0"; samsung,pin-con-pdn = <2>; samsung,pin-pud-pdn = <1>; };
  gpy6-1 { samsung,pins = "gpy6-1"; samsung,pin-con-pdn = <2>; samsung,pin-pud-pdn = <1>; };
  gpy6-2 { samsung,pins = "gpy6-2"; samsung,pin-con-pdn = <2>; samsung,pin-pud-pdn = <1>; };
  gpy6-3 { samsung,pins = "gpy6-3"; samsung,pin-con-pdn = <2>; samsung,pin-pud-pdn = <1>; };
  gpy6-4 { samsung,pins = "gpy6-4"; samsung,pin-con-pdn = <2>; samsung,pin-pud-pdn = <1>; };
  gpy6-5 { samsung,pins = "gpy6-5"; samsung,pin-con-pdn = <2>; samsung,pin-pud-pdn = <1>; };
  gpy6-6 { samsung,pins = "gpy6-6"; samsung,pin-con-pdn = <2>; samsung,pin-pud-pdn = <1>; };
  gpy6-7 { samsung,pins = "gpy6-7"; samsung,pin-con-pdn = <2>; samsung,pin-pud-pdn = <1>; };
 };
};

&pinctrl_2 {
 pinctrl-names = "default", "sleep";

 pinctrl-0 = <&initial2>;
 pinctrl-1 = <&sleep2>;

initial2: initial-state {
    gpe0-7 { samsung,pins = "gpe0-7"; samsung,pin-function = <0>; samsung,pin-pud = <1>; samsung,pin-drv = <0x0>; };
    gpe1-1 { samsung,pins = "gpe1-1"; samsung,pin-function = <0>; samsung,pin-pud = <1>; samsung,pin-drv = <0x0>; };
    gpf1-4 { samsung,pins = "gpf1-4"; samsung,pin-function = <0>; samsung,pin-pud = <1>; samsung,pin-drv = <0x0>; };
    gpf1-5 { samsung,pins = "gpf1-5"; samsung,pin-function = <0>; samsung,pin-pud = <1>; samsung,pin-drv = <0x0>; };
    gpf1-6 { samsung,pins = "gpf1-6"; samsung,pin-function = <0>; samsung,pin-pud = <1>; samsung,pin-drv = <0x0>; };
    gpf1-7 { samsung,pins = "gpf1-7"; samsung,pin-function = <0>; samsung,pin-pud = <1>; samsung,pin-drv = <0x0>; };
   };

sleep2: sleep-state {
  gpe0-0 { samsung,pins = "gpe0-0"; samsung,pin-con-pdn = <0>; samsung,pin-pud-pdn = <1>; };
  gpe0-1 { samsung,pins = "gpe0-1"; samsung,pin-con-pdn = <3>; samsung,pin-pud-pdn = <0>; };
  gpe0-2 { samsung,pins = "gpe0-2"; samsung,pin-con-pdn = <3>; samsung,pin-pud-pdn = <0>; };
  gpe0-3 { samsung,pins = "gpe0-3"; samsung,pin-con-pdn = <0>; samsung,pin-pud-pdn = <1>; };
  gpe0-4 { samsung,pins = "gpe0-4"; samsung,pin-con-pdn = <0>; samsung,pin-pud-pdn = <1>; };
  gpe0-5 { samsung,pins = "gpe0-5"; samsung,pin-con-pdn = <0>; samsung,pin-pud-pdn = <1>; };
  gpe0-6 { samsung,pins = "gpe0-6"; samsung,pin-con-pdn = <0>; samsung,pin-pud-pdn = <1>; };
  gpe0-7 { samsung,pins = "gpe0-7"; samsung,pin-con-pdn = <2>; samsung,pin-pud-pdn = <1>; };

  gpe1-0 { samsung,pins = "gpe1-0"; samsung,pin-con-pdn = <2>; samsung,pin-pud-pdn = <1>; };
  gpe1-1 { samsung,pins = "gpe1-1"; samsung,pin-con-pdn = <2>; samsung,pin-pud-pdn = <1>; };

  gpf0-0 { samsung,pins = "gpf0-0"; samsung,pin-con-pdn = <2>; samsung,pin-pud-pdn = <1>; };
  gpf0-1 { samsung,pins = "gpf0-1"; samsung,pin-con-pdn = <2>; samsung,pin-pud-pdn = <1>; };
  gpf0-2 { samsung,pins = "gpf0-2"; samsung,pin-con-pdn = <2>; samsung,pin-pud-pdn = <1>; };
  gpf0-3 { samsung,pins = "gpf0-3"; samsung,pin-con-pdn = <2>; samsung,pin-pud-pdn = <1>; };
  gpf0-4 { samsung,pins = "gpf0-4"; samsung,pin-con-pdn = <2>; samsung,pin-pud-pdn = <1>; };
  gpf0-5 { samsung,pins = "gpf0-5"; samsung,pin-con-pdn = <2>; samsung,pin-pud-pdn = <1>; };

  gpf1-0 { samsung,pins = "gpf1-0"; samsung,pin-con-pdn = <0>; samsung,pin-pud-pdn = <1>; };
  gpf1-1 { samsung,pins = "gpf1-1"; samsung,pin-con-pdn = <0>; samsung,pin-pud-pdn = <1>; };
  gpf1-2 { samsung,pins = "gpf1-2"; samsung,pin-con-pdn = <0>; samsung,pin-pud-pdn = <1>; };
  gpf1-3 { samsung,pins = "gpf1-3"; samsung,pin-con-pdn = <0>; samsung,pin-pud-pdn = <1>; };
  gpf1-4 { samsung,pins = "gpf1-4"; samsung,pin-con-pdn = <2>; samsung,pin-pud-pdn = <1>; };
  gpf1-5 { samsung,pins = "gpf1-5"; samsung,pin-con-pdn = <2>; samsung,pin-pud-pdn = <1>; };
  gpf1-6 { samsung,pins = "gpf1-6"; samsung,pin-con-pdn = <2>; samsung,pin-pud-pdn = <1>; };
  gpf1-7 { samsung,pins = "gpf1-7"; samsung,pin-con-pdn = <2>; samsung,pin-pud-pdn = <1>; };

  gpg0-0 { samsung,pins = "gpg0-0"; samsung,pin-con-pdn = <1>; samsung,pin-pud-pdn = <0>; };
  gpg0-1 { samsung,pins = "gpg0-1"; samsung,pin-con-pdn = <3>; samsung,pin-pud-pdn = <0>; };
  gpg0-2 { samsung,pins = "gpg0-2"; samsung,pin-con-pdn = <3>; samsung,pin-pud-pdn = <0>; };
  gpg0-3 { samsung,pins = "gpg0-3"; samsung,pin-con-pdn = <2>; samsung,pin-pud-pdn = <1>; };
  gpg0-4 { samsung,pins = "gpg0-4"; samsung,pin-con-pdn = <2>; samsung,pin-pud-pdn = <1>; };
  gpg0-5 { samsung,pins = "gpg0-5"; samsung,pin-con-pdn = <2>; samsung,pin-pud-pdn = <1>; };
  gpg0-6 { samsung,pins = "gpg0-6"; samsung,pin-con-pdn = <2>; samsung,pin-pud-pdn = <1>; };
  gpg0-7 { samsung,pins = "gpg0-7"; samsung,pin-con-pdn = <3>; samsung,pin-pud-pdn = <1>; };

  gpg1-0 { samsung,pins = "gpg1-0"; samsung,pin-con-pdn = <3>; samsung,pin-pud-pdn = <0>; };
  gpg1-1 { samsung,pins = "gpg1-1"; samsung,pin-con-pdn = <3>; samsung,pin-pud-pdn = <1>; };
  gpg1-2 { samsung,pins = "gpg1-2"; samsung,pin-con-pdn = <3>; samsung,pin-pud-pdn = <0>; };
  gpg1-3 { samsung,pins = "gpg1-3"; samsung,pin-con-pdn = <0>; samsung,pin-pud-pdn = <0>; };
  gpg1-4 { samsung,pins = "gpg1-4"; samsung,pin-con-pdn = <3>; samsung,pin-pud-pdn = <0>; };
  gpg1-5 { samsung,pins = "gpg1-5"; samsung,pin-con-pdn = <2>; samsung,pin-pud-pdn = <1>; };
  gpg1-6 { samsung,pins = "gpg1-6"; samsung,pin-con-pdn = <3>; samsung,pin-pud-pdn = <0>; };
  gpg1-7 { samsung,pins = "gpg1-7"; samsung,pin-con-pdn = <2>; samsung,pin-pud-pdn = <1>; };

  gpg2-0 { samsung,pins = "gpg2-0"; samsung,pin-con-pdn = <3>; samsung,pin-pud-pdn = <0>; };
  gpg2-1 { samsung,pins = "gpg2-1"; samsung,pin-con-pdn = <3>; samsung,pin-pud-pdn = <0>; };

  gpj4-0 { samsung,pins = "gpj4-0"; samsung,pin-con-pdn = <2>; samsung,pin-pud-pdn = <1>; };
  gpj4-1 { samsung,pins = "gpj4-1"; samsung,pin-con-pdn = <1>; samsung,pin-pud-pdn = <0>; };
  gpj4-2 { samsung,pins = "gpj4-2"; samsung,pin-con-pdn = <1>; samsung,pin-pud-pdn = <0>; };
  gpj4-3 { samsung,pins = "gpj4-3"; samsung,pin-con-pdn = <1>; samsung,pin-pud-pdn = <0>; };
 };
};

&pinctrl_3 {
 pinctrl-names = "sleep";
 pinctrl-0 = <&sleep3>;
sleep3: sleep-state {
  gpa0-0 { samsung,pins = "gpa0-0"; samsung,pin-con-pdn = <2>; samsung,pin-pud-pdn = <3>; };
  gpa0-1 { samsung,pins = "gpa0-1"; samsung,pin-con-pdn = <1>; samsung,pin-pud-pdn = <3>; };
  gpa0-2 { samsung,pins = "gpa0-2"; samsung,pin-con-pdn = <2>; samsung,pin-pud-pdn = <3>; };
  gpa0-3 { samsung,pins = "gpa0-3"; samsung,pin-con-pdn = <1>; samsung,pin-pud-pdn = <3>; };
  gpa0-4 { samsung,pins = "gpa0-4"; samsung,pin-con-pdn = <2>; samsung,pin-pud-pdn = <3>; };
  gpa0-5 { samsung,pins = "gpa0-5"; samsung,pin-con-pdn = <2>; samsung,pin-pud-pdn = <3>; };
  gpa0-6 { samsung,pins = "gpa0-6"; samsung,pin-con-pdn = <2>; samsung,pin-pud-pdn = <1>; };
  gpa0-7 { samsung,pins = "gpa0-7"; samsung,pin-con-pdn = <1>; samsung,pin-pud-pdn = <0>; };

  gpa1-0 { samsung,pins = "gpa1-0"; samsung,pin-con-pdn = <2>; samsung,pin-pud-pdn = <1>; };
  gpa1-1 { samsung,pins = "gpa1-1"; samsung,pin-con-pdn = <2>; samsung,pin-pud-pdn = <1>; };
  gpa1-2 { samsung,pins = "gpa1-2"; samsung,pin-con-pdn = <2>; samsung,pin-pud-pdn = <0>; };
  gpa1-3 { samsung,pins = "gpa1-3"; samsung,pin-con-pdn = <2>; samsung,pin-pud-pdn = <0>; };
  gpa1-4 { samsung,pins = "gpa1-4"; samsung,pin-con-pdn = <2>; samsung,pin-pud-pdn = <1>; };
  gpa1-5 { samsung,pins = "gpa1-5"; samsung,pin-con-pdn = <2>; samsung,pin-pud-pdn = <1>; };

  gpa2-0 { samsung,pins = "gpa2-0"; samsung,pin-con-pdn = <0>; samsung,pin-pud-pdn = <0>; };
  gpa2-1 { samsung,pins = "gpa2-1"; samsung,pin-con-pdn = <0>; samsung,pin-pud-pdn = <0>; };
  gpa2-2 { samsung,pins = "gpa2-2"; samsung,pin-con-pdn = <2>; samsung,pin-pud-pdn = <1>; };
  gpa2-3 { samsung,pins = "gpa2-3"; samsung,pin-con-pdn = <0>; samsung,pin-pud-pdn = <0>; };
  gpa2-4 { samsung,pins = "gpa2-4"; samsung,pin-con-pdn = <0>; samsung,pin-pud-pdn = <0>; };
  gpa2-5 { samsung,pins = "gpa2-5"; samsung,pin-con-pdn = <0>; samsung,pin-pud-pdn = <0>; };
  gpa2-6 { samsung,pins = "gpa2-6"; samsung,pin-con-pdn = <2>; samsung,pin-pud-pdn = <1>; };
  gpa2-7 { samsung,pins = "gpa2-7"; samsung,pin-con-pdn = <0>; samsung,pin-pud-pdn = <0>; };

  gpb0-0 { samsung,pins = "gpb0-0"; samsung,pin-con-pdn = <3>; samsung,pin-pud-pdn = <0>; };
  gpb0-1 { samsung,pins = "gpb0-1"; samsung,pin-con-pdn = <2>; samsung,pin-pud-pdn = <1>; };
  gpb0-2 { samsung,pins = "gpb0-2"; samsung,pin-con-pdn = <0>; samsung,pin-pud-pdn = <1>; };
  gpb0-3 { samsung,pins = "gpb0-3"; samsung,pin-con-pdn = <2>; samsung,pin-pud-pdn = <0>; };
  gpb0-4 { samsung,pins = "gpb0-4"; samsung,pin-con-pdn = <2>; samsung,pin-pud-pdn = <0>; };

  gpb1-0 { samsung,pins = "gpb1-0"; samsung,pin-con-pdn = <2>; samsung,pin-pud-pdn = <0>; };
  gpb1-1 { samsung,pins = "gpb1-1"; samsung,pin-con-pdn = <0>; samsung,pin-pud-pdn = <0>; };
  gpb1-2 { samsung,pins = "gpb1-2"; samsung,pin-con-pdn = <0>; samsung,pin-pud-pdn = <0>; };
  gpb1-3 { samsung,pins = "gpb1-3"; samsung,pin-con-pdn = <2>; samsung,pin-pud-pdn = <1>; };
  gpb1-4 { samsung,pins = "gpb1-4"; samsung,pin-con-pdn = <0>; samsung,pin-pud-pdn = <0>; };

  gpb2-0 { samsung,pins = "gpb2-0"; samsung,pin-con-pdn = <0>; samsung,pin-pud-pdn = <0>; };
  gpb2-1 { samsung,pins = "gpb2-1"; samsung,pin-con-pdn = <2>; samsung,pin-pud-pdn = <0>; };
  gpb2-2 { samsung,pins = "gpb2-2"; samsung,pin-con-pdn = <2>; samsung,pin-pud-pdn = <0>; };
  gpb2-3 { samsung,pins = "gpb2-3"; samsung,pin-con-pdn = <2>; samsung,pin-pud-pdn = <0>; };

  gpb3-2 { samsung,pins = "gpb3-2"; samsung,pin-con-pdn = <2>; samsung,pin-pud-pdn = <1>; };
  gpb3-3 { samsung,pins = "gpb3-3"; samsung,pin-con-pdn = <2>; samsung,pin-pud-pdn = <1>; };
  gpb3-4 { samsung,pins = "gpb3-4"; samsung,pin-con-pdn = <2>; samsung,pin-pud-pdn = <0>; };
  gpb3-5 { samsung,pins = "gpb3-5"; samsung,pin-con-pdn = <2>; samsung,pin-pud-pdn = <0>; };
  gpb3-6 { samsung,pins = "gpb3-6"; samsung,pin-con-pdn = <2>; samsung,pin-pud-pdn = <0>; };
  gpb3-7 { samsung,pins = "gpb3-7"; samsung,pin-con-pdn = <2>; samsung,pin-pud-pdn = <0>; };

  gpb4-0 { samsung,pins = "gpb4-0"; samsung,pin-con-pdn = <2>; samsung,pin-pud-pdn = <1>; };
  gpb4-1 { samsung,pins = "gpb4-1"; samsung,pin-con-pdn = <2>; samsung,pin-pud-pdn = <1>; };

  gph0-0 { samsung,pins = "gph0-0"; samsung,pin-con-pdn = <2>; samsung,pin-pud-pdn = <0>; };
  gph0-1 { samsung,pins = "gph0-1"; samsung,pin-con-pdn = <2>; samsung,pin-pud-pdn = <0>; };
  gph0-2 { samsung,pins = "gph0-2"; samsung,pin-con-pdn = <2>; samsung,pin-pud-pdn = <0>; };
  gph0-3 { samsung,pins = "gph0-3"; samsung,pin-con-pdn = <2>; samsung,pin-pud-pdn = <0>; };
  gph0-4 { samsung,pins = "gph0-4"; samsung,pin-con-pdn = <2>; samsung,pin-pud-pdn = <0>; };
  gph0-5 { samsung,pins = "gph0-5"; samsung,pin-con-pdn = <0>; samsung,pin-pud-pdn = <1>; };
  gph0-6 { samsung,pins = "gph0-6"; samsung,pin-con-pdn = <0>; samsung,pin-pud-pdn = <0>; };
  gph0-7 { samsung,pins = "gph0-7"; samsung,pin-con-pdn = <0>; samsung,pin-pud-pdn = <1>; };
 };
};
# 15 "arch/arm/boot/dts/exynos5422_evt0-k3g_common.dtsi" 2


/ {
 model = "Samsung universal5422 board based on EXYNOS5422";
 compatible = "samsung,universal5422", "samsung,exynos5422";

 memory {
  reg = <0x40000000 0x80000000>;
 };

 chosen {
  bootargs = "console=ttySAC2,115200 vmalloc=512M clk_ignore_unused";
 };

 fixed-rate-clocks {
  oscclk {
   compatible = "samsung,exynos5422-oscclk";
   clock-frequency = <24000000>;
  };
 };

 rtc {
  status = "okay";
 };

 dwmmc0@12200000 {
  status = "okay";
  num-slots = <1>;
  broken-cd;
  bypass-smu;
  fixed_volt;
  clock-gate;
  enable-cclk-on-suspend;
  only_once_tune;
  extra_tuning;
  supports-highspeed;
  supports-hs200-1-8v-mode;
  supports-ddr200-1-8v-mode;
  error-retry;
  enable-cache-control;
  supports-poweroff-notification;
  use-fine-tuning;
  supports-ddr200-enhanced-strobe;
  sw_data_timeout;
  fifo-depth = <0x40>;
  card-detect-delay = <200>;
  qos_int_level = <222000>;
  samsung,dw-mshc-ciu-div = <3>;
  samsung,dw-mshc-sdr-timing = <3 0 4 0>;
  samsung,dw-mshc-ddr-timing = <3 0 2 0>;
  samsung,dw-mshc-hs200-timing = <3 0 2 0>;
  samsung,dw-mshc-ddr200-timing = <1 1 2 0>;
  clk_pin = "gpc0-0";
  clk_addr = "13410000.pinctrl";
  clk_val = <0x3>;
  clk_str_num = <4>;
  num-ref-clks = <8>;
  ciu_clkin = <20812500 41625000 41625000 83250000 166500000 83250000 166500000 333000000>;
  pinctrl-names = "default";
  pinctrl-0 = <&sd0_clk &sd0_cmd &sd0_rdqs &sd0_bus1 &sd0_bus4 &sd0_bus8>;

  slot@0 {
   reg = <0>;
   bus-width = <8>;
  };
 };

 dwmmc1@12210000 {
  status = "okay";
  num-slots = <1>;
  channel = <1>;
  bypass-smu;
  clock-gate;
  caps-control;
  use-fine-tuning;
  ignore-phase = <(1 << 7)>;
  sw-timeout = <1000>;
  enable-cclk-on-suspend;
  fixed_volt;
  supports-highspeed;
  sw_data_timeout;
  supports-sdr104-mode;
  keep-power-in-suspend;
  pm-ignore-notify;
  cd-type-external;
  cd-type = <2>;
  use-broken-voltage;
  fifo-depth = <0x40>;
  card-detect-delay = <200>;
  qos_int_level = <222000>;
  samsung,dw-mshc-ciu-div = <3>;
  samsung,dw-mshc-sdr-timing = <3 0 2 0>;
  samsung,dw-mshc-ddr-timing = <3 0 2 0>;
  clk_pin = "gpc1-0";
  clk_addr = "13410000.pinctrl";
  clk_val = <0x3>;
  clk_str_num = <4>;
  num-ref-clks = <8>;
  ciu_clkin = <25000000 50000000 50000000 100000000 200000000 100000000 200000000 400000000>;
  tp_mon_depth = <3>;

  tp_mon_table = <18000000 825000 2000000 1500000
    12000000 413000 0 0
    0 0 0 0>;
  pinctrl-names = "default";

  pinctrl-0 = <&sd1_clk &sd1_cmd &sd1_bus1 &sd1_bus4 &cfg_wlanen &cfg_wlanhostwake>;

  slot@0 {
   reg = <0>;
   bus-width = <4>;
  };
 };


 dwmmc2@12220000 {
  status = "okay";
  num-slots = <1>;
  supports-highspeed;
  clock-gate;
  enable-cclk-on-suspend;
  sw_data_timeout;
                use-cpu-mode-tuning;
  use-fine-tuning;
  ignore-phase = <(1 << 7)>;
  fifo-depth = <0x40>;
  card-detect-delay = <200>;
  qos_int_level = <222000>;
  samsung,dw-mshc-ciu-div = <3>;
  samsung,dw-mshc-sdr-timing = <3 0 4 0>;
  samsung,dw-mshc-ddr-timing = <3 0 2 0>;
  clk_pin = "gpc2-0";
  clk_addr = "13410000.pinctrl";
  clk_val = <0x1>;
  clk_str_num = <4>;
  num-ref-clks = <8>;
  ciu_clkin = <20812500 41625000 41625000 83250000 166500000 83250000 166500000 333000000>;
  pinctrl-names = "default", "output";
  pinctrl-0 = <&sd2_clk &sd2_cmd &sd2_bus1 &sd2_bus4 &dwmmc2_cd_irq>;
  pinctrl-1 = <&sd2_clk_output &sd2_cmd_output &sd2_bus1 &sd2_bus4 &dwmmc2_cd_irq>;

  gpio-controller;
  #gpio-cells = <2>;
  cd-gpio = <&gpx2 4 0xf>;

  slot@0 {
   reg = <0>;
   bus-width = <4>;
   disable-wp;
  };
 };

 pinctrl@13400000 {
  pmic_irq: pmic-irq {
   samsung,pins = "gpx0-7";
   samsung,pin-pud = <3>;
   samsung,pin-drv = <3>;
  };

  hall_irq: hall-irq {
   samsung,pins = "gpx0-1";
   samsung,pin-function = <0xf>;
   samsung,pin-pud = <0>;
   samsung,pin-drv = <0>;
  };

  irda_irq: irda-irq {
   samsung,pins = "gpx0-4";
   samsung,pin-function = <0>;
   samsung,pin-pud = <0>;
   samsung,pin-drv = <0>;
  };

  mfd_irq: mfd-irq {
   samsung,pins = "gpx1-4";
   samsung,pin-function = <0>;
   samsung,pin-pud = <0>;
   samsung,pin-drv = <0>;
  };

  fuel_irq: fuel-irq {
   samsung,pins = "gpx1-5";
   samsung,pin-function = <0>;
   samsung,pin-pud = <0>;
   samsung,pin-drv = <0>;
  };

  ssp_ap_int: ssp-ap-int {
   samsung,pins = "gpx3-0";
   samsung,pin-function = <0>;
   samsung,pin-pud = <3>;
   samsung,pin-drv = <3>;
  };

  hrm_int: hrm-int {
   samsung,pins = "gpx3-1";
   samsung,pin-function = <0>;
   samsung,pin-pud = <0>;
   samsung,pin-drv = <3>;
  };

  ssp_irq: ssp-irq {
   samsung,pins = "gpx3-3";
   samsung,pin-function = <0>;
   samsung,pin-pud = <3>;
   samsung,pin-drv = <3>;
  };
  ssp_irq2: ssp-irq2 {
   samsung,pins = "gpx3-4";
   samsung,pin-function = <0>;
   samsung,pin-pud = <3>;
   samsung,pin-drv = <3>;
  };


  cfg_irq: cfg-irq {
   samsung,pins = "gpy7-1";
   samsung,pin-function = <0xf>;
   samsung,pin-pud = <0>;
   samsung,pin-drv = <0>;
  };
  cfg_input: cfg-input {
   samsung,pins = "gpy7-1";
   samsung,pin-function = <0>;
   samsung,pin-pud = <1>;
   samsung,pin-drv = <0>;
  };
  dwmmc2_cd_irq: dwmmc2-cd-irq {
   samsung,pins = "gpx2-4";
   samsung,pin-function = <0xf>;
   samsung,pin-pud = <3>;
   samsung,pin-drv = <3>;
  };
 };

 pinctrl@13410000 {

  cfg_i2c: cfg-i2c {
   samsung,pins = "gpd1-5", "gpd1-4";
   samsung,pin-function = <3>;
   samsung,pin-pud = <0>;
   samsung,pin-drv = <0>;
  };
  cfg_gpio: cfg_gpio {
   samsung,pins = "gpd1-5", "gpd1-4";
   samsung,pin-function = <0>;
   samsung,pin-pud = <0>;
   samsung,pin-drv = <0>;
  };
  pm_wrsti: pm-wrsti {
   samsung,pins = "gpy3-0";
   samsung,pin-con-pdn = <3>;
  };
 };

 hsi2c@12CD0000 {
  clock-frequency = <400000>;
  status = "okay";

  s2mps11_pmic@66 {
   compatible = "samsung,s2mps11-pmic";
   reg = <0x66>;
   interrupts = <7 0 0>;
   interrupt-parent = <&gpx0>;
   pinctrl-names = "default";
   pinctrl-0 = <&pmic_irq &pm_wrsti>;

   wtsr_en = <1>;
   smpl_en = <1>;
   wtsr_timer_val = <3>;
   smpl_timer_val = <0>;
   check_jigon = <0>;

   init_time,sec = <0>;
   init_time,min = <0>;
   init_time,hour = <12>;
   init_time,mday = <1>;
   init_time,mon = <0>;
   init_time,year = <114>;
   init_time,wday = <3>;

   regulators {
    buck1_reg: BUCK1 {
     regulator-name = "vdd_mif";
     regulator-min-microvolt = <700000>;
     regulator-max-microvolt = <1300000>;
     regulator-always-on;
     regulator-boot-on;
     regulator-ramp-delay = <12000>;
     regulator-initial-mode = <1>;
    };

    buck2_reg: BUCK2 {
     regulator-name = "vdd_eagle";
     regulator-min-microvolt = <800000>;
     regulator-max-microvolt = <1500000>;
     regulator-always-on;
     regulator-boot-on;
     regulator-ramp-delay = <12000>;
     regulator-initial-mode = <1>;
    };

    buck3_reg: BUCK3 {
     regulator-name = "vdd_int";
     regulator-min-microvolt = <800000>;
     regulator-max-microvolt = <1400000>;
     regulator-always-on;
     regulator-boot-on;
     regulator-ramp-delay = <12000>;
     regulator-initial-mode = <1>;
    };

    buck4_reg: BUCK4 {
     regulator-name = "vdd_g3d";
     regulator-min-microvolt = <700000>;
     regulator-max-microvolt = <1400000>;
     regulator-always-on;
     regulator-boot-on;
     regulator-ramp-delay = <12000>;
     regulator-initial-mode = <1>;
    };

    buck6_reg: BUCK6 {
     regulator-name = "vdd_kfc";
     regulator-min-microvolt = <800000>;
     regulator-max-microvolt = <1500000>;
     regulator-always-on;
     regulator-boot-on;
     regulator-ramp-delay = <12000>;
     regulator-initial-mode = <1>;
    };

    buck10_reg: BUCK10 {
     regulator-name = "vdd_cam_isp_1.0v";
     regulator-min-microvolt = <750000>;
     regulator-max-microvolt = <1500000>;
     regulator-always-on;
     regulator-boot-on;
     regulator-ramp-delay = <12000>;
     regulator-initial-mode = <1>;
    };

    ldo6_reg: LDO6 {
     regulator-name = "vdd_ldo6";
     regulator-min-microvolt = <1000000>;
     regulator-max-microvolt = <1000000>;
     regulator-always-on;
     regulator-initial-mode = <1>;
    };

    ldo7_reg: LDO7 {
     regulator-name = "vdd_ldo7";
     regulator-min-microvolt = <1800000>;
     regulator-max-microvolt = <1800000>;
     regulator-always-on;
     regulator-initial-mode = <1>;
    };

    ldo13_reg: LDO13 {
     regulator-name = "vqmmc";
     regulator-min-microvolt = <1800000>;
     regulator-max-microvolt = <3300000>;
     regulator-boot-on;
     regulator-ramp-delay = <12000>;
     regulator-initial-mode = <1>;
    };

    ldo14_reg: LDO14 {
     regulator-name = "vcc_3.0v_motor";
     regulator-min-microvolt = <3000000>;
     regulator-max-microvolt = <3000000>;
     regulator-initial-mode = <3>;
    };

    ldo15_reg: LDO15 {
     regulator-name = "VT_CAM_2.8V";
     regulator-min-microvolt = <2800000>;
     regulator-max-microvolt = <2800000>;
    };

    ldo17_reg: LDO17 {
     regulator-name = "IR_3.3V_AP";
     regulator-min-microvolt = <3300000>;
     regulator-max-microvolt = <3300000>;
     regulator-initial-mode = <3>;
    };

    ldo18_reg: LDO18 {
     regulator-name = "vdd_ldo18";
     regulator-min-microvolt = <1800000>;
     regulator-max-microvolt = <1800000>;
     regulator-always-on;
     regulator-initial-mode = <3>;
    };

    ldo19_reg: LDO19 {
     regulator-name = "vmmc";
     regulator-min-microvolt = <1800000>;
     regulator-max-microvolt = <2850000>;
     regulator-boot-on;
     regulator-initial-mode = <1>;
    };

    ldo20_reg: LDO20 {
     regulator-name = "VT_CAM_1.8V";
     regulator-min-microvolt = <1800000>;
     regulator-max-microvolt = <1800000>;
    };

    ldo21_reg: LDO21 {
     regulator-name = "CAM_IO_1.8V_AP";
     regulator-min-microvolt = <1800000>;
     regulator-max-microvolt = <1800000>;
    };

    ldo22_reg: LDO22 {
     regulator-name = "CAM_SEN_CORE_1.2V_AP";
     regulator-min-microvolt = <1200000>;
     regulator-max-microvolt = <1200000>;
    };

    ldo23_reg: LDO23 {
     regulator-name = "vdd_mifs";
     regulator-min-microvolt = <800000>;
     regulator-max-microvolt = <1100000>;
     regulator-always-on;
     regulator-initial-mode = <1>;
     regulator-ramp-delay = <12000>;
    };

    ldo24_reg: LDO24 {
     regulator-name = "HRM_3.3V_AP";
     regulator-min-microvolt = <3300000>;
     regulator-max-microvolt = <3300000>;
    };

    ldo25_reg: LDO25 {
     regulator-name = "vdd_ldo25";
     regulator-min-microvolt = <1800000>;
     regulator-max-microvolt = <1800000>;
     regulator-boot-on;
     regulator-initial-mode = <3>;
    };

    ldo26_reg: LDO26 {
     regulator-name = "CAM_AF_2.8V_AP";
     regulator-min-microvolt = <2800000>;
     regulator-max-microvolt = <2800000>;
    };

    ldo27_reg: LDO27 {
     regulator-name = "vdd_g3ds";
     regulator-min-microvolt = <800000>;
     regulator-max-microvolt = <1100000>;
     regulator-always-on;
     regulator-initial-mode = <1>;
     regulator-ramp-delay = <12000>;
    };

    ldo28_reg: LDO28 {
     regulator-name = "vdd_ldo28";
     regulator-min-microvolt = <3000000>;
     regulator-max-microvolt = <3000000>;
     regulator-boot-on;
     regulator-initial-mode = <3>;
    };


    ldo30_reg: LDO30 {
     regulator-name = "vtouch_1.8v";
     regulator-min-microvolt = <1800000>;
     regulator-max-microvolt = <1800000>;
    };

    ldo31_reg: LDO31 {
     regulator-name = "VDDA_1.8V_COMP";
     regulator-min-microvolt = <1800000>;
     regulator-max-microvolt = <1800000>;
    };

    ldo32_reg: LDO32 {
     regulator-name = "tsp_io";
     regulator-min-microvolt = <1800000>;
     regulator-max-microvolt = <1800000>;
    };

    ldo33_reg: LDO33 {
     regulator-name = "VCC_1.8V_MHL";
     regulator-min-microvolt = <1800000>;
     regulator-max-microvolt = <1800000>;
    };

    ldo34_reg: LDO34 {
     regulator-name = "VCC_3.3V_MHL";
     regulator-min-microvolt = <3300000>;
     regulator-max-microvolt = <3300000>;
    };

    ldo35_reg: LDO35 {
     regulator-name = "VSIL_1.2A";
     regulator-min-microvolt = <1200000>;
     regulator-max-microvolt = <1200000>;
    };

    ldo38_reg: LDO38 {
     regulator-name = "vtouch_3.3v";
     regulator-min-microvolt = <3300000>;
     regulator-max-microvolt = <3300000>;
    };
   };
  };
 };

 i2c@20{
  compatible = "i2c-gpio";
  gpios = <&gpd1 4 0
    &gpd1 5 0
    >;
  i2c-gpio,delay-us = <2>;
  #address-cells = <1>;
  #size-cells = <0>;
  status = "okay";

  cypress@20 {
   compatible = "cypress,cypress_touchkey";
   pinctrl-names = "on_irq","off_irq","on_i2c","off_i2c";
   pinctrl-0 = <&cfg_irq>;
   pinctrl-1 = <&cfg_input>;
   pinctrl-2 = <&cfg_i2c>;
   pinctrl-3 = <&cfg_gpio>;
   reg = <0x20>;
   interrupts = <1 0 0>;
   interrupt-parent = <&gpy7>;
   cypress,sda-gpio = <&gpd1 4 0>;
   cypress,scl-gpio = <&gpd1 5 0>;
   cypress,irq-gpio = <&gpy7 1 1>;
   cypress,i2c-gpio = "true";
   cypress,ic-stabilizing-time = <50>;
   cypress,multi-touchkey-fw-version = <0x1c>;
  };
 };

 i2c@30 {
  compatible = "i2c-gpio";
  gpios = <&gpy3 6 0
   &gpy3 7 0
   >;
  i2c-gpio,delay-us = <2>;
  #address-cells = <1>;
  #size-cells = <0>;
  status = "okay";

  lp5562@30 {
   compatible = "ti,lp5562";
   reg = <0x30>;
   label = "lp5562_pri";
   clock-mode = /bits/ 8 <2>;

   chan0 {
    chan-name = "R";
    led-cur = /bits/ 8 <0x40>;
    max-cur = /bits/ 8 <0x40>;
   };

   chan1 {
    chan-name = "G";
    led-cur = /bits/ 8 <0x40>;
    max-cur = /bits/ 8 <0x40>;
   };

   chan2 {
    chan-name = "B";
    led-cur = /bits/ 8 <0x40>;
    max-cur = /bits/ 8 <0x40>;
   };

   chan3 {
    chan-name = "W";
    led-cur = /bits/ 8 <0x20>;
    max-cur = /bits/ 8 <0x40>;
   };
  };

 };

 lp5562_pattern_data {

  pattern_arr_size = <6>;


  dataset0 {
   num = <0>;
   type = "r";
   size = <2>;
   data = /bits/ 8 <0x40 0xFF>;
  };

  dataset1 {
   num = <1>;
   type = "r";
   size = <8>;
   data = /bits/ 8 <0x40 0x00 0x60 0x00
     0x40 0xFF 0x60 0x00>;
  };

  dataset2 {
   num = <2>;
   type = "b";
   size = <10>;
   data = /bits/ 8 <0x40 0x00 0x60 0x00
     0xA4 0xA1 0x40 0xFF
     0x60 0x00>;
  };

  dataset3 {
   num = <3>;
   type = "r";
   size = <10>;
   data = /bits/ 8 <0x40 0x00 0x60 0x00
     0xA4 0xA1 0x40 0xFF
     0x60 0x00>;
  };

  dataset4 {
   num = <4>;
   type = "g";
   size = <2>;
   data = /bits/ 8 <0x40 0xFF>;
  };

  dataset5 {
   num = <5>;
   type = "g";
   size = <18>;
   data = /bits/ 8 <0x40 0x11 0x0B 0x7A
     0x40 0x8C 0x55 0x00
     0xE0 0x08 0x0B 0xFA
     0x40 0x11 0x55 0x00
     0xE0 0x08>;
  };

  dataset6 {
   num = <5>;
   type = "b";
   size = <18>;
   data = /bits/ 8 <0x40 0xCC 0x1B 0x32
     0x40 0xFF 0x55 0x00
     0xE1 0x00 0x1B 0xB2
     0x40 0xCC 0x55 0x00
     0xE1 0x00>;
  };
 };

 i2c@6c {
  compatible = "i2c-gpio";
  gpios = <&gpb1 0 0
   &gph0 4 0
   >;
  i2c-gpio,delay-us = <2>;
  #address-cells = <1>;
  #size-cells = <0>;
  status = "okay";
  ice40lm@6c {
   compatible = "lattice,ice40lm";
   reg = <0x6c>;
   ice40lm,creset_b = <&gpj4 2 0>;
   ice40lm,cdone = <&gpg0 2 0>;
   ice40lm,irda_irq = <&gpx0 4 0>;
   ice40lm,spi_si_sda = <&gpb1 0 0>;
   ice40lm,spi_clk_scl = <&gph0 4 0>;
   ice40lm,spi_en_rstn = <&gpy7 0 0>;
   ice40lm,power = "REG";
   ice40lm,regulator_name = "IR_3.3V_AP";
   clocks = <&clock 4200>;
   clock-names = "clk_out";
  };
 };

 pinctrl@14010000 {
  i2c3_bus: i2c3-bus {
   samsung,pin-pud = <0>;
  };

  health_cover: health_cover {
   samsung,pins = "gpb0-2";
   samsung,pin-function = <2>;
   samsung,pin-pud = <0>;
   samsung,pin-drv = <0>;
  };

  vibetonz_pwm: vibetonz_pwm {
   samsung,pins = "gpb2-0";
   samsung,pin-function = <2>;
   samsung,pin-pud = <0>;
   samsung,pin-drv = <0>;
  };

  hs_i2c3_bus: hs-i2c3-bus {
    samsung,pins = "gpb2-3", "gpb2-2";
    samsung,pin-function = <3>;
    samsung,pin-pud = <0>;
    samsung,pin-drv = <0>;
  };

  hs_i2c5_bus: hs-i2c5-bus {
   samsung,pins = "gpb3-7", "gpb3-6";
   samsung,pin-function = <2>;
   samsung,pin-pud = <0>;
   samsung,pin-drv = <0>;
  };

  fimc_is_ch0_mclk: fimc-is-ch0_mclk {
   samsung,pin-drv = <2>;
  };

  fimc_is_ch0_mclk_off: fimc-is-ch0_mclk_off {
   samsung,pins = "gph0-5";
   samsung,pin-function = <1>;
   samsung,pin-pud = <1>;
   samsung,pin-drv = <0>;
  };

  fimc_is_ch2_mclk: fimc-is-ch2-mclk {
   samsung,pin-drv = <2>;
  };

  fimc_is_ch2_mclk_off: fimc-is-ch2_mclk_off {
   samsung,pins = "gph0-7";
   samsung,pin-function = <1>;
   samsung,pin-pud = <1>;
   samsung,pin-drv = <0>;
  };
 };

 hsi2c@12E10000 {
  samsung,hs-mode;
  clock-frequency = <400000>;
  status = "okay";

  max77804@66 {
   compatible = "maxim,max77804";
   reg = <0x66>;
   pinctrl-names = "default";
   pinctrl-0 = <&mfd_irq &vibetonz_pwm>;
   max77804,irq-gpio = <&gpx1 4 0>;
   max77804,irqf-trigger = "falling_edge";
   max77804,wakeup;

   regulators {
    safeout1: ESAFEOUT1 {
     regulator-compatible = "safeout1";
     regulator-name = "safeout1_range";
     regulator-min-microvolt = <3300000>;
     regulator-max-microvolt = <4900000>;
     regulator-boot-on;
    };

    safeout2: ESAFEOUT2 {
     regulator-compatible = "safeout2";
     regulator-name = "safeout2_range";
     regulator-min-microvolt = <3300000>;
     regulator-max-microvolt = <4900000>;
    };
   };
  };
 };

 i2c_8: i2c@13130000 {
  compatible = "samsung,exynos5430-fimc-i2c";
  reg = <0x13130000 0x1000>;
  interrupt-parent = <&combiner>;
  interrupts = <19 4>;
  #address-cells = <1>;
  #size-cells = <0>;
  pinctrl-names = "default";
  pinctrl-0 = <&fimc_is_i2c_0>;
  clocks = <&clock 4171>, <&clock 4171>;
  clock-names = "rate_i2c","gate_i2c";
  samsung,i2c-sda-delay = <100>;
  samsung,i2c-max-bus-freq = <400000>;
  status = "okay";

  fimc_is_i2c0@3d {
   compatible = "samsung,fimc_is_i2c0";
   reg = <0x3d>;
  };
 };


 i2c@12C70000 {
  status = "okay";
  samsung,i2c-sda-delay = <100>;
  samsung,i2c-max-bus-freq = <400000>;
  status = "okay";
  fimc-is-vision@20 {
   compatible = "samsung,exynos5-fimc-is-sensor-8b1";
   reg = <0x35>;
  };
 };

        i2c@60{
                compatible = "i2c-gpio";
                gpios = <&gpg0 5 0
                          &gpg0 4 0
                          >;
                i2c-gpio,delay-us = <2>;
                #address-cells = <1>;
                #size-cells = <0>;
                status = "okay";

                fimc_is_fan53555@60 {
                        compatible = "samsung,fimc_is_fan53555";
                        reg = <0x60>;
                        comp_en = <&gpe0 5 0>;
                };
        };

 pinctrl@13410000 {
  svc_i2c: svc_i2c {
   samsung,pins = "gpy3-7", "gpy3-6";
   samsung,pin-function = <0>;
   samsung,pin-pud = <0>;
   samsung,pin-drv = <0>;
  };
 };

 pinctrl@14000000 {
  disp_pcd: disp_pcd {
   samsung,pins = "gpg0-6";
   samsung,pin-function = <0>;
   samsung,pin-pud = <1>;
  };
 };

 pinctrl@14010000 {
  disp_errfg: disp_errfg {
   samsung,pins = "gpb0-1";
   samsung,pin-function = <0>;
   samsung,pin-pud = <1>;
  };
 };


 fimd_fb: fimd_fb {
  LCD18V-supply = <&ldo25_reg>;
  LCD30V-supply = <&ldo28_reg>;
  oled-id-gpio = <&gpd1 3 0x0>;
  oled-pcd-gpio = <&gpg0 6 0x0>;
  oled-errfg-gpio = <&gpb0 1 0x0>;
  lcd_info = <&s6e3fa2>;
  gpios = <&gpd1 7 0xf>;

  pinctrl-names = "default", "turnon_tes", "turnoff_tes";
  pinctrl-0 = <&disp_pcd &disp_errfg>;
  pinctrl-1 = <&disp_teson>;
  pinctrl-2 = <&disp_tesoff>;

  fimd: fimd_ctrl {
   samsung,left_margin = <10>;
   samsung,right_margin = <10>;
   samsung,upper_margin = <4>;
   samsung,lower_margin = <3>;
   samsung,hsync_len = <10>;
   samsung,vsync_len = <1>;
   samsung,xres = <1080>;
   samsung,yres = <1920>;
   samsung,virtual_x = <1080>;
   samsung,virtual_y = <3840>;
   samsung,width = <65>;
   samsung,height = <115>;
   samsung,max_bpp = <32>;
   samsung,default_bpp = <24>;

   fb_driver_data {
    fb_win_variant_0 {
     has_osd_c = <1>;
     has_osd_d = <0>;
     has_osd_alpha = <0>;
     osd_size_off = <0x08>;
     palette_size = <256>;
     VALID_BPP_1248 = <1>;
     VALID_BPP_13 = <1>;
     VALID_BPP_15 = <1>;
     VALID_BPP_16 = <1>;
     VALID_BPP_18 = <1>;
     VALID_BPP_19 = <1>;
     VALID_BPP_24 = <1>;
     VALID_BPP_25 = <1>;
     VALID_BPP_32 = <1>;
    };
    fb_win_variant_1 {
     has_osd_c = <1>;
     has_osd_d = <1>;
     has_osd_alpha = <1>;
     osd_size_off = <0x0c>;
     palette_size = <256>;
     VALID_BPP_1248 = <1>;
     VALID_BPP_13 = <1>;
     VALID_BPP_15 = <1>;
     VALID_BPP_16 = <1>;
     VALID_BPP_18 = <1>;
     VALID_BPP_19 = <1>;
     VALID_BPP_24 = <1>;
     VALID_BPP_25 = <1>;
     VALID_BPP_32 = <1>;
    };
    fb_win_variant_2 {
     has_osd_c = <1>;
     has_osd_d = <1>;
     has_osd_alpha = <1>;
     osd_size_off = <0x0c>;
     palette_size = <256>;
     VALID_BPP_1248 = <1>;
     VALID_BPP_13 = <1>;
     VALID_BPP_15 = <1>;
     VALID_BPP_16 = <1>;
     VALID_BPP_18 = <1>;
     VALID_BPP_19 = <1>;
     VALID_BPP_24 = <1>;
     VALID_BPP_25 = <1>;
     VALID_BPP_32 = <1>;
    };
    fb_win_variant_3 {
     has_osd_c = <1>;
     has_osd_d = <0>;
     has_osd_alpha = <1>;
     osd_size_off = <0x0>;
     palette_size = <256>;
     VALID_BPP_1248 = <1>;
     VALID_BPP_13 = <1>;
     VALID_BPP_15 = <1>;
     VALID_BPP_16 = <1>;
     VALID_BPP_18 = <1>;
     VALID_BPP_19 = <1>;
     VALID_BPP_24 = <1>;
     VALID_BPP_25 = <1>;
     VALID_BPP_32 = <1>;
    };
    fb_win_variant_4 {
     has_osd_c = <1>;
     has_osd_d = <0>;
     has_osd_alpha = <1>;
     osd_size_off = <0x0>;
     palette_size = <256>;
     VALID_BPP_1248 = <1>;
     VALID_BPP_13 = <1>;
     VALID_BPP_15 = <1>;
     VALID_BPP_16 = <1>;
     VALID_BPP_18 = <1>;
     VALID_BPP_19 = <1>;
     VALID_BPP_24 = <1>;
     VALID_BPP_25 = <1>;
     VALID_BPP_32 = <1>;
    };
   };
  };
  mipi_dsi: mipi_dsi {
   gpios = <&gpy7 4 0x1>, <&gpy3 2 0x1>, <&gpb0 0 0x1>;

   interrupt-parent = <&gic>;
   interrupts = <0 82 0>;


   e_interface = <0>;
# 988 "arch/arm/boot/dts/exynos5422_evt0-k3g_common.dtsi"
   e_pixel_format = <7>;


   auto_flush = <0>;
   eot_disable = <1>;
   auto_vertical_cnt = <0>;
   hse = <0>;
   hfp = <0>;
   hbp = <0>;
   hsa = <0>;





   e_no_data_lane = <3>;



   e_byte_clk = <0>;




   e_burst_mode = <1>;






   p = <3>;
   m = <56>;
   s = <0>;

   pll_stable_time = <23000>;

   esc_clk = <16000000>;

   stop_holding_cnt = <10>;

   bta_timeout = <0xff>;

   rx_timeout = <0xffff>;
  };
  s6e3fa2: s6e3fa2_fhd {
   mode = <0>;
   resolution = <1080 1920>;
   size = <65 115>;
   timing,refresh = <60>;
   timing,h-porch = <10 10 10>;
   timing,v-porch = <4 3 1>;
   timing,dsi-hs-clk = <896>;
   timing,dsi-escape-clk = <19>;
   mic = <1>;
  };
  decon_mic: decon_mic {
   sysreg1 = <0x10050214>;
  };
 };

 spi_3: spi@131a0000 {
  #address-cells = <1>;
  #size-cells = <0>;

  num-cs = <2>;

  fimc_is_spi_0@0 {
   compatible = "samsung,fimc_is_spi0";
   spi-max-frequency = <50000000>;
   reg = <0x0>;

   controller-data {
    cs-gpio = <&gpe0 6 0>;
    samsung,spi-feedback-delay = <2>;
   };
  };

  fimc_is_spi_1@1 {
   compatible = "samsung,fimc_is_spi1";
   fimc_is_spi_sclk = "gpf1-0";
   fimc_is_spi_ssn = "gpf1-1";
   fimc_is_spi_miso = "gpf1-2";
   fimc_is_spi_mois = "gpf1-3";
   spi-max-frequency = <50000000>;
   reg = <0x1>;
   pinctrl-names = "default";
   pinctrl-0 = <&fimc_is_comp_int>;

   controller-data {
    cs-gpio = <&gpf1 1 0>;
    samsung,spi-feedback-delay = <2>;
   };
  };
 };


 fimc_is_companion: fimc_is_companion@13180000 {
  compatible = "samsung,exynos5-fimc-is-companion";
  pinctrl-names = "default", "ch0", "af0", "off0";
  pinctrl-0 = <&fimc_is_ch0_mclk_off>;
  pinctrl-1 = <&fimc_is_ch0_mclk>;
  pinctrl-2 = <&fimc_is_ch0_mclk &fimc_is_ch1_i2c>;
  pinctrl-3 = <&fimc_is_ch0_mclk_off>;

  scenario = <0>;
  mclk_ch = <0>;
  sensor_id = <10>;

  gpio_reset = <&gpe0 4 0x1>;
  gpios_cam_en = <&gpd1 6 0x1>;
  gpios_comp_en = <&gpe0 5 0x1>;
  gpios_comp_reset = <&gpd1 0 0x1>;

  status = "okay";
 };


 fimc_is_sensor0: fimc_is_sensor@13C00000 {
  scenario = <0>;
  gpio_reset = <&gpe0 4 0x1>;
  gpios_cam_en = <&gpd1 6 0x1>;
  id = <0>;
  mclk_ch = <0>;
  csi_ch = <0>;
  flite_ch = <0>;
  i2c_ch = <0x100>;
  i2c_addr = <0x5A5A>;
  flash_first_gpio = <1>;
  flash_second_gpio = <2>;
  sensor_name = "2p2";
  sensor_id = <10>;
  is_bns = <1>;
  status = "okay";
 };


 fimc_is_sensor1: fimc_is_sensor@13C10000 {
  pinctrl-names ="default", "ch1", "off1";
  pinctrl-0 = <&fimc_is_ch2_mclk_off>;
  pinctrl-1 = <&fimc_is_ch2_i2c &fimc_is_ch2_mclk>;
  pinctrl-2 = <&fimc_is_ch2_mclk_off>;

  scenario = <0>;
  gpio_reset = <&gpe0 3 0x1>;
  gpio_standby = <&gpe0 0 0x1>;
  gpios_cam_en = <&gpd1 2 0x1>;
  id = <1>;
  mclk_ch = <2>;
  csi_ch = <1>;
  flite_ch = <1>;
  i2c_ch = <0x2>;
  i2c_addr = <0x6A>;
  sensor_name = "8b1";
  sensor_id = <11>;
  is_bns = <0>;
  status = "okay";
 };


 fimc_is@13000000 {
  companion_spi_channel = <0>;
  use_vision = <1>;
  fimc_is_dvfs {
   default_int = <600000>;
   default_cam = <666000>;
   default_mif = <825000>;
   default_i2c = <0>;

   front_preview_int = <460000>;
   front_preview_cam = <333000>;
   front_preview_mif = <413000>;
   front_preview_i2c = <0>;

   front_capture_int = <460000>;
   front_capture_cam = <333000>;
   front_capture_mif = <413000>;
   front_capture_i2c = <0>;

   front_camcording_int = <460000>;
   front_camcording_cam = <333000>;
   front_camcording_mif = <413000>;
   front_camcording_i2c = <0>;

   front_vt1_int = <460000>;
   front_vt1_cam = <333000>;
   front_vt1_mif = <413000>;
   front_vt1_i2c = <0>;

   front_vt2_int = <460000>;
   front_vt2_cam = <333000>;
   front_vt2_mif = <413000>;
   front_vt2_i2c = <0>;

   rear_preview_fhd_int = <500000>;
   rear_preview_fhd_cam = <222000>;
   rear_preview_fhd_mif = <633000>;
   rear_preview_fhd_i2c = <0>;

   rear_preview_whd_int = <500000>;
   rear_preview_whd_cam = <444000>;
   rear_preview_whd_mif = <633000>;
   rear_preview_whd_i2c = <0>;

   rear_preview_uhd_int = <600000>;
   rear_preview_uhd_cam = <666000>;
   rear_preview_uhd_mif = <825000>;
   rear_preview_uhd_i2c = <0>;

   rear_capture_int = <600000>;
   rear_capture_cam = <666000>;
   rear_capture_mif = <825000>;
   rear_capture_i2c = <0>;

   rear_camcording_fhd_int = <500000>;
   rear_camcording_fhd_cam = <444000>;
   rear_camcording_fhd_mif = <543000>;
   rear_camcording_fhd_i2c = <0>;

   rear_camcording_whd_int = <500000>;
   rear_camcording_whd_cam = <444000>;
   rear_camcording_whd_mif = <633000>;
   rear_camcording_whd_i2c = <0>;

   rear_camcording_uhd_int = <600000>;
   rear_camcording_uhd_cam = <666000>;
   rear_camcording_uhd_mif = <825000>;
   rear_camcording_uhd_i2c = <0>;

   dual_preview_int = <600000>;
   dual_preview_cam = <333000>;
   dual_preview_mif = <825000>;
   dual_preview_i2c = <0>;

   dual_capture_int = <600000>;
   dual_capture_cam = <666000>;
   dual_capture_mif = <825000>;
   dual_capture_i2c = <0>;

   dual_camcording_int = <600000>;
   dual_camcording_cam = <333000>;
   dual_camcording_mif = <825000>;
   dual_camcording_i2c = <0>;

   high_speed_fps_int = <600000>;
   high_speed_fps_cam = <666000>;
   high_speed_fps_mif = <825000>;
   high_speed_fps_i2c = <0>;

   dis_enable_int = <600000>;
   dis_enable_cam = <666000>;
   dis_enable_mif = <825000>;
   dis_enable_i2c = <0>;

   max_int = <600000>;
   max_cam = <666000>;
   max_mif = <825000>;
   max_i2c = <0>;
  };
 };

 pinctrl@13400000 {

  fimc_is_vt_cam_id: fimc_is_vt_cam_id {
   samsung,pins = "gpy7-2";
   samsung,pin-function = <0>;
   samsung,pin-pud = <0>;
   samsung,pin-drv = <0>;
  };

  fimc_is_main_cam_det: fimc_is_main_cam_det {
   samsung,pins = "gpy7-3";
   samsung,pin-function = <0>;
   samsung,pin-pud = <1>;
   samsung,pin-drv = <0>;
  };
 };

 pinctrl@13410000 {

  fimc_is_main_cam_en: fimc_is_main_cam_en {
   samsung,pins = "gpd1-6";
   samsung,pin-function = <1>;
   samsung,pin-pud = <0>;
   samsung,pin-drv = <0>;
  };

  fimc_is_vt_cam_en: fimc_is_vt_cam_en {
   samsung,pins = "gpd1-2";
   samsung,pin-function = <1>;
   samsung,pin-pud = <0>;
   samsung,pin-drv = <0>;
  };
 };

 pinctrl@14000000 {
  fimc_is_i2c_0: fimc-is-i2c-0 {
   samsung,pins = "gpf0-1", "gpf0-0";
   samsung,pin-function = <2>;
   samsung,pin-pud = <3>;
   samsung,pin-drv = <6>;
  };
  fimc_is_spi_pin0: fimc-is-spi-pin0 {
   samsung,pins = "gpf1-3", "gpf1-2", "gpf1-1", "gpf1-0";
   samsung,pin-function = <1>;
   samsung,pin-pud = <1>;
   samsung,pin-drv = <0>;
  };
  fimc_is_flash: fimc-is-flash {
   samsung,pins = "gpe0-2", "gpe0-1";
   samsung,pin-function = <2>;
   samsung,pin-pud = <0>;
   samsung,pin-drv = <0>;
  };

  fimc_is_comp_int: fimc-is-comp-int {
   samsung,pins = "gpe1-0";
   samsung,pin-function = <3>;
   samsung,pin-pud = <0>;
   samsung,pin-drv = <0>;
  };
 };

 muic {
  status = "disabled";
  muic,support-list = "MHL","OTG","Jig USB On","Jig UART Off",
        "Jig UART Off + VB","Jig UART On","TA","USB","CDP",
        "Unofficial","Fuelgauge test","Charging Cable";
 };

 hall {
  status = "okay";
  compatible = "hall";
  pinctrl-names = "default";
  pinctrl-0 = <&hall_irq>;
  hall,gpio_flip_cover = <&gpx0 1 0>;
  hall,gsm_wa = <1>;
 };

 haptic {
  status = "okay";
  haptic,max_timeout = <10000>;

  haptic,duty = <32047>;

  haptic,period = <33500>;
  haptic,reg2 = <0x82>;
  haptic,pwm_id = <0>;
  haptic,regulator_name = "vcc_3.0v_motor";
 };

 torch {
  status = "okay";
  leds1 {
   ledname = "leds-sec1";

   id = <0>;

   timer = <2>;

   timer_mode = <1>;

   cntrl_mode = <0>;
   brightness = <0x3D>;
  };
  leds2 {
   ledname = "torch-sec1";

   id = <1>;

   cntrl_mode = <0>;
   brightness = <0x06>;
  };
 };

 w1_gpio_exynos {
  status = "okay";
  compatible = "w1_gpio_exynos";
  is_open_drain = <1>;
  slave_speed = <1>;
  w1,gpio = <&gpb2 1 0>;
 };

 health_cover {
  status = "okay";
  compatible = "health_cover";
  health_en,gpio = <&gpb0 2 0>;
 };

 gpio_keys {
  compatible = "gpio-keys";
  #address-cells = <1>;
  #size-cells = <0>;
  poll-interval = <100>;
  button@1 {
   label = "gpio-keys: KEY_POWER";
   interrupts = <2 0 0>;
   interrupt-parent = <&gpx2>;
   linux,code = <116>;
   gpios = <&gpx2 2 0xf>;
   gpio-key,wakeup = <1>;
  };
  button@2 {
   label = "gpio-keys: KEY_VOLUMEDOWN";
   interrupts = <3 0 0>;
   interrupt-parent = <&gpx0>;
   linux,code = <114>;
   gpios = <&gpx0 3 0xf>;
  };
  button@3 {
   label = "gpio-keys: KEY_VOLUMEUP";
   interrupts = <2 0 0>;
   interrupt-parent = <&gpx0>;
   linux,code = <115>;
   gpios = <&gpx0 2 0xf>;
  };
  button@4 {
   label = "gpio-keys: KEY_HOMEPAGE";
   interrupts = <5 0 0>;
   interrupt-parent = <&gpx0>;
   linux,code = <172>;
   gpios = <&gpx0 5 0xf>;
   gpio-key,wakeup = <1>;
  };
 };

 sec_input_debug-keys {
  compatible = "sec_input_debug-keys";

  button@1 {
   label = "debug-keys: KEY_POWER";
   linux,code = <116>;
  };
  button@2 {
   label = "debug-keys: KEY_VOLUMEDOWN";
   linux,code = <114>;
   state = "true";
  };
  button@3 {
   label = "debug-keys: KEY_VOLUMEUP";
   linux,code = <115>;
  };
 };

 pinctrl@13400000 {
  cfg_wlanen: cfg-wlanen {
   samsung,pins = "gpy7-7";
   samsung,pin-function = <1>;
   samsung,pin-pud = <0>;
   samsung,pin-drv = <3>;
   samsung,pin-con-pdn = <3>;
   samsung,pin-pud-pdn = <0>;
  };

  cfg_wlanhostwake: cfg-wlanhostwake {
   samsung,pins = "gpx2-0";
   samsung,pin-function = <0>;
   samsung,pin-pud = <1>;
   samsung,pin-con-pdn = <2>;
   samsung,pin-pud-pdn = <0>;
  };
 };

 wlan {
  compatible = "samsung,brcm-wlan";
  gpios = <&gpy7 7 0x1
    &gpx2 0 0xF
    >;
  pinctrl-names = "default";
  pinctrl-0=<&cfg_wlanen &cfg_wlanhostwake>;
  status = "okay";
 };

 usb@12000000 {
  status = "okay";

  is_gpio = <0>;

  dwc3 {
   maximum-speed = "super-speed";
   dr_mode = "otg";
  };
 };

 usb@12400000 {
  status = "okay";

  is_gpio = <0>;

  dwc3 {
   maximum-speed = "super-speed";
   dr_mode = "otg";
  };
 };

 usb@12110000 {

  is_gpio = <0>;
 };

 usb_notifier {
  compatible = "samsung,usb-notifier";
 };

 i2s0: i2s@03830000 {
  status = "okay";
 };

 i2s_dummy: dummy-i2s {
  compatible = "samsung,dummy-i2s";
  status = "okay";
 };

 sound {
  compatible = "samsung,pacific-arizona";
  samsung,audio-cpu = <&i2s0
         &i2s_dummy
         &i2s_dummy
         &i2s0>;
  samsung,audio-codec = <&audio_codec
           &audio_codec
           &audio_codec
           &audio_codec>;

  clocks = <&clock 4200>;
  clock-names = "mclk";

  status = "okay";
 };

 input_booster {
  status = "okay";
  compatible = "input_booster";
  #address-cells = <1>;
  #size-cells = <0>;

  booster_key@1 {
   input_booster,label = "TOUCH";
   input_booster,type = <0>;

   input_booster,levels = <1 2 3 4 5 9 10>;



   input_booster,cpu_freqs = <1600000 0 0 0 1200000 1900000 1600000>;
   input_booster,hmp_boost = <1 0 0 0 1 1 1>;
   input_booster,kfc_freqs = <1000000 1200000 1300000 1300000 800000 1300000 1300000>;
   input_booster,mif_freqs = <633000 413000 413000 633000 633000 825000 825000>;
   input_booster,int_freqs = <333000 110000 111000 111000 333000 400000 400000>;


   input_booster,head_times = <130 130 130 130 100 500 0>;
   input_booster,tail_times = <500 500 500 200 500 1000 0>;
   input_booster,phase_times = <0 0 0 0 40 0 0>;
  };

 };

 sec_thermistor {
  compatible = "samsung,sec-ap-thermistor";
  status = "okay";


  adc_array = <181 189 197 205 213 221 229 237 245 253 261 269 277 286 297 309 318 329 340 350
               361 370 380 393 405 418 431 446 460 473 489 503 520 536 552 569 586 604 622 640
               659 679 698 718 739 759 781 803 824 847 869 891 914 938 959 982 1005 1030 1052
               1076 1099 1126 1145 1168 1193 1215 1239 1263 1286 1309 1333 1354 1377 1397 1418
               1439 1459 1483 1497 1518 1537 1557 1557 1593 1611 1628 1645 1661 1678 1693 1704
               1718 1732 1745 1757 1770 1781 1794 1805 1815 1827>;

  temp_array = <800 790 780 770 760 750 740 730 720 710 700 690 680 670 660 650 640 630 620 610
                600 590 580 570 560 550 540 530 520 510 500 490 480 470 460 450 440 430 420 410
                400 390 380 370 360 350 340 330 320 310 300 290 280 270 260 250 240 230 220 210
                200 190 180 170 160 150 140 130 120 110 100 90 80 70 60 50 40 30 20 10 0 (-10)
               (-20) (-30) (-40) (-50) (-60) (-70) (-80) (-90) (-100) (-110) (-120) (-130) (-140)
               (-150) (-160) (-170) (-180) (-190) (-200)>;

  io-channels = <&exynos_adc 0>;
  io-channel-names = "adc-ap-temp";
  io-channel-ranges;
 };

 secgpio_dvs {
  compatible = "samsung,exynos5422-secgpio-dvs";
  status = "okay";
 };

 ion {
  compatible = "samsung,exynos5430-ion";

  contig-names = "common",
          "mfc_sh",
          "g2d_wfd",
          "video",
          "sectbl",
          "mfc_fw",
          "mfc_nfw",
          "secdma";

  contig = <0 0x400000 0x0>,
           <2 0x100000 0x0>,
           <10 0x800000 0x0>,
           <11 0xA800000 0x0>,
           <9 0x100000 0x0>,
           <8 0x100000 0x0>,
           <12 0x100000 0x0>,
           <13 0x20000 0x0>;

  contig-isolate_on_boot = <0>, <2>, <8>,
       <9>, <10>, <11>, <12>, <13>;

  ion_noncontig_heap {
   id-type = <0 0>;
  };

  exynos_contig_heap {
   id-type = <4 6>;
  };
 };

 ipa_pdata {
  compatible = "samsung,exynos-ipa";

  control_temp = <50>;
  temp_threshold = <10>;
  enabled = <1>;
  tdp = <3500>;
  boost = <1>;
  ros_power = <500>;
  a7_weight = <1024>;
  a15_weight = <256>;
  gpu_weight = <256>;
  a7_max_power = <1000>;
  a15_max_power = <6552>;
  gpu_max_power = <3110>;
  hotplug_out_threshold = <10>;
  hotplug_in_threshold = <0>;
  enable_ctlr = <1>;
  ctlr.mult = <2>;
  ctlr.k_i = <1>;
  ctlr.k_d = <0>;
  ctlr.feed_forward = <1>;
  ctlr.integral_reset_value = <0>;
  ctlr.integral_cutoff = <0>;
  ctlr.integral_reset_threshold = <5>;
 };
};
# 14 "arch/arm/boot/dts/exynos5422-k3g_eur_open_04.dts" 2
# 1 "arch/arm/boot/dts/exynos5422-k_battery_03.dtsi" 1
# 12 "arch/arm/boot/dts/exynos5422-k_battery_03.dtsi"
/ {
        i2c@19{
                compatible = "i2c-gpio";
                gpios = <&gpb0 3 0
                         &gpb0 4 0
                        >;
                i2c-gpio,delay-us = <2>;
                #address-cells = <1>;
                #size-cells = <0>;
  status = "okay";
  sec-fuelgauge@36 {
   compatible = "sec-fuelgauge,i2c";
   reg = <0x36>;
   pinctrl-names = "default";
   pinctrl-0 = <&fuel_irq>;
   fuelgauge,fuel_int = <&gpx1 5 0>;
   fuelgauge,fuel_alert_soc = <2>;
   fuelgauge,capacity_max = <990>;
   fuelgauge,capacity_max_margin = <30>;
   fuelgauge,capacity_min = <0>;
   fuelgauge,capacity_calculation_type = <28>;
   fuelgaguge,repeated_fuelalert;
   fuelgauge,rcomp0 = <0x5D>;
   fuelgauge,rcomp_charging = <0x5D>;
   fuelgauge,temp_cohot = <(-175)>;
   fuelgauge,temp_cocold = <(-5825)>;
   fuelgauge,is_using_model_data;
   fuelgauge,type_str = "SDI";
  };
 };

 battery {
  status = "okay";
  compatible = "samsung,sec-battery";
  battery,vendor = "SDI SDI";
  battery,charger_name = "sec-charger";
  battery,fuelgauge_name = "sec-fuelgauge";
  battery,technology = <2>;

  battery,chip_vendor = "LSI";
  battery,temp_adc_type = <1>;

  battery,polling_time = <10 30 30 30 3600>;

  battery,temp_table_adc = <276 326 383 455 530 629 740 787 866 1013
             1181 1361 1564 1792 2024 2263 2493 2728 2948 3011
      3135 3208 3313 3465 3588 3698 3779>;
  battery,temp_table_data = <900 850 800 750 700 650 600 580 550 500
        450 400 350 300 250 200 150 100 50 30
        0 (-20) (-50) (-100) (-150) (-200) (-250)>;

  battery,input_current_limit = <1800 0 0 1800 460 900 1000 460 1000 0 760 1900 0 0 0 400 700 1300 300 1000 1600>;
  battery,fast_charging_current = <2100 0 0 2100 460 1200 1000 460 1200 0 900 1600 0 0 0 400 700 1300 300 1000 1900>;
  battery,full_check_current_1st = <200 0 0 200 200 200 200 200 200 0 200 200 0 0 0 200 200 200 200 200 200>;
  battery,full_check_current_2nd = <2400 0 0 2400 2400 2400 2400 2400 2400 0 2400 2400 0 0 0 2400 2400 2400 2400 2400 2400>;

  battery,adc_check_count = <5>;

  battery,cable_check_type = <4>;
  battery,cable_source_type = <1>;
  battery,event_waiting_time = <600>;
  battery,polling_type = <1>;
  battery,monitor_initial_count = <0>;

  battery,battery_check_type = <5>;
  battery,check_count = <0>;
  battery,check_adc_max = <1440>;
  battery,check_adc_min = <0>;

  battery,ovp_uvlo_check_type = <3>;

  battery,thermal_source = <2>;

  battery,temp_check_type = <2>;
  battery,temp_check_count = <1>;
  battery,temp_highlimit_threshold_event = <800>;
  battery,temp_highlimit_recovery_event = <750>;
  battery,temp_high_threshold_event = <700>;
  battery,temp_high_recovery_event = <460>;
  battery,temp_low_threshold_event = <(-30)>;
  battery,temp_low_recovery_event = <0>;
  battery,temp_highlimit_threshold_normal = <800>;
  battery,temp_highlimit_recovery_normal = <750>;
  battery,temp_high_threshold_normal = <600>;
  battery,temp_high_recovery_normal = <460>;
  battery,temp_low_threshold_normal = <(-50)>;
  battery,temp_low_recovery_normal = <0>;
  battery,temp_highlimit_threshold_lpm = <800>;
  battery,temp_highlimit_recovery_lpm = <750>;
  battery,temp_high_threshold_lpm = <600>;
  battery,temp_high_recovery_lpm = <460>;
  battery,temp_low_threshold_lpm = <(-50)>;
  battery,temp_low_recovery_lpm = <0>;
  battery,full_check_type = <7>;
  battery,full_check_type_2nd = <3>;
  battery,full_check_count = <1>;
  battery,chg_gpio_full_check = <0>;
  battery,chg_polarity_full_check = <1>;




  battery,full_condition_type = <13>;
  battery,full_condition_soc = <97>;
  battery,full_condition_vcell = <4350>;

  battery,recharge_check_count = <2>;
  battery,recharge_condition_type = <4>;
  battery,recharge_condition_soc = <98>;
  battery,recharge_condition_vcell = <4350>;

  battery,charging_total_time = <21600>;
  battery,recharging_total_time = <5400>;
  battery,charging_reset_time = <0>;

  io-channels = <&exynos_adc 4>;
  io-channel-names = "adc-temp";
  #io-channel-cells = <1>;
  io-channel-ranges;
 };

 charger {
  status = "disable";

                battery,charger_name = "sec-charger";
                battery,chg_gpio_en = <0>;
                battery,chg_polarity_en = <0>;
                battery,chg_gpio_status = <0>;
                battery,chg_polarity_status = <0>;
                battery,chg_float_voltage = <4400>;
 };
};
# 15 "arch/arm/boot/dts/exynos5422-k3g_eur_open_04.dts" 2
# 1 "arch/arm/boot/dts/exynos5-sec_modem-xmm6360.dtsi" 1
# 12 "arch/arm/boot/dts/exynos5-sec_modem-xmm6360.dtsi"
/ {

 mif_pdata {
  mif,name = "xmm6360";
  mif,modem_net = <0>;
  mif,modem_type = <1>;
  mif,link_types = <0x20>;
  mif,use_handover = <0>;
  mif,ipc_version = <50>;
  mif,num_iodevs = <12>;

  mif,max_link_channel = <7>;
  mif,max_acm_channel = <3>;
  mif,max_tx_qlen = <50>;

  iodevs {
   io_device_0 {
    iod,name = "umts_ipc0";
    iod,id = <235>;
    iod,format = <0>;
    iod,io_type = <0>;
    iod,links = <0x20>;
    iod,attr = <0x42>;
   };
   io_device_1 {
    iod,name = "umts_rfs0";
    iod,id = <245>;
    iod,format = <2>;
    iod,io_type = <0>;
    iod,links = <0x20>;
    iod,attr = <0x62>;
   };
   io_device_2 {
    iod,name = "umts_boot0";
    iod,id = <0>;
    iod,format = <4>;
    iod,io_type = <0>;
    iod,links = <0x20>;
    iod,attr = <0>;
   };
   io_device_3 {
    iod,name = "multipdp";
    iod,id = <0>;
    iod,format = <5>;
    iod,io_type = <2>;
    iod,links = <0x20>;
    iod,attr = <0x42>;
   };
   io_device_4 {
    iod,name = "umts_router";
    iod,id = <25>;
    iod,format = <1>;
    iod,io_type = <0>;
    iod,links = <0x20>;
    iod,attr = <0x42>;
   };
   io_device_5 {
    iod,name = "umts_csd";
    iod,id = <1>;
    iod,format = <1>;
    iod,io_type = <0>;
    iod,links = <0x20>;
    iod,attr = <0x42>;
   };
   io_device_6 {
    iod,name = "umts_dm0";
    iod,id = <28>;
    iod,format = <1>;
    iod,io_type = <0>;
    iod,links = <0x20>;
    iod,attr = <0>;
   };
   io_device_7 {
    iod,name = "umts_log";
    iod,id = <27>;
    iod,format = <4>;
    iod,io_type = <0>;
    iod,links = <0x20>;
    iod,attr = <0>;
   };
   io_device_8 {
    iod,name = "rmnet0";
    iod,id = <10>;
    iod,format = <7>;
    iod,io_type = <1>;
    iod,links = <0x20>;
    iod,attr = <0x4>;
   };
   io_device_9 {
    iod,name = "rmnet1";
    iod,id = <11>;
    iod,format = <7>;
    iod,io_type = <1>;
    iod,links = <0x20>;
    iod,attr = <0x4>;
   };
   io_device_10 {
    iod,name = "rmnet2";
    iod,id = <12>;
    iod,format = <7>;
    iod,io_type = <1>;
    iod,links = <0x20>;
    iod,attr = <0x4>;
   };
   io_device_11 {
    iod,name = "rmnet3";
    iod,id = <13>;
    iod,format = <7>;
    iod,io_type = <1>;
    iod,links = <0x20>;
    iod,attr = <0x4>;
   };
  };
 };


 linkpm_pdata {
  linkpm,name = "link_pm";
  linkpm,port = <1>;
 };
};
# 16 "arch/arm/boot/dts/exynos5422-k3g_eur_open_04.dts" 2

/ {
 model = "Samsung K 3G EUR revision 04 board based on EXYNOS5422";
 model_info-chip = <5422>;
 model_info-platform = "k3g";
 model_info-subtype = "k3g_eur_open";
 model_info-hw_rev = <4>;
 model_info-hw_rev_end = <4>;
 compatible = "samsung,K 3G EUR,r04", "samsung,exynos5422";

 dwmmc2@12220000 {
  vmmc-en-gpio = <&gpy2 0 0x1>;
  vqmmc-en-gpio = <&gpy3 1 0x1>;
 };

 hsi2c@12CD0000 {
  s2mps11_pmic@66 {
   regulators {
    ldo5_reg: LDO5 {
     regulator-name = "HRM_1.8V_AP";
     regulator-min-microvolt = <1800000>;
     regulator-max-microvolt = <1800000>;
    };
    ldo24_reg: LDO24 {
     regulator-name = "VCC_3.3V_MHL";
     regulator-min-microvolt = <3300000>;
     regulator-max-microvolt = <3300000>;
    };
    ldo34_reg: LDO34 {
     regulator-name = "HRM_3.3V_AP";
     regulator-min-microvolt = <3300000>;
     regulator-max-microvolt = <3300000>;
    };
   };
  };
 };

 pinctrl@14010000 {
  uart1_rts: uart1-rts {
   samsung,pins = "gpa0-7";
   samsung,pin-function = <2>;
   samsung,pin-pud = <0>;
   samsung,pin-con-pdn = <1>;
   samsung,pin-pud-pdn = <0>;
  };

  uart1_cts: uart1-cts {
   samsung,pins = "gpa0-6";
   samsung,pin-function = <2>;
   samsung,pin-pud = <0>;
   samsung,pin-con-pdn = <2>;
   samsung,pin-pud-pdn = <1>;
  };

  uart1_tx: uart1-tx {
   samsung,pins = "gpa0-5";
   samsung,pin-function = <2>;
   samsung,pin-pud = <0>;
   samsung,pin-con-pdn = <2>;
   samsung,pin-pud-pdn = <3>;
  };

  uart1_rx: uart1-rx {
   samsung,pins = "gpa0-4";
   samsung,pin-function = <2>;
   samsung,pin-pud = <3>;
   samsung,pin-con-pdn = <2>;
   samsung,pin-pud-pdn = <3>;
  };

  nfc_cfg: nfc-cfg {
             samsung,pins = "gph0-6";
             samsung,pin-function = <2>;
  };
 };

 serial@12C10000 {
  pinctrl-0 = <&uart1_rts &uart1_cts &uart1_tx &uart1_rx>;
 };

 gps {
  compatible = "samsung,exynos54xx-bcm4753";
  gpios = <&gpx1 0 0x1
             &gpx0 6 0xf
   >;
  status = "okay";
 };

 i2c@12C90000 {
  samsung,i2c-sda-delay = <100>;
  samsung,i2c-max-bus-freq = <400000>;
  #address-cells = <1>;
  #size-cells = <0>;
  status = "okay";

  pn547@29 {
   compatible = "pn547";
   reg = <0x29>;
   interrupts = <3 0 0>;
   interrupt-parent = <&gpx1>;

   pn547-en = <&gpg1 2 0x00>;
   pn547-firmware = <&gpg1 1 0x00>;
   pn547-irq = <&gpx1 3 0xf>;
   pn547-clk-req = <&gpx0 0 0xf>;
   pn547-clk-use = <1>;
   pinctrl-names = "default";
   pinctrl-0 = <&nfc_cfg>;
   clocks = <&clock 1217>;
   clock-names = "sclk_isp_sensor1";
  };

  max86900@51 {
   compatible = "max86900";
   reg = <0x51>;
   pinctrl-names = "default";
   pinctrl-0 = <&hrm_int>;
   interrupt-parent = <&gpx3>;
   interrupts = <1 0>;
   max86900,hrm_int-gpio = <&gpx3 1 0x00>;
  };

 };

 tsp_avdd_en {
  compatible = "regulator-fixed";
  regulator-name = "tsp_avdd_en";
  regulator-min-microvolt = <3300000>;
  regulator-max-microvolt = <3300000>;
  gpio = <&gpy3 5 0>;
  enable-active-high;
 };

 pinctrl@13400000 {
  attn_irq: attn-irq {
   samsung,pins = "gpx1-6";
   samsung,pin-function = <0xf>;
   samsung,pin-pud = <0>;
   samsung,pin-drv = <0>;
  };

  attn_input: attn-input {
   samsung,pins = "gpx1-6";
   samsung,pin-function = <0>;
   samsung,pin-pud = <1>;
   samsung,pin-drv = <0>;
  };
 };

 pinctrl@14010000 {
  i2c0_bus: i2c0-bus {
   samsung,pins = "gpb3-1", "gpb3-0";
   samsung,pin-function = <2>;
   samsung,pin-pud = <0>;
   samsung,pin-drv = <0>;
  };

  i2c_pdn_off: i2c-pdn_off {
   samsung,pins = "gpb3-1", "gpb3-0";
   samsung,pin-con-pdn = <2>;
   samsung,pin-pud-pdn = <1>;
  };

  i2c_pdn_sleep: i2c-pdn_sleep {
   samsung,pins = "gpb3-1", "gpb3-0";
   samsung,pin-con-pdn = <2>;
   samsung,pin-pud-pdn = <0>;
  };
 };

 i2c@12C60000 {
  samsung,i2c-sda-delay = <100>;
  samsung,i2c-max-bus-freq = <400000>;
  status = "okay";
  touchscreen@20 {
   compatible = "synaptics,rmi4";
   reg = <0x20>;
   pinctrl-names = "on_state", "off_state", "sleep_state";
   pinctrl-0 = <&attn_irq>;
   pinctrl-1 = <&attn_input &i2c_pdn_off>;
   pinctrl-2 = <&attn_irq &i2c_pdn_sleep>;
   synaptics,irq_gpio = <&gpx1 6 0>;
   synaptics,irq_type = <8200>;
   synaptics,max_coords = <1079 1919>;
   synaptics,num_lines = <29 16>;
   synaptics,regulator_dvdd = "tsp_io";
   synaptics,regulator_avdd = "tsp_avdd_en";
   synaptics,project_name = "K", "G900H";
  };
 };

 spi_0: spi@12d20000 {
  #address-cells = <1>;
  #size-cells = <0>;
  pinctrl-names = "default";
  pinctrl-0 = <&spi0_bus>;

  STM32F@0 {
   compatible = "ssp,STM32F";
   reg = <0>;
   spi-max-frequency = <5000000>;
   pinctrl-names = "default";
   pinctrl-0 = <&ssp_irq &ssp_irq2 &ssp_ap_int>;

   gpio-controller;
   #gpio-cells = <2>;
   ssp-irq = <&gpx3 3 0x00>;
   ssp-irq2 = <&gpx3 4 0x00>;
   ssp-ap-int = <&gpx3 0 0x00>;
   ssp-reset = <&gpg0 0 0x00>;
   ssp-acc-position = <6>;
   ssp-mag-position = <6>;
   ssp-sns-combination = <0>;
   ssp-ap-rev = <1>;
   ssp-mag-array = <10000 0 0 0 10000 0 0 0 10000>;

   controller-data {
    cs-gpio = <&gpa2 1 0>;
    samsung,spi-feedback-delay = <0>;
   };
  };
 };


 pinctrl@13400000 {
  ocp_flag: ocf-flag {
   samsung,pins = "gpx2-3";
   samsung,pin-function = <0>;
   samsung,pin-pud = <3>;
   samsung,pin-drv = <3>;
  };
  btp_irq: btp-irq {
   samsung,pins = "gpx3-5";
   samsung,pin-function = <0>;
   samsung,pin-pud = <1>;
   samsung,pin-drv = <3>;
  };
  btp_irqsleep: btp-irqsleep {
   samsung,pins = "gpx3-5";
   samsung,pin-function = <0>;
   samsung,pin-pud = <1>;
  };
  btp_irqidle: btp-irqidle {
   samsung,pins = "gpx3-5";
   samsung,pin-function = <0xf>;
   samsung,pin-pud = <3>;
  };
 };

 pinctrl@13410000 {
  btp_reset: btp-reset {
   samsung,pins = "gpd1-1";
   samsung,pin-function = <1>;
   samsung,pin-pud = <1>;
   samsung,pin-drv = <0>;
  };
  btp_ldo: btp-ldo {
   samsung,pins = "gpy4-0";
   samsung,pin-function = <1>;
   samsung,pin-pud = <1>;
   samsung,pin-drv = <0>;
  };
 };

 pinctrl@14010000 {
  spi1_bus: spi1-bus {
   samsung,pin-drv = <3>;
  };

  spi1_cs: spi1-cs {
   samsung,pin-drv = <3>;
  };
 };

 spi_1: spi@12d30000 {
  /delete-property/ dma-mode;
  /delete-property/ dmas;
  /delete-property/ dma-names;
  #address-cells = <1>;
  #size-cells = <0>;
  pinctrl-names = "default";
  pinctrl-0 = <&spi1_bus>;

  vfsspi-spi@0 {
   compatible = "vfsspi,vfs61xx";
   reg = <0>;
   spi-max-frequency = <19200000>;
   pinctrl-names = "default", "sleep", "idle";
   pinctrl-0 = <&btp_irq &btp_reset &btp_ldo &ocp_flag>;
   pinctrl-1 = <&btp_irqsleep>;
   pinctrl-2 = <&btp_irqidle>;

   gpio-controller;
   #gpio-cells = <2>;

   vfsspi-sleepPin = <&gpd1 1 0x00>;
   vfsspi-drdyPin = <&gpx3 5 0x00>;
   vfsspi-ldoPin = <&gpy4 0 0x00>;

   vfsspi-ldocontrol = <1>;
   vfsspi-orient = <1>;
   vfsspi-irqpincon = <1>;

   controller-data {
    cs-gpio = <&gpa2 5 0 0 3>;
    samsung,spi-feedback-delay = <0>;
   };
  };
 };


 mif_pdata {
  compatible = "sec_modem,modem_pdata";
  status = "okay";
  pinctrl-names = "default";
  pinctrl-0 = <&ap_dump_int &cp_on &reset_req_n>;

  mif,gpio_cp_on = <&gpg1 4 0x1>;
  mif,gpio_reset_req_n = <&gpj4 1 0x1>;
  mif,gpio_cp_reset = <&gpx1 1 0x1>;
  mif,gpio_pda_active = <&gpx3 6 0x1>;
  mif,gpio_phone_active = <&gpx2 7 0xf>;
  mif,gpio_cp_dump_int = <&gpx2 6 0x0>;
  mif,gpio_ap_dump_int = <&gpg1 6 0x1>;
 };


 linkpm_pdata {
  compatible = "sec_modem,linkpm_pdata";
  status = "okay";
  pinctrl-names = "default";
  pinctrl-0 = <&link_active &link_slavewake>;

  reg = <0x12110000 0x100>,
        <0x12130000 0x100>;

  linkpm,gpio_link_active = <&gpg1 7 0x1>;
  linkpm,gpio_link_hostwake = <&gpx1 2 0xf>;
  linkpm,gpio_link_slavewake = <&gpg1 0 0x1>;
  linkpm,gpio_suspend_req = <&gpg1 3 0x1>;
 };

 pinctrl@14000000 {
  link_slavewake: link_slavewake {
   samsung,pins = "gpg1-0";
   samsung,pin-function = <1>;
   samsung,pin-con-pdn = <3>;
   samsung,pin-pud-pdn = <0>;
  };
  cp_on: cp_on {
   samsung,pins = "gpg1-4";
   samsung,pin-function = <1>;
   samsung,pin-con-pdn = <0>;
   samsung,pin-pud-pdn = <0>;
  };
  ap_dump_int: ap_dump_int {
   samsung,pins = "gpg1-6";
   samsung,pin-function = <1>;
   samsung,pin-con-pdn = <3>;
   samsung,pin-pud-pdn = <0>;
  };
  link_active: link_active {
   samsung,pins = "gpg1-7";
   samsung,pin-function = <1>;
   samsung,pin-con-pdn = <0>;
   samsung,pin-pud-pdn = <0>;
  };
  reset_req_n: reset_req_n {
   samsung,pins = "gpj4-1";
   samsung,pin-function = <1>;
   samsung,pin-con-pdn = <3>;
   samsung,pin-pud-pdn = <0>;
  };
 };

 spi_2: spi@12d40000 {
  #address-cells = <1>;
  #size-cells = <0>;
  pinctrl-names = "default";
  pinctrl-0 = <&spi2_bus>;

  audio_codec: wm5110@0 {
   compatible = "wlf,wm5110";
   reg = <0x0>;
   spi-max-frequency = <20000000>;
   interrupts = <5 0 0>;
   interrupt-parent = <&gpx2>;

   gpio-controller;
   #gpio-cells = <2>;

   pinctrl-names ="default";
   pinctrl-0 = <&codec_reset &codec_ldoena &audio_ctrl>;

   wlf,reset = <&gpg2 0 0>;
   wlf,ldoena = <&gpg0 1 0>;
   wlf,init-mic-delay = <30>;
   wlf,micd-detect-debounce = <300>;
   wlf,micd-bias-start-time = <0x1>;
   wlf,micd-rate = <0x7>;
   wlf,micd-dbtime = <0x1>;
   wlf,micd-timeout = <1000>;
   wlf,micd-force-micbias;
   wlf,micd-ranges = <
    139 226
    295 115
    752 114
    1257 217
   >;

   wlf,micd-configs = <
    0x0 1 0
   >;

   wlf,micbias1 = <2800 0 1 0 0>;
   wlf,micbias2 = <1800 0 1 0 0>;
   wlf,micbias3 = <1800 0 1 0 0>;

   wlf,gpio-defaults = <
    0xA101
    0xA101
    0xA101
    0xA101
    0x8101
   >;

   wlf,gpsw = <0x3>;
   wlf,use-jd-gpio;
   wlf,jd-gpio-nopull;
   wlf,micd-software-compare;
   wlf,micd-open-circuit-declare = <1>;

   wlf,max-channels-clocked = <2 0 0>;

   wlf,dmic-ref = <2 1 3 2>;

   wlf,inmode = <2 0 2 2>;

   wlf,out-mono = <0 0 1 0 0 0>;

   AVDD-supply = <&ldo18_reg>;
   LDOVDD-supply = <&ldo18_reg>;
   DBVDD1-supply = <&ldo18_reg>;

   CPVDD-supply = <&ldo18_reg>;
   DBVDD2-supply = <&ldo18_reg>;
   DBVDD3-supply = <&ldo18_reg>;
   SPKVDDL-supply = <&ldo18_reg>;
   SPKVDDR-supply = <&ldo18_reg>;

   adsps {
    #address-cells = <1>;
    #size-cells = <0>;

    adsp@1100 {
     reg = <0x1100>;
     firmware {
      EDAC {
       wlf,wmfw-file = "edac";
       wlf,bin-file = "edac";
      };
      TRACE {
       wlf,wmfw-file = "trace";
       wlf,compr-caps = <1 8 0x4 1 8000 16000 24000>;
      };
     };
    };
    adsp@1200 {
     reg = <0x1200>;
     firmware {
      TX_NB {
       wlf,wmfw-file = "tx-nb";
      };
      TX_WB {
       wlf,wmfw-file = "tx-wb";
      };
      TX_SWB_INTERVIEW {
       wlf,wmfw-file = "tx-swb";
      };
      TX_SWB_CONVERSATION {
       wlf,wmfw-file = "tx-swb";
      };
     };
    };
    adsp@1300 {
     reg = <0x1300>;
     firmware {
      TX_NB {
       wlf,wmfw-file = "tx-nb";
       wlf,bin-file = "tx-nb";
      };
      TX_WB {
       wlf,wmfw-file = "tx-wb";
       wlf,bin-file = "tx-wb";
      };
      TX_SWB_INTERVIEW {
       wlf,wmfw-file = "tx-swb";
       wlf,bin-file = "tx-swb-interview";
      };
      TX_SWB_CONVERSATION {
       wlf,wmfw-file = "tx-swb";
       wlf,bin-file = "tx-swb-conversation";
      };
      VOICECONTROL {
       wlf,wmfw-file = "ez2-control";
       wlf,bin-file = "ez2-control";
      };
      LPSD {
       wlf,wmfw-file = "ez2-control";
       wlf,bin-file = "lpsd-control";
      };
     };
    };
    adsp@1400 {
     reg = <0x1400>;
     firmware {
      RX_NB {
       wlf,wmfw-file = "rx-anc-nb";
       wlf,bin-file = "rx-anc-nb";
      };
      RX_WB {
       wlf,wmfw-file = "rx-anc-wb";
       wlf,bin-file = "rx-anc-wb";
      };
     };
    };
   };
   controller-data {
    cs-gpio = <&gpb1 2 0>;
    samsung,spi-feedback-delay = <0>;
   };
  };
 };

 audio_pdata {
  compatible = "samsung,audio-pdata";

  mic_bias_gpio = <&gpy7 6 0>;
  status = "okay";
 };

 pinctrl@13400000 {
  audio_ctrl: audio-ctl {
   samsung,pins = "gpy7-6";
   samsung,pin-con-pdn = <3>;
  };
 };

 pinctrl@14000000 {
  codec_reset: codec-reset {
   samsung,pins ="gpg2-0";
   samsung,pin-function = <1>;
   samsung,pin-pud = <1>;
   samsung,pin-con-pdn =<3>;
   samsung,pin-pud-pdn = <1>;
  };
  codec_ldoena: codec-ldoena {
   samsung,pins ="gpg0-1";
   samsung,pin-con-pdn =<3>;
  };
 };

 pinctrl@14010000 {
  uart0_rts: uart0-rts {
   samsung,pins = "gpa0-3";
   samsung,pin-function = <2>;
   samsung,pin-pud = <3>;
   samsung,pin-con-pdn = <1>;
   samsung,pin-pud-pdn = <3>;
  };

  uart0_cts: uart0-cts {
   samsung,pins = "gpa0-2";
   samsung,pin-function = <2>;
   samsung,pin-pud = <3>;
   samsung,pin-con-pdn = <2>;
   samsung,pin-pud-pdn = <3>;
  };

  uart0_tx: uart0-tx {
   samsung,pins = "gpa0-1";
   samsung,pin-function = <2>;
   samsung,pin-pud = <3>;
   samsung,pin-con-pdn = <1>;
   samsung,pin-pud-pdn = <3>;
  };

  uart0_rx: uart0-rx {
   samsung,pins = "gpa0-0";
   samsung,pin-function = <2>;
   samsung,pin-pud = <3>;
   samsung,pin-con-pdn = <2>;
   samsung,pin-pud-pdn = <3>;
  };
 };
# 628 "arch/arm/boot/dts/exynos5422-k3g_eur_open_04.dts"
 serial@12C00000 {
  pinctrl-0 = <&uart0_rts &uart0_cts &uart0_tx &uart0_rx>;
 };

 pinctrl@14000000 {
  cfg_en: cfg-en {
   samsung,pins ="gpg0-7";
   samsung,pin-function = <1>;
   samsung,pin-pud = <1>;
   samsung,pin-con-pdn = <3>;
   samsung,pin-pud-pdn = <1>;
  };
 };

 pinctrl@13400000 {
  cfg_hostwake: cfg-hostwake {
   samsung,pins = "gpx2-1";
   samsung,pin-function = <0>;
   samsung,pin-pud = <2>;
   samsung,pin-con-pdn = <2>;
   samsung,pin-pud-pdn = <0>;
  };

  cfg_btwake: cfg-btwake {
   samsung,pins = "gpx3-2";
   samsung,pin-function = <1>;
   samsung,pin-pud = <1>;
   samsung,pin-con-pdn = <0>;
   samsung,pin-pud-pdn = <1>;
  };
 };

 bluetooth {
  compatible = "broadcom,bcm4354";

  gpios = <&gpg0 7 0
    &gpx3 2 0
    &gpx2 1 0xF >;

  pinctrl-names = "default";
  pinctrl-0=<&cfg_hostwake &cfg_btwake &cfg_en>;
  status = "okay";
 };

 usb_notifier {
  gpios_redriver_en = <&gpy7 5 0x1>;
 };

 sec_thermistor {
  compatible = "samsung,sec-ap-thermistor";
  status = "okay";

  adc_array = <261 269 277 285 293 301 309 317 325 333 341 351 361 372 382 392 409 426 443 460
     475 494 513 532 551 569 585 601 617 633 648 698 748 772 796 821 859 898 936 975
     1013 1038 1063 1099 1135 1172 1199 1226 1271 1316 1361 1399 1437 1472 1507 1541
     1590 1639 1679 1719 1760 1803 1846 1890 1934 1977 2019 2061 2103 2145 2186 2225
     2264 2303 2342 2381 2420 2459 2498 2537 2577 2613 2649 2685 2721 2757 2793 2830
     2866 2903 2940 2968 2996 3024 3052 3080 3108 3136 3164 3192 3217 3237 3258 3278
     3299 3319 3340 3360 3381 3401 3422>;

  temp_array = <900 890 880 870 860 850 840 830 820 810 800 790 780 770 760 750 740 730 720 710
      700 690 680 670 660 650 640 630 620 610 600 590 580 570 560 550 540 530 520 510
      500 490 480 470 460 450 440 430 420 410 400 390 380 370 360 350 340 330 320 310
      300 290 280 270 260 250 240 230 220 210 200 190 180 170 160 150 140 130 120 110
      100 90 80 70 60 50 40 30 20 10 0 (-10) (-20) (-30) (-40) (-50) (-60) (-70) (-80)
      (-90) (-100) (-110) (-120) (-130) (-140) (-150) (-160) (-170) (-180) (-190) (-200)>;

  io-channels = <&exynos_adc 0>;
  io-channel-names = "adc-ap-temp";
  io-channel-ranges;
 };

};
